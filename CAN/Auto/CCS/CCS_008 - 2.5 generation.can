/*@!Encoding:65001*/
// Preconditions: - Block CCU, ACC and IGN and ccNC/ccIC switch OFF state, AVN mode
includes
{
  
  #include "..\DeclarationFunction_Gen2.5.h"
  
}

variables
{
  char failReason[512];
  // Global Variable Declaration
  int i;
  int get_PEVRecorded_change = 0;
  byte get_PEVRecorded_value = 0x0;
  
  // Variables for test summary
  int total_tests = 0;
  int passed_tests = 0;
  int failed_tests = 0;
  char failed_test_names[2048] = ""; // To store names of failed tests
}

testcase CCS_008_1() {
  Send_Value_To_COM(30801);
  SetTestStep("Buoc 1 - CCS_008");
  StartTestTimer();
  @panel::Switch_CGWNM = 1;
  testStep("Step 1", "Start test-case CCS_008_1");
  write("=== START CCS_008_1 ===");  
  
  write("=== SETTING ===");
  
  Set_BglrAlrm(0x5); 
  
  write("KEY ON"); KEY_ON(); testWaitForTimeout(3000);
  Apply_CCS_RecSettings(0x2, 0);
  
  write("=== TESTING ===");
  
  write("KEY OFF"); KEY_OFF();
  
  if (WaitFor_RecSta_OWP_Recording(60000) == 1) {
    
    write("OWP recording is started"); @panel::Switch_CGWNM = 1;
    
    testWaitForTimeout(10000);
    
    
    if (WaitFor_RecSta_PEV_Recording(60) == 1) {
      
      write("PEV recording is started"); 
      
      get_PEVRecorded_change = WaitFor_PEV_Recorded_Value(0x2, 10000);
      
      get_PEVRecorded_value = $BLTN_CAM_PEV_Recorded;
      
      if (get_PEVRecorded_change != 1 && get_PEVRecorded_value == 0x0) {
        
        write("PEV_Recorded: 0x%X << Test-case is OK >>", get_PEVRecorded_value);
        
        testStepPass("Pass","Test-case is OK");
        passed_tests++;
        
      }
      else {
        
        write("PEV_Recorded: 0x%X << Test-case is NG >>", get_PEVRecorded_value);
        
        snprintf(failReason, elcount(failReason), "Fail reason: Test-case is NG (PEV_Recorded=0x%X). Cause: expected condition was not satisfied.", get_PEVRecorded_value);
        testStepFail("Fail", failReason);
        failed_tests++;
        strncat(failed_test_names, "CCS_008_1 (PEV check), ", elcount(failed_test_names));
      }
    }
    else {
      write("PEV recording hasn't started"); 
      snprintf(failReason, elcount(failReason), "Fail reason: PEV recording hasn\'t started (BLTN_CAM_RecSta_PEV=0x%X). Cause: expected condition was not satisfied.", $BLTN_CAM_RecSta_PEV);
      testStepFail("Fail", failReason);
      failed_tests++;
      strncat(failed_test_names, "CCS_008_1 (PEV timeout), ", elcount(failed_test_names));
    }
  }
  else {
    write("OWP recording hasn't started");
    snprintf(failReason, elcount(failReason), "Fail reason: OWP recording hasn\'t started (BLTN_CAM_RecSta_OWP=0x%X). Cause: expected condition was not satisfied.", $BLTN_CAM_RecSta_OWP);
    testStepFail("Fail", failReason);
    failed_tests++;
    strncat(failed_test_names, "CCS_008_1 (OWP timeout), ", elcount(failed_test_names));
  }
  
  total_tests++;
  
  write("Run CaptureGraphics()"); CaptureGraphics("CSS", "BLTN_CAM_RecSta_OWP;BLTN_CAM_RecSta_PEV;BLTN_CAM_PEV_Recorded;BAlarm_BglrAlrmCurrentSta;SMK_TrmnlCtrlGrpStaBDC");  
  
  Standard_Init();
  
  @panel::Switch_CGWNM = 0;
  
  write("=== FINISH CCS_008_1 ===");

  StopTestTimer();
  Send_Value_To_COM(44);
}

testcase CCS_008_2() {
  Send_Value_To_COM(30802);
  SetTestStep("Buoc 2 - CCS_008");
  StartTestTimer();
  @panel::Switch_CGWNM = 1;
  testStep("Step 2", "Start test-case CCS_008_2");
  write("=== START CCS_008_2 ==="); 
  
  
  write("=== SETTING ===");
  
  Set_BglrAlrm(0x5);
  
  write("KEY ON"); KEY_ON(); testWaitForTimeout(3000);
  Apply_CCS_RecSettings(0x2, 0);
  
  write("=== TESTING ===");
  
  write("KEY OFF"); KEY_OFF();
  
  if (WaitFor_RecSta_OWP_Recording(60000) == 1) {
    
    write("OWP recording is started"); @panel::Switch_CGWNM = 1;
    
    testWaitForTimeout(5000); testWaitForTimeout(5000);
    
    
    if (WaitFor_RecSta_PEV_Recording(60) == 1) {
      
      write("PEV recording is started"); 
      
      get_PEVRecorded_change = WaitFor_PEV_Recorded_Value(0x2, 10000);
    get_PEVRecorded_value = $BLTN_CAM_PEV_Recorded;
    if (get_PEVRecorded_value == 0x2) {
        
        write("PEV_Recorded: 0x%X << Test-case is OK >>", get_PEVRecorded_value);
        
        testStepPass("Pass","Test-case is OK");
        passed_tests++;
        
      }
      else {
        
        write("PEV_Recorded: 0x%X << Test-case is NG >>", get_PEVRecorded_value);
        
        snprintf(failReason, elcount(failReason), "Fail reason: Test-case is NG (PEV_Recorded=0x%X). Cause: expected condition was not satisfied.", get_PEVRecorded_value);
        testStepFail("Fail", failReason);
        failed_tests++;
        strncat(failed_test_names, "CCS_008_2 (PEV check), ", elcount(failed_test_names));
      }
    }
    else {
      write("PEV recording hasn't started"); 
      snprintf(failReason, elcount(failReason), "Fail reason: PEV recording hasn\'t started (BLTN_CAM_RecSta_PEV=0x%X). Cause: expected condition was not satisfied.", $BLTN_CAM_RecSta_PEV);
      testStepFail("Fail", failReason);
      failed_tests++;
      strncat(failed_test_names, "CCS_008_2 (PEV timeout), ", elcount(failed_test_names));
    }
  }
  else {
    write("OWP recording hasn't started");
    snprintf(failReason, elcount(failReason), "Fail reason: OWP recording hasn\'t started (BLTN_CAM_RecSta_OWP=0x%X). Cause: expected condition was not satisfied.", $BLTN_CAM_RecSta_OWP);
    testStepFail("Fail", failReason);
    failed_tests++;
    strncat(failed_test_names, "CCS_008_2 (OWP timeout), ", elcount(failed_test_names));
  }
  
  total_tests++;
  
  write("Run CaptureGraphics()"); CaptureGraphics("CSS", "BLTN_CAM_RecSta_OWP;BLTN_CAM_RecSta_PEV;BLTN_CAM_PEV_Recorded;BAlarm_BglrAlrmCurrentSta;SMK_TrmnlCtrlGrpStaBDC");  
  
  Standard_Init();
  
  @panel::Switch_CGWNM = 0;
  
  write("=== FINISH CCS_008_2 ===");

  StopTestTimer();
  Send_Value_To_COM(44);
}

testcase CCS_008_3() {
  Send_Value_To_COM(30803);
  SetTestStep("Buoc 3 - CCS_008");
  StartTestTimer();
  @panel::Switch_CGWNM = 1;
  testStep("Step 3", "Start test-case CCS_008_3");
  write("=== START CCS_008_3 ===");  
  
  
  write("=== SETTING ===");
  
  Set_BglrAlrm(0x7); 
  
  write("KEY ON"); KEY_ON(); testWaitForTimeout(3000);
  Apply_CCS_RecSettings(0x2, 0);
  
  write("=== TESTING ===");
  
  write("KEY OFF"); KEY_OFF();
  
  if (WaitFor_RecSta_OWP_Recording(60000) == 1) {
    
    write("OWP recording is started"); @panel::Switch_CGWNM = 1;
    
    testWaitForTimeout(10000);
    
    
    if (WaitFor_RecSta_PEV_Recording(60) == 1) {
      
      write("PEV recording is started"); 
      
      get_PEVRecorded_change = WaitFor_PEV_Recorded_Value(0x2, 10000);
      
      get_PEVRecorded_value = $BLTN_CAM_PEV_Recorded;
      
      if (get_PEVRecorded_change != 1 && get_PEVRecorded_value == 0x0) {
        
        write("PEV_Recorded: 0x%X << Test-case is OK >>", get_PEVRecorded_value);
        
        testStepPass("Pass","Test-case is OK");
        passed_tests++;
        
      }
      else {
        
        write("PEV_Recorded: 0x%X << Test-case is NG >>", get_PEVRecorded_value);
        
        snprintf(failReason, elcount(failReason), "Fail reason: Test-case is NG (PEV_Recorded=0x%X). Cause: expected condition was not satisfied.", get_PEVRecorded_value);
        testStepFail("Fail", failReason);
        failed_tests++;
        strncat(failed_test_names, "CCS_008_3 (PEV check), ", elcount(failed_test_names));
      }
    }
    else {
      write("PEV recording hasn't started"); 
      snprintf(failReason, elcount(failReason), "Fail reason: PEV recording hasn\'t started (BLTN_CAM_RecSta_PEV=0x%X). Cause: expected condition was not satisfied.", $BLTN_CAM_RecSta_PEV);
      testStepFail("Fail", failReason);
      failed_tests++;
      strncat(failed_test_names, "CCS_008_3 (PEV timeout), ", elcount(failed_test_names));
    }
  }
  else {
    write("OWP recording hasn't started");
    snprintf(failReason, elcount(failReason), "Fail reason: OWP recording hasn\'t started (BLTN_CAM_RecSta_OWP=0x%X). Cause: expected condition was not satisfied.", $BLTN_CAM_RecSta_OWP);
    testStepFail("Fail", failReason);
    failed_tests++;
    strncat(failed_test_names, "CCS_008_3 (OWP timeout), ", elcount(failed_test_names));
  }
  
  total_tests++;
  
  write("Run CaptureGraphics()"); CaptureGraphics("CSS", "BLTN_CAM_RecSta_OWP;BLTN_CAM_RecSta_PEV;BLTN_CAM_PEV_Recorded;BAlarm_BglrAlrmCurrentSta;SMK_TrmnlCtrlGrpStaBDC");  
  
  Standard_Init();
  
  @panel::Switch_CGWNM = 0;
  
  write("=== FINISH CCS_008_3 ===");

  StopTestTimer();
  Send_Value_To_COM(44);
}

testcase CCS_008_4() {
  Send_Value_To_COM(30804);
  SetTestStep("Buoc 4 - CCS_008");
  StartTestTimer();
  @panel::Switch_CGWNM = 1;
  testStep("Step 4", "Start test-case CCS_008_4");
  write("=== START CCS_008_4 ==="); 
  
  
  write("=== SETTING ===");
  
  Set_BglrAlrm(0x7);
  
  write("KEY ON"); KEY_ON(); testWaitForTimeout(3000);
  Apply_CCS_RecSettings(0x2, 0);
  
  write("=== TESTING ===");
  
  write("KEY OFF"); KEY_OFF();
  
  if (WaitFor_RecSta_OWP_Recording(60000) == 1) {
    
    write("OWP recording is started"); @panel::Switch_CGWNM = 1;
    
    testWaitForTimeout(5000); testWaitForTimeout(5000);
    
    
    if (WaitFor_RecSta_PEV_Recording(60) == 1) {
      
      write("PEV recording is started"); 
      
      get_PEVRecorded_change = WaitFor_PEV_Recorded_Value(0x2, 10000);
    get_PEVRecorded_value = $BLTN_CAM_PEV_Recorded;
    if (get_PEVRecorded_value == 0x2) {
        
        write("PEV_Recorded: 0x%X << Test-case is OK >>", get_PEVRecorded_value);
        
        testStepPass("Pass","Test-case is OK");
        passed_tests++;
        
      }
      else {
        
        write("PEV_Recorded: 0x%X << Test-case is NG >>", get_PEVRecorded_value);
        
        snprintf(failReason, elcount(failReason), "Fail reason: Test-case is NG (PEV_Recorded=0x%X). Cause: expected condition was not satisfied.", get_PEVRecorded_value);
        testStepFail("Fail", failReason);
        failed_tests++;
        strncat(failed_test_names, "CCS_008_4 (PEV check), ", elcount(failed_test_names));
      }
    }
    else {
      write("PEV recording hasn't started"); 
      snprintf(failReason, elcount(failReason), "Fail reason: PEV recording hasn\'t started (BLTN_CAM_RecSta_PEV=0x%X). Cause: expected condition was not satisfied.", $BLTN_CAM_RecSta_PEV);
      testStepFail("Fail", failReason);
      failed_tests++;
      strncat(failed_test_names, "CCS_008_4 (PEV timeout), ", elcount(failed_test_names));
    }
  }
  else {
    write("OWP recording hasn't started");
    snprintf(failReason, elcount(failReason), "Fail reason: OWP recording hasn\'t started (BLTN_CAM_RecSta_OWP=0x%X). Cause: expected condition was not satisfied.", $BLTN_CAM_RecSta_OWP);
    testStepFail("Fail", failReason);
    failed_tests++;
    strncat(failed_test_names, "CCS_008_4 (OWP timeout), ", elcount(failed_test_names));
  }  
  
  total_tests++;
  
  write("Run CaptureGraphics()"); CaptureGraphics("CSS", "BLTN_CAM_RecSta_OWP;BLTN_CAM_RecSta_PEV;BLTN_CAM_PEV_Recorded;BAlarm_BglrAlrmCurrentSta;SMK_TrmnlCtrlGrpStaBDC");  
  
  Standard_Init();
  
  @panel::Switch_CGWNM = 0;
  
  write("=== FINISH CCS_008_4 ===");

  StopTestTimer();
  Send_Value_To_COM(44);
}

testcase CCS_008_5() {
  Send_Value_To_COM(30805);
  SetTestStep("Buoc 5 - CCS_008");
  StartTestTimer();
  @panel::Switch_CGWNM = 1;
  testStep("Step 5", "Start test-case CCS_008_5");
  write("=== START CCS_008_5 ===");  
  
  
  write("=== SETTING ===");
  
  Set_BglrAlrm(0x8); 
  
  write("KEY ON"); KEY_ON(); testWaitForTimeout(3000);
  Apply_CCS_RecSettings(0x2, 0);
  
  write("=== TESTING ===");
  
  write("KEY OFF"); KEY_OFF();
  
  if (WaitFor_RecSta_OWP_Recording(60000) == 1) {
    
    write("OWP recording is started"); @panel::Switch_CGWNM = 1;
    
    testWaitForTimeout(10000);
    
    
    if (WaitFor_RecSta_PEV_Recording(60) == 1) {
      
      write("PEV recording is started"); 
      
      get_PEVRecorded_change = WaitFor_PEV_Recorded_Value(0x2, 10000);
      
      get_PEVRecorded_value = $BLTN_CAM_PEV_Recorded;
      
      if (get_PEVRecorded_change != 1 && get_PEVRecorded_value == 0x0) {
        
        write("PEV_Recorded: 0x%X << Test-case is OK >>", get_PEVRecorded_value);
        
        testStepPass("Pass","Test-case is OK");
        passed_tests++;
        
      }
      else {
        
        write("PEV_Recorded: 0x%X << Test-case is NG >>", get_PEVRecorded_value);
        
        snprintf(failReason, elcount(failReason), "Fail reason: Test-case is NG (PEV_Recorded=0x%X). Cause: expected condition was not satisfied.", get_PEVRecorded_value);
        testStepFail("Fail", failReason);
        failed_tests++;
        strncat(failed_test_names, "CCS_008_5 (PEV check), ", elcount(failed_test_names));
      }
    }
    else {
      write("PEV recording hasn't started"); 
      snprintf(failReason, elcount(failReason), "Fail reason: PEV recording hasn\'t started (BLTN_CAM_RecSta_PEV=0x%X). Cause: expected condition was not satisfied.", $BLTN_CAM_RecSta_PEV);
      testStepFail("Fail", failReason);
      failed_tests++;
      strncat(failed_test_names, "CCS_008_5 (PEV timeout), ", elcount(failed_test_names));
    }
  }
  else {
    write("OWP recording hasn't started");
    snprintf(failReason, elcount(failReason), "Fail reason: OWP recording hasn\'t started (BLTN_CAM_RecSta_OWP=0x%X). Cause: expected condition was not satisfied.", $BLTN_CAM_RecSta_OWP);
    testStepFail("Fail", failReason);
    failed_tests++;
    strncat(failed_test_names, "CCS_008_5 (OWP timeout), ", elcount(failed_test_names));
  }
  
  total_tests++;
  
  write("Run CaptureGraphics()"); CaptureGraphics("CSS", "BLTN_CAM_RecSta_OWP;BLTN_CAM_RecSta_PEV;BLTN_CAM_PEV_Recorded;BAlarm_BglrAlrmCurrentSta;SMK_TrmnlCtrlGrpStaBDC");  
  
  Standard_Init();
  
  @panel::Switch_CGWNM = 0;
  
  write("=== FINISH CCS_008_5 ===");

  StopTestTimer();
  Send_Value_To_COM(44);
}

testcase CCS_008_6() {
  Send_Value_To_COM(30806);
  SetTestStep("Buoc 6 - CCS_008");
  StartTestTimer();
  @panel::Switch_CGWNM = 1;
  testStep("Step 6", "Start test-case CCS_008_6");
  write("=== START CCS_008_6 ==="); 
  
  
  write("=== SETTING ===");
  
  Set_BglrAlrm(0x8);
  
  write("KEY ON"); KEY_ON(); testWaitForTimeout(3000);
  Apply_CCS_RecSettings(0x2, 0);
  
  write("=== TESTING ===");
  
  write("KEY OFF"); KEY_OFF();
  
  if (WaitFor_RecSta_OWP_Recording(60000) == 1) {
    
    write("OWP recording is started"); @panel::Switch_CGWNM = 1;
    
    testWaitForTimeout(5000); testWaitForTimeout(5000);
    
    
    if (WaitFor_RecSta_PEV_Recording(60) == 1) {
      
      write("PEV recording is started"); 
      
      get_PEVRecorded_change = WaitFor_PEV_Recorded_Value(0x2, 10000);
    get_PEVRecorded_value = $BLTN_CAM_PEV_Recorded;
    if (get_PEVRecorded_value == 0x2) {
        
        write("PEV_Recorded: 0x%X << Test-case is OK >>", get_PEVRecorded_value);
        
        testStepPass("Pass","Test-case is OK");
        passed_tests++;
        
      }
      else {
        
        write("PEV_Recorded: 0x%X << Test-case is NG >>", get_PEVRecorded_value);
        
        snprintf(failReason, elcount(failReason), "Fail reason: Test-case is NG (PEV_Recorded=0x%X). Cause: expected condition was not satisfied.", get_PEVRecorded_value);
        testStepFail("Fail", failReason);
        failed_tests++;
        strncat(failed_test_names, "CCS_008_6 (PEV check), ", elcount(failed_test_names));
      }
    }
    else {
      write("PEV recording hasn't started"); 
      snprintf(failReason, elcount(failReason), "Fail reason: PEV recording hasn\'t started (BLTN_CAM_RecSta_PEV=0x%X). Cause: expected condition was not satisfied.", $BLTN_CAM_RecSta_PEV);
      testStepFail("Fail", failReason);
      failed_tests++;
      strncat(failed_test_names, "CCS_008_6 (PEV timeout), ", elcount(failed_test_names));
    }
  }
  else {
    write("OWP recording hasn't started");
    snprintf(failReason, elcount(failReason), "Fail reason: OWP recording hasn\'t started (BLTN_CAM_RecSta_OWP=0x%X). Cause: expected condition was not satisfied.", $BLTN_CAM_RecSta_OWP);
    testStepFail("Fail", failReason);
    failed_tests++;
    strncat(failed_test_names, "CCS_008_6 (OWP timeout), ", elcount(failed_test_names));
  }  
  
  total_tests++;
  
  write("Run CaptureGraphics()"); CaptureGraphics("CSS", "BLTN_CAM_RecSta_OWP;BLTN_CAM_RecSta_PEV;BLTN_CAM_PEV_Recorded;BAlarm_BglrAlrmCurrentSta;SMK_TrmnlCtrlGrpStaBDC");  
  
  Standard_Init();
  
  @panel::Switch_CGWNM = 0;
  
  write("=== FINISH CCS_008_6 ===");

  StopTestTimer();
  Send_Value_To_COM(44);
}

testcase CCS_008_7() {
  Send_Value_To_COM(30807);
  SetTestStep("Buoc 7 - CCS_008");
  StartTestTimer();
  @panel::Switch_CGWNM = 1;
  testStep("Step 7", "Start test-case CCS_008_7");
  write("=== START CCS_008_7 ===");  
  
  
  write("=== SETTING ===");
  Set_BglrAlrm(0x1); 
  testWaitForTimeout(2000);
  Set_BglrAlrm(0xA); 
  write("KEY ON"); KEY_ON(); testWaitForTimeout(3000);
  Apply_CCS_RecSettings(0x2, 0);
  
  write("=== TESTING ===");
  
  write("KEY OFF"); KEY_OFF();
  
  if (WaitFor_RecSta_OWP_Recording(60000) == 1) {
    
    write("OWP recording is started"); @panel::Switch_CGWNM = 1;
    
    testWaitForTimeout(10000);
    
    
    if (WaitFor_RecSta_PEV_Recording(60) == 1) {
      
      write("PEV recording is started"); 
      
      get_PEVRecorded_change = WaitFor_PEV_Recorded_Value(0x2, 10000);
      
      get_PEVRecorded_value = $BLTN_CAM_PEV_Recorded;
      
      if (get_PEVRecorded_change != 1 && get_PEVRecorded_value == 0x0) {
        
        write("PEV_Recorded: 0x%X << Test-case is OK >>", get_PEVRecorded_value);
        
        testStepPass("Pass","Test-case is OK");
        passed_tests++;
        
      }
      else {
        
        write("PEV_Recorded: 0x%X << Test-case is NG >>", get_PEVRecorded_value);
        
        snprintf(failReason, elcount(failReason), "Fail reason: Test-case is NG (PEV_Recorded=0x%X). Cause: expected condition was not satisfied.", get_PEVRecorded_value);
        testStepFail("Fail", failReason);
        failed_tests++;
        strncat(failed_test_names, "CCS_008_7 (PEV check), ", elcount(failed_test_names));
      }
    }
    else {
      write("PEV recording hasn't started"); 
      snprintf(failReason, elcount(failReason), "Fail reason: PEV recording hasn\'t started (BLTN_CAM_RecSta_PEV=0x%X). Cause: expected condition was not satisfied.", $BLTN_CAM_RecSta_PEV);
      testStepFail("Fail", failReason);
      failed_tests++;
      strncat(failed_test_names, "CCS_008_7 (PEV timeout), ", elcount(failed_test_names));
    }
  }
  else {
    write("OWP recording hasn't started");
    snprintf(failReason, elcount(failReason), "Fail reason: OWP recording hasn\'t started (BLTN_CAM_RecSta_OWP=0x%X). Cause: expected condition was not satisfied.", $BLTN_CAM_RecSta_OWP);
    testStepFail("Fail", failReason);
    failed_tests++;
    strncat(failed_test_names, "CCS_008_7 (OWP timeout), ", elcount(failed_test_names));
  }  
  
  total_tests++;
  
  write("Run CaptureGraphics()"); CaptureGraphics("CSS", "BLTN_CAM_RecSta_OWP;BLTN_CAM_RecSta_PEV;BLTN_CAM_PEV_Recorded;BAlarm_BglrAlrmCurrentSta;SMK_TrmnlCtrlGrpStaBDC");  
  
  Standard_Init();
  
  @panel::Switch_CGWNM = 0;
  
  write("=== FINISH CCS_008_7 ===");

  StopTestTimer();
  Send_Value_To_COM(44);
}

testcase CCS_008_8() {
  Send_Value_To_COM(30808);
  SetTestStep("Buoc 8 - CCS_008");
  StartTestTimer();
  @panel::Switch_CGWNM = 1;
  testStep("Step 8", "Start test-case CCS_008_8");
  write("=== START CCS_008_8 ==="); 
  
  
  write("=== SETTING ===");
  
  Set_BglrAlrm(0xA); 
  write("KEY ON"); KEY_ON(); testWaitForTimeout(3000);
  Apply_CCS_RecSettings(0x2, 0);
  
  write("=== TESTING ===");
  
  write("KEY OFF"); KEY_OFF();
  
  if (WaitFor_RecSta_OWP_Recording(60000) == 1) {
    
    write("OWP recording is started"); @panel::Switch_CGWNM = 1;
    
    testWaitForTimeout(5000); testWaitForTimeout(5000);
    
    
    if (WaitFor_RecSta_PEV_Recording(60) == 1) {
      
      write("PEV recording is started"); 
      
      get_PEVRecorded_change = WaitFor_PEV_Recorded_Value(0x2, 10000);
    get_PEVRecorded_value = $BLTN_CAM_PEV_Recorded;
    if (get_PEVRecorded_value == 0x2) {
        
        write("PEV_Recorded: 0x%X << Test-case is OK >>", get_PEVRecorded_value);
        
        testStepPass("Pass","Test-case is OK");
        passed_tests++;
        
      }
      else {
        
        write("PEV_Recorded: 0x%X << Test-case is NG >>", get_PEVRecorded_value);
        
        snprintf(failReason, elcount(failReason), "Fail reason: Test-case is NG (PEV_Recorded=0x%X). Cause: expected condition was not satisfied.", get_PEVRecorded_value);
        testStepFail("Fail", failReason);
        failed_tests++;
        strncat(failed_test_names, "CCS_008_8 (PEV check), ", elcount(failed_test_names));
      }
    }
    else {
      write("PEV recording hasn't started"); 
      snprintf(failReason, elcount(failReason), "Fail reason: PEV recording hasn\'t started (BLTN_CAM_RecSta_PEV=0x%X). Cause: expected condition was not satisfied.", $BLTN_CAM_RecSta_PEV);
      testStepFail("Fail", failReason);
      failed_tests++;
      strncat(failed_test_names, "CCS_008_8 (PEV timeout), ", elcount(failed_test_names));
    }
  }
  else {
    write("OWP recording hasn't started");
    snprintf(failReason, elcount(failReason), "Fail reason: OWP recording hasn\'t started (BLTN_CAM_RecSta_OWP=0x%X). Cause: expected condition was not satisfied.", $BLTN_CAM_RecSta_OWP);
    testStepFail("Fail", failReason);
    failed_tests++;
    strncat(failed_test_names, "CCS_008_8 (OWP timeout), ", elcount(failed_test_names));
  }
  
  total_tests++;
  
  write("Run CaptureGraphics()"); CaptureGraphics("CSS", "BLTN_CAM_RecSta_OWP;BLTN_CAM_RecSta_PEV;BLTN_CAM_PEV_Recorded;BAlarm_BglrAlrmCurrentSta;SMK_TrmnlCtrlGrpStaBDC");  
  
  Standard_Init();
  
  @panel::Switch_CGWNM = 0;
  
  write("=== FINISH CCS_008_8 ===");

  StopTestTimer();
  Send_Value_To_COM(44);
}

testcase CCS_008_9() {
  Send_Value_To_COM(30809);
  SetTestStep("Buoc 9 - CCS_008");
  StartTestTimer();
  @panel::Switch_CGWNM = 1;
  testStep("Step 9", "Start test-case CCS_008_9");
  write("=== START CCS_008_9 ===");  
  
  
  write("=== SETTING ===");
  
  Set_BglrAlrm(0xB); 
  
  write("KEY ON"); KEY_ON(); testWaitForTimeout(3000);
  Apply_CCS_RecSettings(0x2, 0);
  
  write("=== TESTING ===");
  
  write("KEY OFF"); KEY_OFF();
  
  if (WaitFor_RecSta_OWP_Recording(60000) == 1) {
    
    write("OWP recording is started"); @panel::Switch_CGWNM = 1;
    
    testWaitForTimeout(10000);
    
    
    if (WaitFor_RecSta_PEV_Recording(60) == 1) {
      
      write("PEV recording is started"); 
      
      get_PEVRecorded_change = WaitFor_PEV_Recorded_Value(0x2, 10000);
      
      get_PEVRecorded_value = $BLTN_CAM_PEV_Recorded;
      
      if (get_PEVRecorded_change != 1 && get_PEVRecorded_value == 0x0) {
        
        write("PEV_Recorded: 0x%X << Test-case is OK >>", get_PEVRecorded_value);
        
        testStepPass("Pass","Test-case is OK");
        passed_tests++;
        
      }
      else {
        
        write("PEV_Recorded: 0x%X << Test-case is NG >>", get_PEVRecorded_value);
        
        snprintf(failReason, elcount(failReason), "Fail reason: Test-case is NG (PEV_Recorded=0x%X). Cause: expected condition was not satisfied.", get_PEVRecorded_value);
        testStepFail("Fail", failReason);
        failed_tests++;
        strncat(failed_test_names, "CCS_008_9 (PEV check), ", elcount(failed_test_names));
      }
    }
    else {
      write("PEV recording hasn't started"); 
      snprintf(failReason, elcount(failReason), "Fail reason: PEV recording hasn\'t started (BLTN_CAM_RecSta_PEV=0x%X). Cause: expected condition was not satisfied.", $BLTN_CAM_RecSta_PEV);
      testStepFail("Fail", failReason);
      failed_tests++;
      strncat(failed_test_names, "CCS_008_9 (PEV timeout), ", elcount(failed_test_names));
    }
  }
  else {
    write("OWP recording hasn't started");
    snprintf(failReason, elcount(failReason), "Fail reason: OWP recording hasn\'t started (BLTN_CAM_RecSta_OWP=0x%X). Cause: expected condition was not satisfied.", $BLTN_CAM_RecSta_OWP);
    testStepFail("Fail", failReason);
    failed_tests++;
    strncat(failed_test_names, "CCS_008_9 (OWP timeout), ", elcount(failed_test_names));
  }  
  
  total_tests++;
  
  write("Run CaptureGraphics()"); CaptureGraphics("CSS", "BLTN_CAM_RecSta_OWP;BLTN_CAM_RecSta_PEV;BLTN_CAM_PEV_Recorded;BAlarm_BglrAlrmCurrentSta;SMK_TrmnlCtrlGrpStaBDC");  
  
  Standard_Init();
  
  @panel::Switch_CGWNM = 0;
  
  write("=== FINISH CCS_008_9 ===");

  StopTestTimer();
  Send_Value_To_COM(44);
}

testcase CCS_008_10() {
  Send_Value_To_COM(30810);
  SetTestStep("Buoc 10 - CCS_008");
  StartTestTimer();
  @panel::Switch_CGWNM = 1;
  testStep("Step 10", "Start test-case CCS_008_10");
  write("=== START CCS_008_10 ==="); 
  
  
  write("=== SETTING ===");
  
  Set_BglrAlrm(0xB);
  
  write("KEY ON"); KEY_ON(); testWaitForTimeout(3000);
  Apply_CCS_RecSettings(0x2, 0);
  
  write("=== TESTING ===");
  
  write("KEY OFF"); KEY_OFF();
  
  if (WaitFor_RecSta_OWP_Recording(60000) == 1) {
    
    write("OWP recording is started"); @panel::Switch_CGWNM = 1;
    
    testWaitForTimeout(5000); testWaitForTimeout(5000);
    
    
    if (WaitFor_RecSta_PEV_Recording(60) == 1) {
      
      write("PEV recording is started"); 
      
      get_PEVRecorded_change = WaitFor_PEV_Recorded_Value(0x2, 10000);
    get_PEVRecorded_value = $BLTN_CAM_PEV_Recorded;
    if (get_PEVRecorded_value == 0x2) {
        
        write("PEV_Recorded: 0x%X << Test-case is OK >>", get_PEVRecorded_value);
        
        testStepPass("Pass","Test-case is OK");
        passed_tests++;
        
      }
      else {
        
        write("PEV_Recorded: 0x%X << Test-case is NG >>", get_PEVRecorded_value);
        
        snprintf(failReason, elcount(failReason), "Fail reason: Test-case is NG (PEV_Recorded=0x%X). Cause: expected condition was not satisfied.", get_PEVRecorded_value);
        testStepFail("Fail", failReason);
        failed_tests++;
        strncat(failed_test_names, "CCS_008_10 (PEV check), ", elcount(failed_test_names));
      }
    }
    else {
      write("PEV recording hasn't started"); 
      snprintf(failReason, elcount(failReason), "Fail reason: PEV recording hasn\'t started (BLTN_CAM_RecSta_PEV=0x%X). Cause: expected condition was not satisfied.", $BLTN_CAM_RecSta_PEV);
      testStepFail("Fail", failReason);
      failed_tests++;
      strncat(failed_test_names, "CCS_008_10 (PEV timeout), ", elcount(failed_test_names));
    }
  }
  else {
    write("OWP recording hasn't started");
    snprintf(failReason, elcount(failReason), "Fail reason: OWP recording hasn\'t started (BLTN_CAM_RecSta_OWP=0x%X). Cause: expected condition was not satisfied.", $BLTN_CAM_RecSta_OWP);
    testStepFail("Fail", failReason);
    failed_tests++;
    strncat(failed_test_names, "CCS_008_10 (OWP timeout), ", elcount(failed_test_names));
  }
  
  total_tests++;
  
  write("Run CaptureGraphics()"); CaptureGraphics("CSS", "BLTN_CAM_RecSta_OWP;BLTN_CAM_RecSta_PEV;BLTN_CAM_PEV_Recorded;BAlarm_BglrAlrmCurrentSta;SMK_TrmnlCtrlGrpStaBDC");  
  
  Standard_Init();
  
  @panel::Switch_CGWNM = 0;
  
  write("=== FINISH CCS_008_10 ===");

  StopTestTimer();
  Send_Value_To_COM(44);
}

testcase CCS_008_11() {
  Send_Value_To_COM(30811);
  SetTestStep("Buoc 11 - CCS_008");
  StartTestTimer();
  @panel::Switch_CGWNM = 1;
  testStep("Step 11", "Start test-case CCS_008_11");
  write("=== START CCS_008_11 ===");  
  
  
  write("=== SETTING ===");
  Set_BglrAlrm(0x1); 
  testWaitForTimeout(2000);
  Set_BglrAlrm(0xC); 
  write("KEY ON"); KEY_ON(); testWaitForTimeout(3000);
  Apply_CCS_RecSettings(0x2, 0);
  
  write("=== TESTING ===");
  
  write("KEY OFF"); KEY_OFF();
  
  if (WaitFor_RecSta_OWP_Recording(60000) == 1) {
    
    write("OWP recording is started"); @panel::Switch_CGWNM = 1;
    
    testWaitForTimeout(10000);
    
    
    if (WaitFor_RecSta_PEV_Recording(60) == 1) {
      
      write("PEV recording is started"); 
      
      get_PEVRecorded_change = WaitFor_PEV_Recorded_Value(0x2, 10000);
      
      get_PEVRecorded_value = $BLTN_CAM_PEV_Recorded;
      
      if (get_PEVRecorded_change != 1 && get_PEVRecorded_value == 0x0) {
        
        write("PEV_Recorded: 0x%X << Test-case is OK >>", get_PEVRecorded_value);
        
        testStepPass("Pass","Test-case is OK");
        passed_tests++;
        
      }
      else {
        
        write("PEV_Recorded: 0x%X << Test-case is NG >>", get_PEVRecorded_value);
        
        snprintf(failReason, elcount(failReason), "Fail reason: Test-case is NG (PEV_Recorded=0x%X). Cause: expected condition was not satisfied.", get_PEVRecorded_value);
        testStepFail("Fail", failReason);
        failed_tests++;
        strncat(failed_test_names, "CCS_008_11 (PEV check), ", elcount(failed_test_names));
      }
    }
    else {
      write("PEV recording hasn't started"); 
      snprintf(failReason, elcount(failReason), "Fail reason: PEV recording hasn\'t started (BLTN_CAM_RecSta_PEV=0x%X). Cause: expected condition was not satisfied.", $BLTN_CAM_RecSta_PEV);
      testStepFail("Fail", failReason);
      failed_tests++;
      strncat(failed_test_names, "CCS_008_11 (PEV timeout), ", elcount(failed_test_names));
    }
  }
  else {
    write("OWP recording hasn't started");
    snprintf(failReason, elcount(failReason), "Fail reason: OWP recording hasn\'t started (BLTN_CAM_RecSta_OWP=0x%X). Cause: expected condition was not satisfied.", $BLTN_CAM_RecSta_OWP);
    testStepFail("Fail", failReason);
    failed_tests++;
    strncat(failed_test_names, "CCS_008_11 (OWP timeout), ", elcount(failed_test_names));
  }
  
  total_tests++;
  
  write("Run CaptureGraphics()"); CaptureGraphics("CSS", "BLTN_CAM_RecSta_OWP;BLTN_CAM_RecSta_PEV;BLTN_CAM_PEV_Recorded;BAlarm_BglrAlrmCurrentSta;SMK_TrmnlCtrlGrpStaBDC");  
  
  Standard_Init();
  
  @panel::Switch_CGWNM = 0;
  
  write("=== FINISH CCS_008_11 ===");

  StopTestTimer();
  Send_Value_To_COM(44);
}

testcase CCS_008_12() {
  Send_Value_To_COM(30812);
  SetTestStep("Buoc 12 - CCS_008");
  StartTestTimer();
  @panel::Switch_CGWNM = 1;
  testStep("Step 12", "Start test-case CCS_008_12");
  write("=== START CCS_008_12 ==="); 
  
  
  write("=== SETTING ===");
  
  Set_BglrAlrm(0xC); 
  write("KEY ON"); KEY_ON(); testWaitForTimeout(3000);
  Apply_CCS_RecSettings(0x2, 0);
  
  write("=== TESTING ===");
  
  write("KEY OFF"); KEY_OFF();
  
  if (WaitFor_RecSta_OWP_Recording(60000) == 1) {
    
    write("OWP recording is started"); @panel::Switch_CGWNM = 1;
    
    testWaitForTimeout(5000); testWaitForTimeout(5000);
    
    
    if (WaitFor_RecSta_PEV_Recording(60) == 1) {
      
      write("PEV recording is started"); 
      
      get_PEVRecorded_change = WaitFor_PEV_Recorded_Value(0x2, 10000);
    get_PEVRecorded_value = $BLTN_CAM_PEV_Recorded;
    if (get_PEVRecorded_value == 0x2) {
        
        write("PEV_Recorded: 0x%X << Test-case is OK >>", get_PEVRecorded_value);
        
        testStepPass("Pass","Test-case is OK");
        passed_tests++;
        
      }
      else {
        
        write("PEV_Recorded: 0x%X << Test-case is NG >>", get_PEVRecorded_value);
        
        snprintf(failReason, elcount(failReason), "Fail reason: Test-case is NG (PEV_Recorded=0x%X). Cause: expected condition was not satisfied.", get_PEVRecorded_value);
        testStepFail("Fail", failReason);
        failed_tests++;
        strncat(failed_test_names, "CCS_008_12 (PEV check), ", elcount(failed_test_names));
      }
    }
    else {
      write("PEV recording hasn't started"); 
      snprintf(failReason, elcount(failReason), "Fail reason: PEV recording hasn\'t started (BLTN_CAM_RecSta_PEV=0x%X). Cause: expected condition was not satisfied.", $BLTN_CAM_RecSta_PEV);
      testStepFail("Fail", failReason);
      failed_tests++;
      strncat(failed_test_names, "CCS_008_12 (PEV timeout), ", elcount(failed_test_names));
    }
  }
  else {
    write("OWP recording hasn't started");
    snprintf(failReason, elcount(failReason), "Fail reason: OWP recording hasn\'t started (BLTN_CAM_RecSta_OWP=0x%X). Cause: expected condition was not satisfied.", $BLTN_CAM_RecSta_OWP);
    testStepFail("Fail", failReason);
    failed_tests++;
    strncat(failed_test_names, "CCS_008_12 (OWP timeout), ", elcount(failed_test_names));
  }
  
  total_tests++;
  
  write("Run CaptureGraphics()"); CaptureGraphics("CSS", "BLTN_CAM_RecSta_OWP;BLTN_CAM_RecSta_PEV;BLTN_CAM_PEV_Recorded;BAlarm_BglrAlrmCurrentSta;SMK_TrmnlCtrlGrpStaBDC");  
  
  Standard_Init();
  
  @panel::Switch_CGWNM = 0;
  
  write("=== FINISH CCS_008_12 ===");

  StopTestTimer();
  Send_Value_To_COM(44);
}

testcase CCS_008_13() {
  Send_Value_To_COM(30813);
  SetTestStep("Buoc 13 - CCS_008");
  StartTestTimer();
  @panel::Switch_CGWNM = 1;
  testStep("Step 13", "Start test-case CCS_008_13");
  write("=== START CCS_008_13 ===");  
  
  
  write("=== SETTING ===");
  Set_BglrAlrm(0x1); 
  testWaitForTimeout(2000);
  Set_BglrAlrm(0xD); 
  write("KEY ON"); KEY_ON(); testWaitForTimeout(3000);
  Apply_CCS_RecSettings(0x2, 0);
  
  write("=== TESTING ===");
  
  write("KEY OFF"); KEY_OFF();
  
  if (WaitFor_RecSta_OWP_Recording(60000) == 1) {
    
    write("OWP recording is started"); @panel::Switch_CGWNM = 1;
    
    testWaitForTimeout(10000);
    
    
    if (WaitFor_RecSta_PEV_Recording(60) == 1) {
      
      write("PEV recording is started"); 
      
      get_PEVRecorded_change = WaitFor_PEV_Recorded_Value(0x2, 10000);
      
      get_PEVRecorded_value = $BLTN_CAM_PEV_Recorded;
      
      if (get_PEVRecorded_change != 1 && get_PEVRecorded_value == 0x0) {
        
        write("PEV_Recorded: 0x%X << Test-case is OK >>", get_PEVRecorded_value);
        
        testStepPass("Pass","Test-case is OK");
        passed_tests++;
        
      }
      else {
        
        write("PEV_Recorded: 0x%X << Test-case is NG >>", get_PEVRecorded_value);
        
        snprintf(failReason, elcount(failReason), "Fail reason: Test-case is NG (PEV_Recorded=0x%X). Cause: expected condition was not satisfied.", get_PEVRecorded_value);
        testStepFail("Fail", failReason);
        failed_tests++;
        strncat(failed_test_names, "CCS_008_13 (PEV check), ", elcount(failed_test_names));
      }
    }
    else {
      write("PEV recording hasn't started"); 
      snprintf(failReason, elcount(failReason), "Fail reason: PEV recording hasn\'t started (BLTN_CAM_RecSta_PEV=0x%X). Cause: expected condition was not satisfied.", $BLTN_CAM_RecSta_PEV);
      testStepFail("Fail", failReason);
      failed_tests++;
      strncat(failed_test_names, "CCS_008_13 (PEV timeout), ", elcount(failed_test_names));
    }
  }
  else {
    write("OWP recording hasn't started");
    snprintf(failReason, elcount(failReason), "Fail reason: OWP recording hasn\'t started (BLTN_CAM_RecSta_OWP=0x%X). Cause: expected condition was not satisfied.", $BLTN_CAM_RecSta_OWP);
    testStepFail("Fail", failReason);
    failed_tests++;
    strncat(failed_test_names, "CCS_008_13 (OWP timeout), ", elcount(failed_test_names));
  }
  
  total_tests++;
  
  write("Run CaptureGraphics()"); CaptureGraphics("CSS", "BLTN_CAM_RecSta_OWP;BLTN_CAM_RecSta_PEV;BLTN_CAM_PEV_Recorded;BAlarm_BglrAlrmCurrentSta;SMK_TrmnlCtrlGrpStaBDC");  
  
  Standard_Init();
  
  @panel::Switch_CGWNM = 0;
  
  write("=== FINISH CCS_008_13 ===");

  StopTestTimer();
  Send_Value_To_COM(44);
}

testcase CCS_008_14() {
  Send_Value_To_COM(30814);
  SetTestStep("Buoc 14 - CCS_008");
  StartTestTimer();
  @panel::Switch_CGWNM = 1;
  testStep("Step 14", "Start test-case CCS_008_14");
  write("=== START CCS_008_14 ==="); 
  
  
  write("=== SETTING ===");
  
  Set_BglrAlrm(0xD); 
  write("KEY ON"); KEY_ON(); testWaitForTimeout(3000);
  Apply_CCS_RecSettings(0x2, 0);
  
  write("=== TESTING ===");
  
  write("KEY OFF"); KEY_OFF();
  
  if (WaitFor_RecSta_OWP_Recording(60000) == 1) {
    
    write("OWP recording is started"); @panel::Switch_CGWNM = 1;
    
    testWaitForTimeout(5000); testWaitForTimeout(5000);
    
    
    if (WaitFor_RecSta_PEV_Recording(60) == 1) {
      
      write("PEV recording is started"); 
      
      get_PEVRecorded_change = WaitFor_PEV_Recorded_Value(0x2, 10000);
    get_PEVRecorded_value = $BLTN_CAM_PEV_Recorded;
    if (get_PEVRecorded_value == 0x2) {
        
        write("PEV_Recorded: 0x%X << Test-case is OK >>", get_PEVRecorded_value);
        
        testStepPass("Pass","Test-case is OK");
        passed_tests++;
        
      }
      else {
        
        write("PEV_Recorded: 0x%X << Test-case is NG >>", get_PEVRecorded_value);
        
        snprintf(failReason, elcount(failReason), "Fail reason: Test-case is NG (PEV_Recorded=0x%X). Cause: expected condition was not satisfied.", get_PEVRecorded_value);
        testStepFail("Fail", failReason);
        failed_tests++;
        strncat(failed_test_names, "CCS_008_14 (PEV check), ", elcount(failed_test_names));
      }
    }
    else {
      write("PEV recording hasn't started"); 
      snprintf(failReason, elcount(failReason), "Fail reason: PEV recording hasn\'t started (BLTN_CAM_RecSta_PEV=0x%X). Cause: expected condition was not satisfied.", $BLTN_CAM_RecSta_PEV);
      testStepFail("Fail", failReason);
      failed_tests++;
      strncat(failed_test_names, "CCS_008_14 (PEV timeout), ", elcount(failed_test_names));
    }
  }
  else {
    write("OWP recording hasn't started");
    snprintf(failReason, elcount(failReason), "Fail reason: OWP recording hasn\'t started (BLTN_CAM_RecSta_OWP=0x%X). Cause: expected condition was not satisfied.", $BLTN_CAM_RecSta_OWP);
    testStepFail("Fail", failReason);
    failed_tests++;
    strncat(failed_test_names, "CCS_008_14 (OWP timeout), ", elcount(failed_test_names));
  }
  
  total_tests++;
  
  write("Run CaptureGraphics()"); CaptureGraphics("CSS", "BLTN_CAM_RecSta_OWP;BLTN_CAM_RecSta_PEV;BLTN_CAM_PEV_Recorded;BAlarm_BglrAlrmCurrentSta;SMK_TrmnlCtrlGrpStaBDC");  
  
  Standard_Init();
  
  @panel::Switch_CGWNM = 0;
  
  write("=== FINISH CCS_008_14 ===");

  StopTestTimer();
  Send_Value_To_COM(44);
}

testcase CCS_008_15() {
  Send_Value_To_COM(30815);
  SetTestStep("Buoc 15 - CCS_008");
  StartTestTimer();
  @panel::Switch_CGWNM = 1;
  testStep("Step 15", "Start test-case CCS_008_15");
  write("=== START CCS_008_15 ===");  
  
  
  write("=== SETTING ===");
  Set_BglrAlrm(0x1); 
  testWaitForTimeout(2000);
  Set_BglrAlrm(0xE); 
  write("KEY ON"); KEY_ON(); testWaitForTimeout(3000);
  Apply_CCS_RecSettings(0x2, 0);
  
  write("=== TESTING ===");
  
  write("KEY OFF"); KEY_OFF();
  
  if (WaitFor_RecSta_OWP_Recording(60000) == 1) {
    
    write("OWP recording is started"); @panel::Switch_CGWNM = 1;
    
    testWaitForTimeout(10000);
    
    
    if (WaitFor_RecSta_PEV_Recording(60) == 1) {
      
      write("PEV recording is started"); 
      
      get_PEVRecorded_change = WaitFor_PEV_Recorded_Value(0x2, 10000);
      
      get_PEVRecorded_value = $BLTN_CAM_PEV_Recorded;
      
      if (get_PEVRecorded_change != 1 && get_PEVRecorded_value == 0x0) {
        
        write("PEV_Recorded: 0x%X << Test-case is OK >>", get_PEVRecorded_value);
        
        testStepPass("Pass","Test-case is OK");
        passed_tests++;
        
      }
      else {
        
        write("PEV_Recorded: 0x%X << Test-case is NG >>", get_PEVRecorded_value);
        
        snprintf(failReason, elcount(failReason), "Fail reason: Test-case is NG (PEV_Recorded=0x%X). Cause: expected condition was not satisfied.", get_PEVRecorded_value);
        testStepFail("Fail", failReason);
        failed_tests++;
        strncat(failed_test_names, "CCS_008_15 (PEV check), ", elcount(failed_test_names));
      }
    }
    else {
      write("PEV recording hasn't started"); 
      snprintf(failReason, elcount(failReason), "Fail reason: PEV recording hasn\'t started (BLTN_CAM_RecSta_PEV=0x%X). Cause: expected condition was not satisfied.", $BLTN_CAM_RecSta_PEV);
      testStepFail("Fail", failReason);
      failed_tests++;
      strncat(failed_test_names, "CCS_008_15 (PEV timeout), ", elcount(failed_test_names));
    }
  }
  else {
    write("OWP recording hasn't started");
    snprintf(failReason, elcount(failReason), "Fail reason: OWP recording hasn\'t started (BLTN_CAM_RecSta_OWP=0x%X). Cause: expected condition was not satisfied.", $BLTN_CAM_RecSta_OWP);
    testStepFail("Fail", failReason);
    failed_tests++;
    strncat(failed_test_names, "CCS_008_15 (OWP timeout), ", elcount(failed_test_names));
  }
  
  total_tests++;
  
  write("Run CaptureGraphics()"); CaptureGraphics("CSS", "BLTN_CAM_RecSta_OWP;BLTN_CAM_RecSta_PEV;BLTN_CAM_PEV_Recorded;BAlarm_BglrAlrmCurrentSta;SMK_TrmnlCtrlGrpStaBDC");  
  
  Standard_Init();
  
  @panel::Switch_CGWNM = 0;
  
  write("=== FINISH CCS_008_15 ===");

  StopTestTimer();
  Send_Value_To_COM(44);
}

testcase CCS_008_16() {
  Send_Value_To_COM(30816);
  SetTestStep("Buoc 16 - CCS_008");
  StartTestTimer();
  @panel::Switch_CGWNM = 1;
  testStep("Step 16", "Start test-case CCS_008_16");
  write("=== START CCS_008_16 ==="); 
  
  
  write("=== SETTING ===");
  
  Set_BglrAlrm(0xE); 
  write("KEY ON"); KEY_ON(); testWaitForTimeout(3000);
  Apply_CCS_RecSettings(0x2, 0);
  
  write("=== TESTING ===");
  
  write("KEY OFF"); KEY_OFF();
  
  if (WaitFor_RecSta_OWP_Recording(60000) == 1) {
    
    write("OWP recording is started"); @panel::Switch_CGWNM = 1;
    
    testWaitForTimeout(5000); testWaitForTimeout(5000);
    
    
    if (WaitFor_RecSta_PEV_Recording(60) == 1) {
      
      write("PEV recording is started"); 
      
      get_PEVRecorded_change = WaitFor_PEV_Recorded_Value(0x2, 10000);
    get_PEVRecorded_value = $BLTN_CAM_PEV_Recorded;
    if (get_PEVRecorded_value == 0x2) {
        
        write("PEV_Recorded: 0x%X << Test-case is OK >>", get_PEVRecorded_value);
        
        testStepPass("Pass","Test-case is OK");
        passed_tests++;
        
      }
      else {
        
        write("PEV_Recorded: 0x%X << Test-case is NG >>", get_PEVRecorded_value);
        
        snprintf(failReason, elcount(failReason), "Fail reason: Test-case is NG (PEV_Recorded=0x%X). Cause: expected condition was not satisfied.", get_PEVRecorded_value);
        testStepFail("Fail", failReason);
        failed_tests++;
        strncat(failed_test_names, "CCS_008_16 (PEV check), ", elcount(failed_test_names));
      }
    }
    else {
      write("PEV recording hasn't started"); 
      snprintf(failReason, elcount(failReason), "Fail reason: PEV recording hasn\'t started (BLTN_CAM_RecSta_PEV=0x%X). Cause: expected condition was not satisfied.", $BLTN_CAM_RecSta_PEV);
      testStepFail("Fail", failReason);
      failed_tests++;
      strncat(failed_test_names, "CCS_008_16 (PEV timeout), ", elcount(failed_test_names));
    }
  }
  else {
    write("OWP recording hasn't started");
    snprintf(failReason, elcount(failReason), "Fail reason: OWP recording hasn\'t started (BLTN_CAM_RecSta_OWP=0x%X). Cause: expected condition was not satisfied.", $BLTN_CAM_RecSta_OWP);
    testStepFail("Fail", failReason);
    failed_tests++;
    strncat(failed_test_names, "CCS_008_16 (OWP timeout), ", elcount(failed_test_names));
  }
  
  total_tests++;
  
  write("Run CaptureGraphics()"); CaptureGraphics("CSS", "BLTN_CAM_RecSta_OWP;BLTN_CAM_RecSta_PEV;BLTN_CAM_PEV_Recorded;BAlarm_BglrAlrmCurrentSta;SMK_TrmnlCtrlGrpStaBDC");  
  
  Standard_Init();
  
  @panel::Switch_CGWNM = 0;
  
  write("=== FINISH CCS_008_16 ===");

  StopTestTimer();
  Send_Value_To_COM(44);
}


void MainTest() {

  testReportFileName("TestReports\\CCS_008 - 2.5 generation_report");

  Set_SMK_IGN();
  Click_USM_Reset();
  Click_Rec_Reset();


  CCS_008_1();
  CCS_008_2();
  CCS_008_3();
  CCS_008_4();
  CCS_008_5();
  CCS_008_6();
  CCS_008_7();
  CCS_008_8();
  CCS_008_9();
  CCS_008_10();
  CCS_008_11();
  CCS_008_12();
  CCS_008_13();
  CCS_008_14();
  CCS_008_15();
  CCS_008_16();

}






