/*@!Encoding:65001*/
includes
{
}

variables
{
  // Message: HU_BLTN_CAM_01_00ms (ID: 126 / 0x7E)
  // Sender: CGW_CCU -> Receiver: BLTN_CAM_FD
  message HU_BLTN_CAM_01_00ms msg_HU_BLTN_CAM;
  
  const long TIME_WAIT = 5000; // 5 seconds between each value
}

/*
 * Test case to set signals in HU_BLTN_CAM_01_00ms message
 * Signal 1: BLTN_CAM_AppNoti_PEV_NvalueSet (Parked Event notification - On/Off)
 *           Values: 0=Default, 1=Off, 2=On, 3=Invalid
 * Signal 2: BLTN_CAM_WiFi_AutoOn_NvalueSet (Wifi On/Off User setting)
 * Each step waits 5 seconds
 */
testcase SetSignalsSequentially()
{
  int value;
  
  write("========================================");
  write("Test: Set Signals in HU_BLTN_CAM_01_00ms");
  write("========================================");
  
  // Set BLTN_CAM_AppNoti_PEV_NvalueSet from 0 to 3 with 5s delays
  write("--- Setting BLTN_CAM_AppNoti_PEV_NvalueSet (0 to 3) ---");
  for (value = 0; value <= 3; value++)
  {
    TestStep("1.%d", "Set BLTN_CAM_AppNoti_PEV_NvalueSet to %d", value+1, value);
    msg_HU_BLTN_CAM.BLTN_CAM_AppNoti_PEV_NvalueSet = value;
    output(msg_HU_BLTN_CAM);
    
    switch(value)
    {
      case 0: write("  -> BLTN_CAM_AppNoti_PEV_NvalueSet = 0 (Default)"); break;
      case 1: write("  -> BLTN_CAM_AppNoti_PEV_NvalueSet = 1 (Off)"); break;
      case 2: write("  -> BLTN_CAM_AppNoti_PEV_NvalueSet = 2 (On)"); break;
      case 3: write("  -> BLTN_CAM_AppNoti_PEV_NvalueSet = 3 (Invalid)"); break;
    }
    
    TestStepPass();
    testWaitForTimeout(TIME_WAIT); // Wait 5 seconds
  }
  
  write("----------------------------------------");
  
  // Set BLTN_CAM_WiFi_AutoOn_NvalueSet from 0 to 3 with 5s delays
  write("--- Setting BLTN_CAM_WiFi_AutoOn_NvalueSet (0 to 3) ---");
  for (value = 0; value <= 3; value++)
  {
    TestStep("2.%d", "Set BLTN_CAM_WiFi_AutoOn_NvalueSet to %d", value+1, value);
    msg_HU_BLTN_CAM.BLTN_CAM_WiFi_AutoOn_NvalueSet = value;
    output(msg_HU_BLTN_CAM);
    write("  -> BLTN_CAM_WiFi_AutoOn_NvalueSet = %d", value);
    TestStepPass();
    testWaitForTimeout(TIME_WAIT); // Wait 5 seconds
  }
  
  write("========================================");
  write("Test Completed Successfully!");
  write("========================================");
}

/*
 * Main test execution
 */
void MainTest()
{
  // Execute the test case
  SetSignalsSequentially();
}
