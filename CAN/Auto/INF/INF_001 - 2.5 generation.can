/*@!Encoding:65001*/

includes
{
  #include "../DeclarationFunction_Gen2.5.h"
}

/*
  Test Case: INF_001 - 2.5 generation
  Title: [Driving Info Stamp Settings] - ON/OFF verification for all stamp items

  Preconditions:
    - ACC and IGN and ccNC/ccIC switch OFF, AVN mode

  Test flow:
    Step 1:  Init: Set_SMK_IGN, Click_USM_Reset, Click_Rec_Reset, Turn_ON_OWD,
             Enter_BLTN_CAM, send BLTN_CAM_Time_Stm_NvalueSet=0x1(OFF),
             check BLTN_CAM_Set_Tim_Stm=0x1(OFF), Exit_BLTN_CAM, screenshot
    Step 2:  KEY OFF, KEY ON, wait 10s, KEY OFF, KEY ON
    Step 3:  Enter_BLTN_CAM, send BLTN_CAM_Time_Stm_NvalueSet=0x2(ON),
             check BLTN_CAM_Set_Tim_Stm=0x2(ON), Exit_BLTN_CAM, screenshot
    Step 4:  KEY OFF, KEY ON, wait 10s, KEY OFF
    Step 5~24: Repeat pattern for Spd_Stm, GearPos_Stm, TrnSig_Stm,
               EVSen_Stm, Locatn_Stm (OFF then ON each)

  NOTE: NvalueSet signals are sent via HU_BLTN_CAM_01_00ms CAN FD message.
        Must sync all current signal values before sending (valueSet pattern).
        Screenshots are captured only on odd steps (signal send/check steps).
        If send+check fails, retry up to 5 times (Exit -> re-Enter -> resend).
*/

variables
{
  // Result tracking
  int step1_passed = 0;
  int step3_passed = 0;
  int step5_passed = 0;
  int step7_passed = 0;
  int step9_passed = 0;
  int step11_passed = 0;
  int step13_passed = 0;
  int step15_passed = 0;
  int step17_passed = 0;
  int step19_passed = 0;
  int step21_passed = 0;
  int step23_passed = 0;

  // Message Declaration for CAN FD
  message HU_BLTN_CAM_02_200ms _HU_BLTN_CAM_02_200ms;
  message HU_BLTN_CAM_01_00ms  _HU_BLTN_CAM_01_00ms;
  message HU_CLOCK_01_1000ms   _HU_CLOCK_01_1000ms;
}


// ============================================================================
// Test Cases
// ============================================================================

testcase INF_001_Init()
{
  write("========================================");
  write("=== START TEST INF_001 - 2.5 ===");
  write("========================================");
  write("===START TEST===");
}

// ============================================================================
// STEP 1: Init + Time Stamp OFF
// ============================================================================
testcase INF_001_1()
{
  int attempt;

  SetTestStep("Bước 1 - INF_001");
  StartTestTimer();

  write("");
  write("=== STEP 1: Init + Set Time Stamp = OFF ===");
  testStep("Step1", "Init + BLTN_CAM_Time_Stm_NvalueSet=0x1(OFF), check BLTN_CAM_Set_Tim_Stm=0x1(OFF)");

  // 1.1: Set_SMK_IGN
  write("Step 1.1: Set_SMK_IGN...");
  Set_SMK_IGN();
  testWaitForTimeout(3000);

  // 1.2: USM Reset
  write("Step 1.2: Click_USM_Reset...");
  Click_USM_Reset();

  // 1.3: Rec Reset
  write("Step 1.3: Click_Rec_Reset...");
  Click_Rec_Reset();

  // 1.4: Turn ON OWD
  write("Step 1.4: Turn_ON_OWD...");
  Turn_ON_OWD();
  testWaitForTimeout(3000);

  // 1.5: Enter BLTN_CAM + Send with retry (max 5 attempts)
  step1_passed = 0;
  for (attempt = 1; attempt <= 5; attempt++)
  {
    write("Step 1.5: Enter_BLTN_CAM (attempt %d/5)...", attempt);
    Enter_BLTN_CAM();
    testWaitForTimeout(3000);

    write("Step 1.6: Send BLTN_CAM_Time_Stm_NvalueSet = 0x1 (OFF)...");
    if (Send_Tim_Stm_NvalueSet(0x1) == 1)
    {
      step1_passed = 1;
      write(">>> [OK] Step 1 passed on attempt %d <<<", attempt);
      break;
    }

    write(">>> [NG] Attempt %d/5 failed <<<", attempt);
    Exit_BLTN_CAM();
    testWaitForTimeout(2000);
  }

  if (step1_passed == 1)
  {
    testStepPass("Step1", "BLTN_CAM_Set_Tim_Stm = 0x1 (OFF) - PASS");
    Exit_BLTN_CAM();
    testWaitForTimeout(1000);
  }
  else
  {
    Log_Error_Details();
    testStepFail("Step1", "BLTN_CAM_Set_Tim_Stm != 0x1 - FAIL after 5 attempts");
  }

  CaptureGraphics("INF", "BLTN_CAM_Set_Tim_Stm;BLTN_CAM_Time_Stm_NvalueSet");

  write("=== FINISH STEP 1 ===");
  StopTestTimer();
}

// ============================================================================
// STEP 2: KEY OFF, KEY ON, wait 10s, KEY OFF, KEY ON
// ============================================================================
testcase INF_001_2()
{
  SetTestStep("Bước 2 - INF_001");
  StartTestTimer();

  write("");
  write("=== STEP 2: KEY cycle (OFF -> ON -> 10s -> OFF -> ON) ===");
  testStep("Step2", "KEY OFF, KEY ON, wait 10s, KEY OFF, KEY ON");

  KEY_OFF();
  testWaitForTimeout(3000);

  KEY_ON();
  testWaitForTimeout(10000);

  KEY_OFF();
  testWaitForTimeout(3000);

  KEY_ON();
  testWaitForTimeout(3000);

  write("=== FINISH STEP 2 ===");
  StopTestTimer();
}

// ============================================================================
// STEP 3: Time Stamp ON
// ============================================================================
testcase INF_001_3()
{
  int attempt;

  SetTestStep("Bước 3 - INF_001");
  StartTestTimer();

  write("");
  write("=== STEP 3: Set Time Stamp = ON ===");
  testStep("Step3", "BLTN_CAM_Time_Stm_NvalueSet=0x2(ON), check BLTN_CAM_Set_Tim_Stm=0x2(ON)");

  step3_passed = 0;
  for (attempt = 1; attempt <= 5; attempt++)
  {
    write("Step 3: Enter_BLTN_CAM (attempt %d/5)...", attempt);
    Enter_BLTN_CAM();
    testWaitForTimeout(3000);

    if (Send_Tim_Stm_NvalueSet(0x2) == 1)
    {
      step3_passed = 1;
      write(">>> [OK] Step 3 passed on attempt %d <<<", attempt);
      break;
    }

    write(">>> [NG] Attempt %d/5 failed <<<", attempt);
    Exit_BLTN_CAM();
    testWaitForTimeout(2000);
  }

  if (step3_passed == 1)
  {
    testStepPass("Step3", "BLTN_CAM_Set_Tim_Stm = 0x2 (ON) - PASS");
    Exit_BLTN_CAM();
    testWaitForTimeout(1000);
  }
  else
  {
    Log_Error_Details();
    testStepFail("Step3", "BLTN_CAM_Set_Tim_Stm != 0x2 - FAIL after 5 attempts");
  }

  CaptureGraphics("INF", "BLTN_CAM_Set_Tim_Stm;BLTN_CAM_Time_Stm_NvalueSet");

  write("=== FINISH STEP 3 ===");
  StopTestTimer();
}

// ============================================================================
// STEP 4: KEY OFF, KEY ON, wait 10s, KEY OFF
// ============================================================================
testcase INF_001_4()
{
  SetTestStep("Bước 4 - INF_001");
  StartTestTimer();

  write("");
  write("=== STEP 4: KEY cycle (OFF -> ON -> 10s -> OFF) ===");
  testStep("Step4", "KEY OFF, KEY ON, wait 10s, KEY OFF");

  KEY_OFF();
  testWaitForTimeout(3000);

  KEY_ON();
  testWaitForTimeout(10000);

  KEY_OFF();
  testWaitForTimeout(3000);

  write("=== FINISH STEP 4 ===");
  StopTestTimer();
}

// ============================================================================
// STEP 5: Speed Stamp OFF
// ============================================================================
testcase INF_001_5()
{
  int attempt;

  SetTestStep("Bước 5 - INF_001");
  StartTestTimer();

  write("");
  write("=== STEP 5: Set Speed Stamp = OFF ===");
  testStep("Step5", "BLTN_CAM_Spd_Stm_NvalueSet=0x1(OFF), check BLTN_CAM_Set_Spd_Stm=0x1(OFF)");

  KEY_ON();
  testWaitForTimeout(3000);

  step5_passed = 0;
  for (attempt = 1; attempt <= 5; attempt++)
  {
    write("Step 5: Enter_BLTN_CAM (attempt %d/5)...", attempt);
    Enter_BLTN_CAM();
    testWaitForTimeout(3000);

    if (Send_Spd_Stm_NvalueSet(0x1) == 1)
    {
      step5_passed = 1;
      write(">>> [OK] Step 5 passed on attempt %d <<<", attempt);
      break;
    }

    write(">>> [NG] Attempt %d/5 failed <<<", attempt);
    Exit_BLTN_CAM();
    testWaitForTimeout(2000);
  }

  if (step5_passed == 1)
  {
    testStepPass("Step5", "BLTN_CAM_Set_Spd_Stm = 0x1 (OFF) - PASS");
    Exit_BLTN_CAM();
    testWaitForTimeout(1000);
  }
  else
  {
    Log_Error_Details();
    testStepFail("Step5", "BLTN_CAM_Set_Spd_Stm != 0x1 - FAIL after 5 attempts");
  }

  CaptureGraphics("INF", "BLTN_CAM_Set_Spd_Stm;BLTN_CAM_Spd_Stm_NvalueSet");

  write("=== FINISH STEP 5 ===");
  StopTestTimer();
}

// ============================================================================
// STEP 6: KEY OFF, KEY ON, wait 10s, KEY OFF
// ============================================================================
testcase INF_001_6()
{
  SetTestStep("Bước 6 - INF_001");
  StartTestTimer();
  write("");
  write("=== STEP 6: KEY cycle (OFF -> ON -> 10s -> OFF) ===");
  testStep("Step6", "KEY OFF, KEY ON, wait 10s, KEY OFF");
  KEY_OFF(); testWaitForTimeout(3000);
  KEY_ON();  testWaitForTimeout(10000);
  KEY_OFF(); testWaitForTimeout(3000);
  write("=== FINISH STEP 6 ===");
  StopTestTimer();
}

// ============================================================================
// STEP 7: Speed Stamp ON
// ============================================================================
testcase INF_001_7()
{
  int attempt;

  SetTestStep("Bước 7 - INF_001");
  StartTestTimer();

  write("");
  write("=== STEP 7: Set Speed Stamp = ON ===");
  testStep("Step7", "BLTN_CAM_Spd_Stm_NvalueSet=0x2(ON), check BLTN_CAM_Set_Spd_Stm=0x2(ON)");

  KEY_ON();
  testWaitForTimeout(3000);

  step7_passed = 0;
  for (attempt = 1; attempt <= 5; attempt++)
  {
    write("Step 7: Enter_BLTN_CAM (attempt %d/5)...", attempt);
    Enter_BLTN_CAM();
    testWaitForTimeout(3000);

    if (Send_Spd_Stm_NvalueSet(0x2) == 1)
    {
      step7_passed = 1;
      write(">>> [OK] Step 7 passed on attempt %d <<<", attempt);
      break;
    }

    write(">>> [NG] Attempt %d/5 failed <<<", attempt);
    Exit_BLTN_CAM();
    testWaitForTimeout(2000);
  }

  if (step7_passed == 1)
  {
    testStepPass("Step7", "BLTN_CAM_Set_Spd_Stm = 0x2 (ON) - PASS");
    Exit_BLTN_CAM();
    testWaitForTimeout(1000);
  }
  else
  {
    Log_Error_Details();
    testStepFail("Step7", "BLTN_CAM_Set_Spd_Stm != 0x2 - FAIL after 5 attempts");
  }

  CaptureGraphics("INF", "BLTN_CAM_Set_Spd_Stm;BLTN_CAM_Spd_Stm_NvalueSet");

  write("=== FINISH STEP 7 ===");
  StopTestTimer();
}

// ============================================================================
// STEP 8: KEY OFF, KEY ON, wait 10s, KEY OFF
// ============================================================================
testcase INF_001_8()
{
  SetTestStep("Bước 8 - INF_001");
  StartTestTimer();
  write("");
  write("=== STEP 8: KEY cycle (OFF -> ON -> 10s -> OFF) ===");
  testStep("Step8", "KEY OFF, KEY ON, wait 10s, KEY OFF");
  KEY_OFF(); testWaitForTimeout(3000);
  KEY_ON();  testWaitForTimeout(10000);
  KEY_OFF(); testWaitForTimeout(3000);
  write("=== FINISH STEP 8 ===");
  StopTestTimer();
}

// ============================================================================
// STEP 9: Gear Position Stamp OFF
// ============================================================================
testcase INF_001_9()
{
  int attempt;

  SetTestStep("Bước 9 - INF_001");
  StartTestTimer();

  write("");
  write("=== STEP 9: Set Gear Position Stamp = OFF ===");
  testStep("Step9", "BLTN_CAM_GearPos_Stm_NvalueSet=0x1(OFF), check BLTN_CAM_Set_GearPos_Stm=0x1(OFF)");

  KEY_ON();
  testWaitForTimeout(3000);

  step9_passed = 0;
  for (attempt = 1; attempt <= 5; attempt++)
  {
    write("Step 9: Enter_BLTN_CAM (attempt %d/5)...", attempt);
    Enter_BLTN_CAM();
    testWaitForTimeout(3000);

    if (Send_GearPos_Stm_NvalueSet(0x1) == 1)
    {
      step9_passed = 1;
      write(">>> [OK] Step 9 passed on attempt %d <<<", attempt);
      break;
    }

    write(">>> [NG] Attempt %d/5 failed <<<", attempt);
    Exit_BLTN_CAM();
    testWaitForTimeout(2000);
  }

  if (step9_passed == 1)
  {
    testStepPass("Step9", "BLTN_CAM_Set_GearPos_Stm = 0x1 (OFF) - PASS");
    Exit_BLTN_CAM();
    testWaitForTimeout(1000);
  }
  else
  {
    Log_Error_Details();
    testStepFail("Step9", "BLTN_CAM_Set_GearPos_Stm != 0x1 - FAIL after 5 attempts");
  }

  CaptureGraphics("INF", "BLTN_CAM_Set_GearPos_Stm;BLTN_CAM_GearPos_Stm_NvalueSet");

  write("=== FINISH STEP 9 ===");
  StopTestTimer();
}

// ============================================================================
// STEP 10: KEY OFF, KEY ON, wait 10s, KEY OFF
// ============================================================================
testcase INF_001_10()
{
  SetTestStep("Bước 10 - INF_001");
  StartTestTimer();
  write("");
  write("=== STEP 10: KEY cycle (OFF -> ON -> 10s -> OFF) ===");
  testStep("Step10", "KEY OFF, KEY ON, wait 10s, KEY OFF");
  KEY_OFF(); testWaitForTimeout(3000);
  KEY_ON();  testWaitForTimeout(10000);
  KEY_OFF(); testWaitForTimeout(3000);
  write("=== FINISH STEP 10 ===");
  StopTestTimer();
}

// ============================================================================
// STEP 11: Gear Position Stamp ON
// ============================================================================
testcase INF_001_11()
{
  int attempt;

  SetTestStep("Bước 11 - INF_001");
  StartTestTimer();

  write("");
  write("=== STEP 11: Set Gear Position Stamp = ON ===");
  testStep("Step11", "BLTN_CAM_GearPos_Stm_NvalueSet=0x2(ON), check BLTN_CAM_Set_GearPos_Stm=0x2(ON)");

  KEY_ON();
  testWaitForTimeout(3000);

  step11_passed = 0;
  for (attempt = 1; attempt <= 5; attempt++)
  {
    write("Step 11: Enter_BLTN_CAM (attempt %d/5)...", attempt);
    Enter_BLTN_CAM();
    testWaitForTimeout(3000);

    if (Send_GearPos_Stm_NvalueSet(0x2) == 1)
    {
      step11_passed = 1;
      write(">>> [OK] Step 11 passed on attempt %d <<<", attempt);
      break;
    }

    write(">>> [NG] Attempt %d/5 failed <<<", attempt);
    Exit_BLTN_CAM();
    testWaitForTimeout(2000);
  }

  if (step11_passed == 1)
  {
    testStepPass("Step11", "BLTN_CAM_Set_GearPos_Stm = 0x2 (ON) - PASS");
    Exit_BLTN_CAM();
    testWaitForTimeout(1000);
  }
  else
  {
    Log_Error_Details();
    testStepFail("Step11", "BLTN_CAM_Set_GearPos_Stm != 0x2 - FAIL after 5 attempts");
  }

  CaptureGraphics("INF", "BLTN_CAM_Set_GearPos_Stm;BLTN_CAM_GearPos_Stm_NvalueSet");

  write("=== FINISH STEP 11 ===");
  StopTestTimer();
}

// ============================================================================
// STEP 12: KEY OFF, KEY ON, wait 10s, KEY OFF
// ============================================================================
testcase INF_001_12()
{
  SetTestStep("Bước 12 - INF_001");
  StartTestTimer();
  write("");
  write("=== STEP 12: KEY cycle (OFF -> ON -> 10s -> OFF) ===");
  testStep("Step12", "KEY OFF, KEY ON, wait 10s, KEY OFF");
  KEY_OFF(); testWaitForTimeout(3000);
  KEY_ON();  testWaitForTimeout(10000);
  KEY_OFF(); testWaitForTimeout(3000);
  write("=== FINISH STEP 12 ===");
  StopTestTimer();
}

// ============================================================================
// STEP 13: Turn Signal Stamp OFF
// ============================================================================
testcase INF_001_13()
{
  int attempt;

  SetTestStep("Bước 13 - INF_001");
  StartTestTimer();

  write("");
  write("=== STEP 13: Set Turn Signal Stamp = OFF ===");
  testStep("Step13", "BLTN_CAM_TrnSig_Stm_NvalueSet=0x1(OFF), check BLTN_CAM_Set_TrnSig_Stm=0x1(OFF)");

  KEY_ON();
  testWaitForTimeout(3000);

  step13_passed = 0;
  for (attempt = 1; attempt <= 5; attempt++)
  {
    write("Step 13: Enter_BLTN_CAM (attempt %d/5)...", attempt);
    Enter_BLTN_CAM();
    testWaitForTimeout(3000);

    if (Send_TrnSig_Stm_NvalueSet(0x1) == 1)
    {
      step13_passed = 1;
      write(">>> [OK] Step 13 passed on attempt %d <<<", attempt);
      break;
    }

    write(">>> [NG] Attempt %d/5 failed <<<", attempt);
    Exit_BLTN_CAM();
    testWaitForTimeout(2000);
  }

  if (step13_passed == 1)
  {
    testStepPass("Step13", "BLTN_CAM_Set_TrnSig_Stm = 0x1 (OFF) - PASS");
    Exit_BLTN_CAM();
    testWaitForTimeout(1000);
  }
  else
  {
    Log_Error_Details();
    testStepFail("Step13", "BLTN_CAM_Set_TrnSig_Stm != 0x1 - FAIL after 5 attempts");
  }

  CaptureGraphics("INF", "BLTN_CAM_Set_TrnSig_Stm;BLTN_CAM_TrnSig_Stm_NvalueSet");

  write("=== FINISH STEP 13 ===");
  StopTestTimer();
}

// ============================================================================
// STEP 14: KEY OFF, KEY ON, wait 10s, KEY OFF
// ============================================================================
testcase INF_001_14()
{
  SetTestStep("Bước 14 - INF_001");
  StartTestTimer();
  write("");
  write("=== STEP 14: KEY cycle (OFF -> ON -> 10s -> OFF) ===");
  testStep("Step14", "KEY OFF, KEY ON, wait 10s, KEY OFF");
  KEY_OFF(); testWaitForTimeout(3000);
  KEY_ON();  testWaitForTimeout(10000);
  KEY_OFF(); testWaitForTimeout(3000);
  write("=== FINISH STEP 14 ===");
  StopTestTimer();
}

// ============================================================================
// STEP 15: Turn Signal Stamp ON
// ============================================================================
testcase INF_001_15()
{
  int attempt;

  SetTestStep("Bước 15 - INF_001");
  StartTestTimer();

  write("");
  write("=== STEP 15: Set Turn Signal Stamp = ON ===");
  testStep("Step15", "BLTN_CAM_TrnSig_Stm_NvalueSet=0x2(ON), check BLTN_CAM_Set_TrnSig_Stm=0x2(ON)");

  KEY_ON();
  testWaitForTimeout(3000);

  step15_passed = 0;
  for (attempt = 1; attempt <= 5; attempt++)
  {
    write("Step 15: Enter_BLTN_CAM (attempt %d/5)...", attempt);
    Enter_BLTN_CAM();
    testWaitForTimeout(3000);

    if (Send_TrnSig_Stm_NvalueSet(0x2) == 1)
    {
      step15_passed = 1;
      write(">>> [OK] Step 15 passed on attempt %d <<<", attempt);
      break;
    }

    write(">>> [NG] Attempt %d/5 failed <<<", attempt);
    Exit_BLTN_CAM();
    testWaitForTimeout(2000);
  }

  if (step15_passed == 1)
  {
    testStepPass("Step15", "BLTN_CAM_Set_TrnSig_Stm = 0x2 (ON) - PASS");
    Exit_BLTN_CAM();
    testWaitForTimeout(1000);
  }
  else
  {
    Log_Error_Details();
    testStepFail("Step15", "BLTN_CAM_Set_TrnSig_Stm != 0x2 - FAIL after 5 attempts");
  }

  CaptureGraphics("INF", "BLTN_CAM_Set_TrnSig_Stm;BLTN_CAM_TrnSig_Stm_NvalueSet");

  write("=== FINISH STEP 15 ===");
  StopTestTimer();
}

// ============================================================================
// STEP 16: KEY OFF, KEY ON, wait 10s, KEY OFF
// ============================================================================
testcase INF_001_16()
{
  SetTestStep("Bước 16 - INF_001");
  StartTestTimer();
  write("");
  write("=== STEP 16: KEY cycle (OFF -> ON -> 10s -> OFF) ===");
  testStep("Step16", "KEY OFF, KEY ON, wait 10s, KEY OFF");
  KEY_OFF(); testWaitForTimeout(3000);
  KEY_ON();  testWaitForTimeout(10000);
  KEY_OFF(); testWaitForTimeout(3000);
  write("=== FINISH STEP 16 ===");
  StopTestTimer();
}

// ============================================================================
// STEP 17: Event Sensor Stamp OFF
// ============================================================================
testcase INF_001_17()
{
  int attempt;

  SetTestStep("Bước 17 - INF_001");
  StartTestTimer();

  write("");
  write("=== STEP 17: Set Event Sensor Stamp = OFF ===");
  testStep("Step17", "BLTN_CAM_EVSen_Stm_NvalueSet=0x1(OFF), check BLTN_CAM_Set_EVSen_Stm=0x1(OFF)");

  KEY_ON();
  testWaitForTimeout(3000);

  step17_passed = 0;
  for (attempt = 1; attempt <= 5; attempt++)
  {
    write("Step 17: Enter_BLTN_CAM (attempt %d/5)...", attempt);
    Enter_BLTN_CAM();
    testWaitForTimeout(3000);

    if (Send_EVSen_Stm_NvalueSet(0x1) == 1)
    {
      step17_passed = 1;
      write(">>> [OK] Step 17 passed on attempt %d <<<", attempt);
      break;
    }

    write(">>> [NG] Attempt %d/5 failed <<<", attempt);
    Exit_BLTN_CAM();
    testWaitForTimeout(2000);
  }

  if (step17_passed == 1)
  {
    testStepPass("Step17", "BLTN_CAM_Set_EVSen_Stm = 0x1 (OFF) - PASS");
    Exit_BLTN_CAM();
    testWaitForTimeout(1000);
  }
  else
  {
    Log_Error_Details();
    testStepFail("Step17", "BLTN_CAM_Set_EVSen_Stm != 0x1 - FAIL after 5 attempts");
  }

  CaptureGraphics("INF", "BLTN_CAM_Set_EVSen_Stm;BLTN_CAM_EVSen_Stm_NvalueSet");

  write("=== FINISH STEP 17 ===");
  StopTestTimer();
}

// ============================================================================
// STEP 18: KEY OFF, KEY ON, wait 10s, KEY OFF
// ============================================================================
testcase INF_001_18()
{
  SetTestStep("Bước 18 - INF_001");
  StartTestTimer();
  write("");
  write("=== STEP 18: KEY cycle (OFF -> ON -> 10s -> OFF) ===");
  testStep("Step18", "KEY OFF, KEY ON, wait 10s, KEY OFF");
  KEY_OFF(); testWaitForTimeout(3000);
  KEY_ON();  testWaitForTimeout(10000);
  KEY_OFF(); testWaitForTimeout(3000);
  write("=== FINISH STEP 18 ===");
  StopTestTimer();
}

// ============================================================================
// STEP 19: Event Sensor Stamp ON
// ============================================================================
testcase INF_001_19()
{
  int attempt;

  SetTestStep("Bước 19 - INF_001");
  StartTestTimer();

  write("");
  write("=== STEP 19: Set Event Sensor Stamp = ON ===");
  testStep("Step19", "BLTN_CAM_EVSen_Stm_NvalueSet=0x2(ON), check BLTN_CAM_Set_EVSen_Stm=0x2(ON)");

  KEY_ON();
  testWaitForTimeout(3000);

  step19_passed = 0;
  for (attempt = 1; attempt <= 5; attempt++)
  {
    write("Step 19: Enter_BLTN_CAM (attempt %d/5)...", attempt);
    Enter_BLTN_CAM();
    testWaitForTimeout(3000);

    if (Send_EVSen_Stm_NvalueSet(0x2) == 1)
    {
      step19_passed = 1;
      write(">>> [OK] Step 19 passed on attempt %d <<<", attempt);
      break;
    }

    write(">>> [NG] Attempt %d/5 failed <<<", attempt);
    Exit_BLTN_CAM();
    testWaitForTimeout(2000);
  }

  if (step19_passed == 1)
  {
    testStepPass("Step19", "BLTN_CAM_Set_EVSen_Stm = 0x2 (ON) - PASS");
    Exit_BLTN_CAM();
    testWaitForTimeout(1000);
  }
  else
  {
    Log_Error_Details();
    testStepFail("Step19", "BLTN_CAM_Set_EVSen_Stm != 0x2 - FAIL after 5 attempts");
  }

  CaptureGraphics("INF", "BLTN_CAM_Set_EVSen_Stm;BLTN_CAM_EVSen_Stm_NvalueSet");

  write("=== FINISH STEP 19 ===");
  StopTestTimer();
}

// ============================================================================
// STEP 20: KEY OFF, KEY ON, wait 10s, KEY OFF
// ============================================================================
testcase INF_001_20()
{
  SetTestStep("Bước 20 - INF_001");
  StartTestTimer();
  write("");
  write("=== STEP 20: KEY cycle (OFF -> ON -> 10s -> OFF) ===");
  testStep("Step20", "KEY OFF, KEY ON, wait 10s, KEY OFF");
  KEY_OFF(); testWaitForTimeout(3000);
  KEY_ON();  testWaitForTimeout(10000);
  KEY_OFF(); testWaitForTimeout(3000);
  write("=== FINISH STEP 20 ===");
  StopTestTimer();
}

// ============================================================================
// STEP 21: Location Stamp OFF
// ============================================================================
testcase INF_001_21()
{
  int attempt;

  SetTestStep("Bước 21 - INF_001");
  StartTestTimer();

  write("");
  write("=== STEP 21: Set Location Stamp = OFF ===");
  testStep("Step21", "BLTN_CAM_Locatn_Stm_NvalueSet=0x1(OFF), check BLTN_CAM_Set_Locatn_Stm=0x1(OFF)");

  KEY_ON();
  testWaitForTimeout(3000);

  step21_passed = 0;
  for (attempt = 1; attempt <= 5; attempt++)
  {
    write("Step 21: Enter_BLTN_CAM (attempt %d/5)...", attempt);
    Enter_BLTN_CAM();
    testWaitForTimeout(3000);

    if (Send_Locatn_Stm_NvalueSet(0x1) == 1)
    {
      step21_passed = 1;
      write(">>> [OK] Step 21 passed on attempt %d <<<", attempt);
      break;
    }

    write(">>> [NG] Attempt %d/5 failed <<<", attempt);
    Exit_BLTN_CAM();
    testWaitForTimeout(2000);
  }

  if (step21_passed == 1)
  {
    testStepPass("Step21", "BLTN_CAM_Set_Locatn_Stm = 0x1 (OFF) - PASS");
    Exit_BLTN_CAM();
    testWaitForTimeout(1000);
  }
  else
  {
    Log_Error_Details();
    testStepFail("Step21", "BLTN_CAM_Set_Locatn_Stm != 0x1 - FAIL after 5 attempts");
  }

  CaptureGraphics("INF", "BLTN_CAM_Set_Locatn_Stm;BLTN_CAM_Locatn_Stm_NvalueSet");

  write("=== FINISH STEP 21 ===");
  StopTestTimer();
}

// ============================================================================
// STEP 22: KEY OFF, KEY ON, wait 10s, KEY OFF
// ============================================================================
testcase INF_001_22()
{
  SetTestStep("Bước 22 - INF_001");
  StartTestTimer();
  write("");
  write("=== STEP 22: KEY cycle (OFF -> ON -> 10s -> OFF) ===");
  testStep("Step22", "KEY OFF, KEY ON, wait 10s, KEY OFF");
  KEY_OFF(); testWaitForTimeout(3000);
  KEY_ON();  testWaitForTimeout(10000);
  KEY_OFF(); testWaitForTimeout(3000);
  write("=== FINISH STEP 22 ===");
  StopTestTimer();
}

// ============================================================================
// STEP 23: Location Stamp ON
// ============================================================================
testcase INF_001_23()
{
  int attempt;

  SetTestStep("Bước 23 - INF_001");
  StartTestTimer();

  write("");
  write("=== STEP 23: Set Location Stamp = ON ===");
  testStep("Step23", "BLTN_CAM_Locatn_Stm_NvalueSet=0x2(ON), check BLTN_CAM_Set_Locatn_Stm=0x2(ON)");

  KEY_ON();
  testWaitForTimeout(3000);

  step23_passed = 0;
  for (attempt = 1; attempt <= 5; attempt++)
  {
    write("Step 23: Enter_BLTN_CAM (attempt %d/5)...", attempt);
    Enter_BLTN_CAM();
    testWaitForTimeout(3000);

    if (Send_Locatn_Stm_NvalueSet(0x2) == 1)
    {
      step23_passed = 1;
      write(">>> [OK] Step 23 passed on attempt %d <<<", attempt);
      break;
    }

    write(">>> [NG] Attempt %d/5 failed <<<", attempt);
    Exit_BLTN_CAM();
    testWaitForTimeout(2000);
  }

  if (step23_passed == 1)
  {
    testStepPass("Step23", "BLTN_CAM_Set_Locatn_Stm = 0x2 (ON) - PASS");
    Exit_BLTN_CAM();
    testWaitForTimeout(1000);
  }
  else
  {
    Log_Error_Details();
    testStepFail("Step23", "BLTN_CAM_Set_Locatn_Stm != 0x2 - FAIL after 5 attempts");
  }

  CaptureGraphics("INF", "BLTN_CAM_Set_Locatn_Stm;BLTN_CAM_Locatn_Stm_NvalueSet");

  write("=== FINISH STEP 23 ===");
  StopTestTimer();
}

// ============================================================================
// STEP 24: KEY OFF, KEY ON, wait 10s, KEY OFF
// ============================================================================
testcase INF_001_24()
{
  SetTestStep("Bước 24 - INF_001");
  StartTestTimer();
  write("");
  write("=== STEP 24: KEY cycle (OFF -> ON -> 10s -> OFF) ===");
  testStep("Step24", "KEY OFF, KEY ON, wait 10s, KEY OFF");
  KEY_OFF(); testWaitForTimeout(3000);
  KEY_ON();  testWaitForTimeout(10000);
  KEY_OFF(); testWaitForTimeout(3000);
  write("=== FINISH STEP 24 ===");
  StopTestTimer();
}

// ============================================================================
// Summary
// ============================================================================

void MainTest()
{
  testReportFileName("TestReports\\INF_001 - 2.5 generation_report");

  INF_001_Init();

  INF_001_1();
  INF_001_2();
  INF_001_3();
  INF_001_4();
  INF_001_5();
  INF_001_6();
  INF_001_7();
  INF_001_8();
  INF_001_9();
  INF_001_10();
  INF_001_11();
  INF_001_12();
  INF_001_13();
  INF_001_14();
  INF_001_15();
  INF_001_16();
  INF_001_17();
  INF_001_18();
  INF_001_19();
  INF_001_20();
  INF_001_21();
  INF_001_22();
  INF_001_23();
  INF_001_24();

  write("");
  write("========================================");
  write("=== INF_001 TEST SUMMARY ===");
  write("========================================");

  if (step1_passed == 1)  write("  Step 1  (Tim_Stm OFF):      PASS");
  else                    write("  Step 1  (Tim_Stm OFF):      FAIL");

  if (step3_passed == 1)  write("  Step 3  (Tim_Stm ON):       PASS");
  else                    write("  Step 3  (Tim_Stm ON):       FAIL");

  if (step5_passed == 1)  write("  Step 5  (Spd_Stm OFF):      PASS");
  else                    write("  Step 5  (Spd_Stm OFF):      FAIL");

  if (step7_passed == 1)  write("  Step 7  (Spd_Stm ON):       PASS");
  else                    write("  Step 7  (Spd_Stm ON):       FAIL");

  if (step9_passed == 1)  write("  Step 9  (GearPos_Stm OFF):  PASS");
  else                    write("  Step 9  (GearPos_Stm OFF):  FAIL");

  if (step11_passed == 1) write("  Step 11 (GearPos_Stm ON):   PASS");
  else                    write("  Step 11 (GearPos_Stm ON):   FAIL");

  if (step13_passed == 1) write("  Step 13 (TrnSig_Stm OFF):   PASS");
  else                    write("  Step 13 (TrnSig_Stm OFF):   FAIL");

  if (step15_passed == 1) write("  Step 15 (TrnSig_Stm ON):    PASS");
  else                    write("  Step 15 (TrnSig_Stm ON):    FAIL");

  if (step17_passed == 1) write("  Step 17 (EVSen_Stm OFF):    PASS");
  else                    write("  Step 17 (EVSen_Stm OFF):    FAIL");

  if (step19_passed == 1) write("  Step 19 (EVSen_Stm ON):     PASS");
  else                    write("  Step 19 (EVSen_Stm ON):     FAIL");

  if (step21_passed == 1) write("  Step 21 (Locatn_Stm OFF):   PASS");
  else                    write("  Step 21 (Locatn_Stm OFF):   FAIL");

  if (step23_passed == 1) write("  Step 23 (Locatn_Stm ON):    PASS");
  else                    write("  Step 23 (Locatn_Stm ON):    FAIL");

  write("========================================");
}
