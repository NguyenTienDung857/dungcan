/*@!Encoding:65001*/
/*
 * FILE OVERVIEW: OTA_007.can
 *
 * Muc tieu test:
 * - Setup dieu kien OTA voi OWP ON.
 * - Neu version khong phai 0 thi chay update_to_00.py de dua ve ban 0.
 * - Chay case_007.py.
 * - Trong luong chinh, neu AppState len 17 thi KEY_OFF ngay (1 lan).
 * - Tiep tuc lang nghe toi da 30 phut, dung khi AppState = 3 hoac 4.
 * - Ket qua cuoi (case test update loi):
 *   + AppState = 4
 *   + SW version = 0
 *   + OWP recording OK
 *   + WaitForNetworkSleep(360) = 1
 *   => PASS
 *   + Neu AppState = 3 => FAIL (update thanh cong, khong dung muc tieu case)
 */
includes
{
  #include "../DeclarationFunction_Gen2.5.h"
}

variables
{
  char gWorkingDir[256] = "D:\\project\\CANoe\\CANFD\\Auto\\OTA\\";
  char gUpdateTo00Cmd[256] = "\"python\" \"D:\\project\\CANoe\\CANFD\\Auto\\OTA\\update_to_00.py\"";
  char gCase007Cmd[256] = "\"python\" \"D:\\project\\CANoe\\CANFD\\Auto\\OTA\\case_007.py\"";

  int gAppStatePrev = -1;

  int gOTA007_EnableKeyOffOnAppState17 = 0;
  int gOTA007_KeyOffDone = 0;
  int gOTA007_AppState17Seen = 0;
}

on sysvar_update PythonCom::AppState
{
  write("[OTA_007][EVENT] AppState cu=%d, moi=%d", gAppStatePrev, @PythonCom::AppState);

  if (@PythonCom::AppState == 17 && gAppStatePrev != 17)
  {
    if (gOTA007_EnableKeyOffOnAppState17 == 1)
    {
      gOTA007_AppState17Seen = 1;
      write("[OTA_007][EVENT] Bat duoc AppState = 17");

      if (gOTA007_KeyOffDone == 0)
      {
        write("[OTA_007][EVENT] AppState = 17 -> KEY_OFF ngay");
        KEY_OFF();
        gOTA007_KeyOffDone = 1;
      }
    }
    else
    {
      write("[OTA_007][EVENT][SETUP] AppState = 17 nhung dang setup ve ban 0 -> bo qua KEY_OFF");
    }
  }

  OTA_Update_AppStateTrigger_FromValue(gAppStatePrev, @PythonCom::AppState);

  if (@PythonCom::AppState == 3 && gAppStatePrev != 3)
  {
    write("[OTA_007][EVENT] Bat duoc AppState = 3");
  }
  else if (@PythonCom::AppState == 4 && gAppStatePrev != 4)
  {
    write("[OTA_007][EVENT] Bat duoc AppState = 4");
  }

  gAppStatePrev = @PythonCom::AppState;
}

int Run_Python_Update(char cmd[], char reason[])
{
  long result;

  write("[OTA_007][PY] %s", reason);
  write("[OTA_007][PY] WorkingDir = %s", gWorkingDir);
  write("[OTA_007][PY] Command    = %s", cmd);
  write("[OTA_007][PY] Reset AppState ve 0 truoc khi goi python");
  @PythonCom::AppState = 0;

  testStep("Python", "%s", reason);
  testWaitForTimeout(10000);
  result = TestWaitForSyscall(gWorkingDir, cmd, 0, 30000);
  write("[OTA_007][PY] Syscall ret = %d", result);
  // LUU Y: Khong dung ret de ket luan luong OTA. Ket qua OTA duoc xac nhan bang AppState (3/4).

  if (result != 1)
  {
    write("[OTA_007][PY][WARN] ret=%d nhung van tiep tuc luong test", result);
  }

  testStepPass("Python", "Da goi python (%s), ret=%d", reason, result);
  return 1;
}
testcase OTA_007()
{
  int swVerIsZero;
  int setupAppStateResult;
  int appStateResult;
  int swVerIsZeroAfter;
  int owpRecordingOk;
  long networkSleepOk;

  write("===========================================================");
  write("[OTA_007] Start test case OTA_007");
  write("===========================================================");

  testStep("Step 1", "KEY OFF -> KEY ON -> Set_SMK_IGN -> Click_USM_Reset -> Click_Rec_Reset -> Turn_ON_OWP");

  write("[OTA_007] KEY_OFF");
  KEY_OFF();
  testWaitForTimeout(2000);

  write("[OTA_007] KEY_ON");
  KEY_ON();
  testWaitForTimeout(2000);

  write("[OTA_007] Set_SMK_IGN");
  Set_SMK_IGN();

  write("[OTA_007] Click_USM_Reset");
  Click_USM_Reset();

  write("[OTA_007] Click_Rec_Reset");
  Click_Rec_Reset();

  write("[OTA_007] Turn_ON_OWP");
  Turn_ON_OWP();

  testStep("Step 2", "Kiem tra SW version co phai ban 0 khong");
  swVerIsZero = Check_SWVerMinor3(0);

  if (swVerIsZero != 1)
  {
    write("[OTA_007] Version khong phai ban 0 -> chay update_to_00.py de dua ve ban 0");

    OTA_Reset_AppStateWaitContext();
    gAppStatePrev = gOTA_AppStateWaitStart;
    gOTA007_EnableKeyOffOnAppState17 = 0;
    write("[OTA_007][SETUP] AppState truoc khi chay update_to_00.py = %d", gOTA_AppStateWaitStart);

    Run_Python_Update(gUpdateTo00Cmd, "Dua version ve ban 0 - update_to_00.py");

    // O setup: luon tiep tuc luong, chi dung AppState de ghi nhan ket qua.
    setupAppStateResult = Wait_AppState_3_Or_4_Changed(1800000);
    if (setupAppStateResult == 3)
    {
      write("[OTA_007][SETUP] update_to_00.py bao AppState=3 (OK setup), tiep tuc");
    }
    else if (setupAppStateResult == 4)
    {
      write("[OTA_007][SETUP] update_to_00.py bao AppState=4 (NG setup), van tiep tuc check version");
    }
    else
    {
      write("[OTA_007][SETUP] Timeout 30 phut o buoc update_to_00.py, van tiep tuc check version");
    }

    testWaitForTimeout(3000);
    swVerIsZero = Check_SWVerMinor3(0);
    if (swVerIsZero != 1)
    {
      testStepFail("Version", "Sau update_to_00.py van chua ve ban 0");
      CaptureGraphics("OTA", "SMK_TrmnlCtrlGrpStaBDC;BLTN_CAM_RecSta_OWD;BLTN_CAM_SWVerMinor3");
      return;
    }

    testStepPass("Version", "Da ve ban 0");
  }
  else
  {
    testStepPass("Version", "Da la ban 0 ngay tu dau");
  }

  testStep("Step 3", "Chay case_007.py va lang nghe AppState");
  OTA_Reset_AppStateWaitContext();
  gAppStatePrev = gOTA_AppStateWaitStart;
  gOTA007_EnableKeyOffOnAppState17 = 1;
  gOTA007_KeyOffDone = 0;
  gOTA007_AppState17Seen = 0;

  write("[OTA_007] AppState truoc khi chay case_007.py = %d", gOTA_AppStateWaitStart);

  Run_Python_Update(gCase007Cmd, "Chay case_007.py");

  testStep("Step 4", "Lang nghe AppState toi da 30 phut, dung khi thay 3 hoac 4");
  appStateResult = Wait_AppState_3_Or_4_Changed(1800000);

  if (appStateResult == 3)
  {
    write("[OTA_007] AppState = 3 (update thanh cong) -> FAIL theo muc tieu case update loi");
    if (gOTA007_AppState17Seen == 1)
      write("[OTA_007] Da bat duoc AppState=17 va da KEY_OFF truoc do");
    else
      write("[OTA_007] Khong bat duoc AppState=17 trong luong cho");

    swVerIsZeroAfter = Check_SWVerMinor3(0);
    owpRecordingOk = Check_RecSta_OWP_Recording();
    networkSleepOk = WaitForNetworkSleep(360);

    CaptureGraphics("OTA", "SMK_TrmnlCtrlGrpStaBDC;BLTN_CAM_RecSta_OWD;BLTN_CAM_SWVerMinor3");
  

    if (swVerIsZeroAfter == 1 && owpRecordingOk == 1 && networkSleepOk == 1)
    {
      testStepFail("Result", "AppState=3 (update thanh cong) -> FAIL theo muc tieu case update loi, du version/OWP Recording/Network Sleep dat");
    }
    else
    {
      testStepFail("Result", "AppState=3 (update thanh cong) -> FAIL theo muc tieu case update loi");
    }
  }
  else if (appStateResult == 4)
  {
    write("[OTA_007] AppState = 4 (update loi) -> xem xet PASS theo tieu chi");
    swVerIsZeroAfter = Check_SWVerMinor3(0);
    owpRecordingOk = Check_RecSta_OWP_Recording();
    networkSleepOk = WaitForNetworkSleep(360);

    CaptureGraphics("OTA", "SMK_TrmnlCtrlGrpStaBDC;BLTN_CAM_RecSta_OWD;BLTN_CAM_SWVerMinor3");
    

    if (swVerIsZeroAfter == 1 && owpRecordingOk == 1 && networkSleepOk == 1)
    {
      testStepPass("Result", "AppState=4 (update loi nhu ky vong), version=0, OWP Recording OK, Network Sleep 6 phut OK -> PASS");
    }
    else
    {
      testStepFail("Result", "AppState=4 nhung version/OWP Recording/Network Sleep khong dat");
    }
  }
  else
  {
    write("[OTA_007] Timeout 30 phut, khong thay AppState doi sang 3/4");
    CaptureGraphics("OTA", "SMK_TrmnlCtrlGrpStaBDC;BLTN_CAM_RecSta_OWD;BLTN_CAM_SWVerMinor3");
   
    testStepFail("Result", "Timeout 30 phut, khong thay AppState doi sang 3/4");
  }

  write("[OTA_007] Ket thuc testcase");
}

void MainTest()
{
  testReportFileName("TestReports\\OTA_007_report");
  OTA_007();
}