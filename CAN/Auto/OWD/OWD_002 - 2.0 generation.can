/*@!Encoding:1252*/

/*
  Test Case: OWD_002
  Title: [Continuous recording while driving] - (2)
  Verification items: Check OWD recording behavior in different UI modes and AIN
  voltage levels

  Preconditions:
    - ACC and IGN and ccNC/ccIC switch OFF, AVN mode

  Step 1: Enter Built-in Cam mode, turn ON OWD recording, check RecSta_OWD = OFF
  Step 2 & 3: Check AIN voltage drops below 4V
  Step 4: Enter Engineer Mode, check LVDS_Mode_State = 0x02, check RecSta_OWD =
  OFF Step 5 & 6: Check AIN voltage drops below 4V Step 7: AVN -> BLTN_CAM (wait
  4s) -> AVN (wait 4s), check RecSta_OWD = ON Step 8: Log screenshot from step 7
  Step 9 & 10: Check AIN voltage rises above 4V
*/

variables {
  long max_wait_time = 180000; // 180 seconds = 3 minutes max wait
  float ain_threshold = 4.0;   // 4V threshold for AIN check

  // Result tracking
  int step1_passed = 0;
  int step2_3_passed = 0;
  int step4_passed = 0;
  int step5_6_passed = 0;
  int step7_passed = 0;
  int step8_passed = 0;
  int step9_10_passed = 0;
  int step11_12_13_14_passed = 0;

  int key_z_pressed = 0; // Flag set by on key 'z' handler

  message HU_BLTN_CAM_PE_00_200ms _HU_BLTN_CAM_PE_00_200ms;
  message HU_BLTN_CAM_E_01 _HU_BLTN_CAM_E_01; // CANFD
  byte rec_sta_owd = 0;
  byte lvds_mode = 0;
}

// Key 'z' handler - sets flag for Step 8 wait
on key 'z' {
  key_z_pressed = 1;
  write(">>> Key 'z' pressed! <<<");
}

// ============================================================================
// Helper Functions
// ============================================================================

// Read AIN voltage from CANoe VN1600 hardware
float Get_AIN_Voltage() {
  float ain_value = 0.0;
  ain_value = @sysvar::IO::VN1600_1::AIN;
  write("  AIN Voltage: %.2f V", ain_value);
  return ain_value;
}

// Enter Built-in Cam mode automatically
void Enter_BLTN_CAM() {
  int i;
  write(">>> Enter BLTN_CAM mode <<<");
  _HU_BLTN_CAM_PE_00_200ms.HU_BLTN_CAM_UI_Mode = 0x1;
  output(_HU_BLTN_CAM_PE_00_200ms);

  for (i = 0; i < 10; i++) {
    testWaitForTimeout(500);
    if (getSignal(BLTN_CAM_HU_UI_Mode) == 0x1) {
      write(">>> [OK] BLTN_CAM mode confirmed <<<");
      return;
    }
  }
  write(">>> [NG] Timeout: BLTN_CAM_HU_UI_Mode = 0x%X <<<",
        getSignal(BLTN_CAM_HU_UI_Mode));
}

// Exit to AVN mode automatically
void Exit_BLTN_CAM() {
  int i;
  write(">>> Exit to AVN mode <<<");
  _HU_BLTN_CAM_PE_00_200ms.HU_BLTN_CAM_UI_Mode = 0x0;
  output(_HU_BLTN_CAM_PE_00_200ms);

  for (i = 0; i < 10; i++) {
    testWaitForTimeout(500);
    if (getSignal(BLTN_CAM_HU_UI_Mode) == 0x0) {
      write(">>> [OK] AVN mode confirmed <<<");
      return;
    }
  }
  write(">>> [NG] Timeout: BLTN_CAM_HU_UI_Mode = 0x%X <<<",
        getSignal(BLTN_CAM_HU_UI_Mode));
}

// Set SMK to IGN (0x2) via panel combo box
void Set_SMK_IGN() {
  write("=== Setting SMK to IGN (0x2) via panel ===");
  setSignal(SMK_TrmnlCtrlGrpStaBDC, 0x2); // IGN
  testWaitForTimeout(2000);
  write("  SMK_TrmnlCtrlGrpStaBDC = 0x%X (IGN)", $SMK_TrmnlCtrlGrpStaBDC);
}

// Click USM Reset button on panel
void Click_USM_Reset() {
  write("=== Clicking USM Reset button on panel ===");
  @panel::Button_USMReset = 1;
  testWaitForTimeout(5000);
  write("  USM Reset clicked");
}

// Click Rec Reset button on panel
void Click_Rec_Reset() {
  write("=== Clicking Rec Reset button on panel ===");
  @panel::Button_RecReset = 1;
  testWaitForTimeout(2000);
  write("  Rec Reset clicked");
}

// Turn ON OWD via panel (must be in Built-in Cam mode)
void Turn_ON_OWD() {
  int retry = 0;

  write("=== Turn ON OWD via panel ===");
  write("Setting OWD to ON...");

  while ($BLTN_CAM_RecSet_OWD != 0x2 && retry < 10) {
    @panel::LED_Ctrl_SetOWD = 1;
    testWaitForTimeout(2000);
    write("  Attempt %d: RecSet_OWD=0x%X", retry + 1, $BLTN_CAM_RecSet_OWD);
    retry++;
  }

  if ($BLTN_CAM_RecSet_OWD == 0x2)
    write(">>> SUCCESS: OWD = ON (0x2) <<<");
  else
    write(">>> FAILED: Could not set OWD to ON <<<");
}

// Enter Engineer Mode by sending BLTN_CAM_LVDS_Mode_Cmd = 0x2 directly
int Enter_Engineer_Mode(long timeout_ms) {
  long elapsed = 0;
  long log_interval;
  byte lvds_mode = 0;
  int i;

  write("=== Entering Engineer Mode via signal ===");

  // Send Engineer Mode command directly
  for (i = 0; i < 8; i++) {
    _HU_BLTN_CAM_E_01.byte(i) = 0xFF;
  }
  _HU_BLTN_CAM_E_01.BLTN_CAM_LVDS_Mode_Cmd = 0x2;
  output(_HU_BLTN_CAM_E_01);

  write("Waiting for Engineer Mode confirmation (LVDS_Mode_State = 0x02)...");

  log_interval = (timeout_ms / 6 / 500) * 500;
  if (log_interval < 500)
    log_interval = 500;

  while (elapsed < timeout_ms) {
    lvds_mode = $BLTN_CAM_LVDS_Mode_State;

    if (lvds_mode == 0x02) {
      write(">>> Now in Engineer Mode! LVDS_Mode_State = 0x02 <<<");
      return 1;
    }

    if (elapsed == 0 || elapsed % log_interval == 0) {
      write("  [%d s] LVDS_Mode_State=0x%X (waiting for 0x02)", elapsed / 1000,
            lvds_mode);
      // Resend command
      for (i = 0; i < 8; i++) {
        _HU_BLTN_CAM_E_01.byte(i) = 0xFF;
      }
      _HU_BLTN_CAM_E_01.BLTN_CAM_LVDS_Mode_Cmd = 0x2;
      output(_HU_BLTN_CAM_E_01);
    }

    testWaitForTimeout(500);
    elapsed += 500;
  }

  write(">>> Timeout! Could not enter Engineer Mode <<<");
  return 0;
}

// Check AIN voltage below threshold
int Check_AIN_Below_Threshold(float threshold, long timeout_ms) {
  long elapsed = 0;
  long log_interval;
  float ain_voltage = 0.0;

  write("Checking AIN voltage below %.1f V... (max %d seconds)", threshold,
        timeout_ms / 1000);

  log_interval = (timeout_ms / 6 / 1000) * 1000;
  if (log_interval < 1000)
    log_interval = 1000;

  while (elapsed < timeout_ms) {
    ain_voltage = Get_AIN_Voltage();

    if (ain_voltage < threshold) {
      write(">>> PASS: AIN = %.2f V < %.1f V <<<", ain_voltage, threshold);
      return 1;
    }

    if (elapsed == 0 || elapsed % log_interval == 0) {
      write("  [%d s] AIN=%.2f V (waiting for < %.1f V)", elapsed / 1000,
            ain_voltage, threshold);
    }

    testWaitForTimeout(1000);
    elapsed += 1000;
  }

  write(">>> Timeout! AIN = %.2f V still >= %.1f V <<<", ain_voltage,
        threshold);
  return 0;
}

// Check AIN voltage above threshold
int Check_AIN_Above_Threshold(float threshold, long timeout_ms) {
  long elapsed = 0;
  long log_interval;
  float ain_voltage = 0.0;

  write("Checking AIN voltage above %.1f V... (max %d seconds)", threshold,
        timeout_ms / 1000);

  log_interval = (timeout_ms / 6 / 1000) * 1000;
  if (log_interval < 1000)
    log_interval = 1000;

  while (elapsed < timeout_ms) {
    ain_voltage = Get_AIN_Voltage();

    if (ain_voltage > threshold) {
      write(">>> PASS: AIN = %.2f V > %.1f V <<<", ain_voltage, threshold);
      return 1;
    }

    if (elapsed == 0 || elapsed % log_interval == 0) {
      write("  [%d s] AIN=%.2f V (waiting for > %.1f V)", elapsed / 1000,
            ain_voltage, threshold);
    }

    testWaitForTimeout(1000);
    elapsed += 1000;
  }

  write(">>> Timeout! AIN = %.2f V still <= %.1f V <<<", ain_voltage,
        threshold);
  return 0;
}

// Capture graph window screenshot
void CaptureGraphics(char signalList[]) {
  testWaitForTimeout(3000);
  testReportAddWindowCapture("OWD", signalList, "Screenshot");
  write(">>> Screenshot captured <<<");
}

// ============================================================================
// Main Test Case
// ============================================================================

testcase OWD_002_Init() {
  write("========================================");
  write("=== START TEST OWD_002 ===");
  write("========================================");

  @panel::Switch_CGWNM = 1;
  testWaitForTimeout(3000);

  // Set initial conditions
  Set_SMK_IGN();
  Click_USM_Reset();
  Click_Rec_Reset();
}

testcase OWD_002_1() {
  //============================================================================
  // STEP 1: Enter Built-in Cam mode, turn ON OWD, check RecSta_OWD = OFF (0x0)
  //============================================================================
  write("");
  write("=== STEP 1: Enter Built-in Cam mode, turn ON OWD, check RecSta_OWD = "
        "OFF ===");

  Enter_BLTN_CAM();
  Turn_ON_OWD();
  testWaitForTimeout(2000);

  rec_sta_owd = $BLTN_CAM_RecSta_OWD;
  write("BLTN_CAM_RecSta_OWD = 0x%X", rec_sta_owd);

  if (rec_sta_owd == 0x0) {
    write(">>> PASS: RecSta_OWD = 0x0 (OFF) <<<");
    testStepPass("Step1", "RecSta_OWD = 0x0 (OFF) - PASS");
    step1_passed = 1;
  } else {
    write(">>> FAIL: RecSta_OWD = 0x%X, expected 0x0 (OFF) <<<", rec_sta_owd);
    testStepFail("Step1", "RecSta_OWD = 0x%X, expected 0x0 - FAIL",
                 rec_sta_owd);
    step1_passed = 0;
  }

  CaptureGraphics(
      "BLTN_CAM_RecSet_OWD;BLTN_CAM_RecSta_OWD;BLTN_CAM_HU_UI_Mode");
}

testcase OWD_002_2_3() {
  //============================================================================
  // STEP 2 & 3: Check AIN voltage drops below 4V
  //============================================================================
  write("");
  write("=== STEP 2 & 3: Check AIN voltage drops below 4V ===");

  if (Check_AIN_Below_Threshold(ain_threshold, max_wait_time) == 1) {
    testStepPass("Step2", "AIN dropped below 4V - PASS");
    testStepPass("Step3", "AIN dropped below 4V - PASS");
    step2_3_passed = 1;
  } else {
    testStepFail("Step2", "AIN did not drop below 4V - FAIL");
    testStepFail("Step3", "AIN did not drop below 4V - FAIL");
    step2_3_passed = 0;
  }

  CaptureGraphics(
      "AIN;BLTN_CAM_RecSta_OWD;HU_BLTN_CAM_UI_Mode;BLTN_CAM_HU_UI_Mode");
}

testcase OWD_002_4() {
  //============================================================================
  // STEP 4: Enter Engineer Mode, check LVDS_Mode_State = 0x02, check RecSta_OWD
  // = OFF
  //============================================================================
  write("");
  write("=== STEP 4: Enter Engineer Mode, check LVDS_Mode_State = 0x02, check "
        "RecSta_OWD = OFF ===");

  // Ensure in Built-in Cam mode first
  if ($BLTN_CAM_HU_UI_Mode != 0x1) {
    Enter_BLTN_CAM();
  }

  if (Enter_Engineer_Mode(30000) == 1) {
    lvds_mode = $BLTN_CAM_LVDS_Mode_State;
    write("BLTN_CAM_LVDS_Mode_State = 0x%X", lvds_mode);

    if (lvds_mode == 0x02) {
      write(">>> Engineer Mode confirmed! <<<");

      rec_sta_owd = $BLTN_CAM_RecSta_OWD;
      write("BLTN_CAM_RecSta_OWD = 0x%X", rec_sta_owd);

      if (rec_sta_owd == 0x0 || rec_sta_owd == 0x1) {
        write(">>> PASS: RecSta_OWD = 0x%X (OFF) in Engineer Mode <<<",
              rec_sta_owd);
        testStepPass("Step4",
                     "Engineer Mode (LVDS=0x02), RecSta_OWD=OFF - PASS");
        step4_passed = 1;
      } else {
        write(">>> FAIL: RecSta_OWD = 0x%X in Engineer Mode, expected OFF <<<",
              rec_sta_owd);
        testStepFail("Step4",
                     "RecSta_OWD should be OFF in Engineer Mode - FAIL");
        step4_passed = 0;
      }
    } else {
      testStepFail("Step4", "LVDS_Mode_State = 0x%X, expected 0x02 - FAIL",
                   lvds_mode);
      step4_passed = 0;
    }
  } else {
    testStepFail("Step4", "Failed to enter Engineer Mode - FAIL");
    step4_passed = 0;
  }

  CaptureGraphics(
      "BLTN_CAM_LVDS_Mode_State;BLTN_CAM_RecSta_OWD;BLTN_CAM_HU_UI_Mode");
}

testcase OWD_002_5_6() {
  //============================================================================
  // STEP 5 & 6: Check AIN voltage drops below 4V
  //============================================================================
  write("");
  write("=== STEP 5 & 6: Check AIN voltage drops below 4V ===");

  if (Check_AIN_Below_Threshold(ain_threshold, max_wait_time) == 1) {
    testStepPass("Step5", "AIN dropped below 4V - PASS");
    testStepPass("Step6", "AIN dropped below 4V - PASS");
    step5_6_passed = 1;
  } else {
    testStepFail("Step5", "AIN did not drop below 4V - FAIL");
    testStepFail("Step6", "AIN did not drop below 4V - FAIL");
    step5_6_passed = 0;
  }

  CaptureGraphics(
      "AIN;BLTN_CAM_RecSta_OWD;HU_BLTN_CAM_UI_Mode;BLTN_CAM_HU_UI_Mode");
}

testcase OWD_002_7() {
  //============================================================================
  // STEP 7: AVN -> BLTN_CAM (wait 4s) -> AVN (wait 4s), check RecSta_OWD = ON
  //============================================================================
  write("");
  write("=== STEP 7: AVN -> BLTN_CAM (4s) -> AVN (4s), check RecSta_OWD = ON "
        "===");

  // Ensure in AVN home first
  Exit_BLTN_CAM();

  // Enter Built-in Cam mode
  Enter_BLTN_CAM();
  write("In Built-in Cam mode. Waiting 4 seconds...");
  testWaitForTimeout(4000);

  // Return to AVN
  Exit_BLTN_CAM();
  write("In AVN home. Waiting 4 seconds...");
  testWaitForTimeout(4000);

  // Check RecSta_OWD should be ON
  rec_sta_owd = $BLTN_CAM_RecSta_OWD;
  write("BLTN_CAM_RecSta_OWD = 0x%X", rec_sta_owd);

  if (rec_sta_owd == 0x1) {
    write(">>> PASS: RecSta_OWD = 0x1 (ON) <<<");
    testStepPass("Step7", "RecSta_OWD = 0x1 (ON) - PASS");
    step7_passed = 1;
  } else {
    write(">>> FAIL: RecSta_OWD = 0x%X, expected 0x1 (ON) <<<", rec_sta_owd);
    testStepFail("Step7", "RecSta_OWD = 0x%X, expected 0x1 - FAIL",
                 rec_sta_owd);
    step7_passed = 0;
  }

  CaptureGraphics("BLTN_CAM_RecSta_OWD;HU_BLTN_CAM_UI_Mode;BLTN_CAM_HU_UI_Mode;"
                  "BLTN_CAM_State");
}

testcase OWD_002_8() {
  //============================================================================
  // STEP 8: Enter BLTN_CAM, wait for key 'z', exit to AVN, check RecSta_OWD =
  // ON
  //============================================================================
  write("");
  write("=== STEP 8: Enter BLTN_CAM, wait for key z, exit to AVN, check "
        "RecSta_OWD = ON ===");
  testStep("Step8",
           "Enter BLTN_CAM, wait for key z then exit, verify RecSta_OWD = ON");

  Enter_BLTN_CAM();

  write("*************************************************************");
  write("*** lay dien thoai ra de kiem tra thoi gian bat dau ghi   ***");
  write("*** ke tu khi thoat khoi man hinh build in cam,           ***");
  write("*** roi nhan phim z la bat dau quay                       ***");
  write("*************************************************************");

  // Reset flag and wait for key 'z' (max 5 minutes = 300000ms)
  key_z_pressed = 0;
  {
    long elapsed_z = 0;
    long max_z = 300000; // 5 minutes

    while (elapsed_z < max_z && key_z_pressed == 0) {
      testWaitForTimeout(500);
      elapsed_z += 500;
    }

    if (key_z_pressed == 1) {
      write(">>> Key 'z' detected! Exiting to AVN immediately... <<<");

      // Immediately exit to AVN
      Exit_BLTN_CAM();

      // Wait 5 seconds
      write("Waiting 5 seconds at AVN...");
      testWaitForTimeout(5000);

      // Check RecSta_OWD = ON
      rec_sta_owd = $BLTN_CAM_RecSta_OWD;
      write("BLTN_CAM_RecSta_OWD = 0x%X", rec_sta_owd);

      if (rec_sta_owd == 0x1) {
        write(">>> PASS: RecSta_OWD = 0x1 (ON) <<<");
        testStepPass("Step8", "RecSta_OWD = ON after exit BLTN_CAM - PASS");
        step8_passed = 1;
      } else {
        write(">>> FAIL: RecSta_OWD = 0x%X, expected 0x1 (ON) <<<",
              rec_sta_owd);
        testStepFail("Step8", "RecSta_OWD = 0x%X, expected ON - FAIL",
                     rec_sta_owd);
        step8_passed = 0;
      }
    } else {
      write(">>> Timeout! Key 'z' not pressed within 5 minutes <<<");
      testStepFail("Step8", "Timeout waiting for key z - FAIL");
      step8_passed = 0;
    }
  }

  CaptureGraphics("BLTN_CAM_RecSta_OWD;HU_BLTN_CAM_UI_Mode;BLTN_CAM_HU_UI_Mode;"
                  "BLTN_CAM_State");
}

testcase OWD_002_9_10() {
  //============================================================================
  // STEP 9 & 10: Check AIN voltage rises above 4V
  //============================================================================
  write("");
  write("=== STEP 9 & 10: Check AIN voltage rises above 4V ===");

  if (Check_AIN_Above_Threshold(ain_threshold, max_wait_time) == 1) {
    testStepPass("Step9", "AIN rose above 4V - PASS");
    testStepPass("Step10", "AIN rose above 4V - PASS");
    step9_10_passed = 1;
  } else {
    testStepFail("Step9", "AIN did not rise above 4V - FAIL");
    testStepFail("Step10", "AIN did not rise above 4V - FAIL");
    step9_10_passed = 0;
  }

  CaptureGraphics(
      "AIN;BLTN_CAM_RecSta_OWD;HU_BLTN_CAM_UI_Mode;BLTN_CAM_HU_UI_Mode");
}

testcase OWD_002_11_14() {
  //============================================================================
  // STEP 11-14: Log "copy" - using same logic as Step 8
  //============================================================================
  write("");
  write("=== STEP 11-14: Copy Step 8 logic ===");
  testStepPass("Step11", "Copy Step 8 logic - PASS");
  testStepPass("Step12", "Copy Step 8 logic - PASS");
  testStepPass("Step13", "Copy Step 8 logic - PASS");
  testStepPass("Step14", "Copy Step 8 logic - PASS");
  step11_12_13_14_passed = 1;
}

testcase OWD_002_Summary() {
  //============================================================================
  // Overall Test Verdict
  //============================================================================
  if (step1_passed == 1 && step2_3_passed == 1 && step4_passed == 1 &&
      step5_6_passed == 1 && step7_passed == 1 && step8_passed == 1 &&
      step9_10_passed == 1 && step11_12_13_14_passed == 1) {
    testStepPass("Overall_Verdict", "Test OWD_002: PASS");
    write("=== OVERALL VERDICT: PASS ===");
  } else {
    testStepFail("Overall_Verdict", "Test OWD_002: FAIL");
    write("=== OVERALL VERDICT: FAIL ===");
  }

  //============================================================================
  // SUMMARY
  //============================================================================
  write("");
  write("=== TEST SUMMARY ===");
  if (step1_passed)
    write("Step 1: Enter BLTN_CAM, turn ON OWD, check RecSta_OWD = OFF: PASS");
  else
    write("Step 1: Enter BLTN_CAM, turn ON OWD, check RecSta_OWD = OFF: FAIL");
  if (step2_3_passed)
    write("Step 2-3: AIN voltage below 4V check: PASS");
  else
    write("Step 2-3: AIN voltage below 4V check: FAIL");
  if (step4_passed)
    write("Step 4: Engineer Mode, check LVDS_Mode_State = 0x02, RecSta_OWD = "
          "OFF: PASS");
  else
    write("Step 4: Engineer Mode, check LVDS_Mode_State = 0x02, RecSta_OWD = "
          "OFF: FAIL");
  if (step5_6_passed)
    write("Step 5-6: AIN voltage below 4V check: PASS");
  else
    write("Step 5-6: AIN voltage below 4V check: FAIL");
  if (step7_passed)
    write("Step 7: AVN->BLTN_CAM(4s)->AVN(4s), RecSta_OWD = ON: PASS");
  else
    write("Step 7: AVN->BLTN_CAM(4s)->AVN(4s), RecSta_OWD = ON: FAIL");
  if (step8_passed)
    write("Step 8: Enter BLTN_CAM, key z -> exit AVN, RecSta_OWD = ON: PASS");
  else
    write("Step 8: Enter BLTN_CAM, key z -> exit AVN, RecSta_OWD = ON: FAIL");
  if (step9_10_passed)
    write("Step 9-10: AIN voltage above 4V check: PASS");
  else
    write("Step 9-10: AIN voltage above 4V check: FAIL");
  if (step11_12_13_14_passed)
    write("Step 11-14: Repeat key z sequence 4 times: PASS");
  else
    write("Step 11-14: Repeat key z sequence 4 times: FAIL");

  @panel::Switch_CGWNM = 0;

  write("");
  write("========================================");
  write("=== END TEST OWD_002 ===");
  write("========================================");
}

void MainTest() {
  testReportFileName("TestReports\\OWD_002 - 2.0 generation_report");
  OWD_002_Init();
  OWD_002_1();
  OWD_002_2_3();
  OWD_002_4();
  OWD_002_5_6();
  OWD_002_7();
  OWD_002_8();
  OWD_002_9_10();
  OWD_002_11_14();
  OWD_002_Summary();
}
