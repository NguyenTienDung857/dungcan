/*@!Encoding:65001*/

/*
  Test Case: OWD_005
  Title: [OWD Recording Test - Multi-mode with Voltage Control]
  Verification items: Check OWD/TML/DEV/MAR recording behavior and voltage
  control

  Preconditions:
    - ACC and IGN and ccNC/ccIC switch OFF, AVN mode
    - Power supply connected via COM3

  Step 1: Set SMK to IGN, click USM Reset, check BLTN_CAM_RecSet_OWD = 0x2 (ON)
  Step 2: Switch to HU UI mode (HU_BLTN_CAM_UI_Mode=0), click TML Start, check
  BLTN_CAM_RecSta_TML = 0x1 Step 3: Click Evt Switch, check BLTN_CAM_RecSta_MAR
  = 0x1 Step 4: Wait for BLTN_CAM_RecSta_DEV = 0x1 (event while driving) Step 5:
  Click TMLStop, check BLTN_CAM_RecSta_TML = 0x0, wait 65s, verify DEV recording
  Step 6: Enter/Exit Built-in Cam mode 5 times, verify HU_BLTN_CAM_UI_Mode
  Step 7: Log video verification
  Step 8: Set voltage to 9V via COM3, wait 60s at AVN mode
  Step 9: Set voltage to 16V via COM3, wait 60s at AVN mode

  NOTE: Script uses panel controls and RS232 for power supply control.
*/

variables {
  long max_wait_time = 180000; // 180 seconds = 3 minutes max wait

  // Power supply settings
  int rs232_PortNum = 3;    // COM3
  int PowerSupplyModel = 1; // 0=OPE305QI, 1=TL305TP, 2=GPP2323

  // Power supply model definitions
  enum Model_PowerSupply { OPE305QI = 0x0, TL305TP = 0x1, GPP2323 = 0x2 };

  // Message declarations
  // CAN Message Declaration
  message HU_BLTN_CAM_PE_00_200ms _HU_BLTN_CAM_PE_00_200ms;

  // RS232 send buffer
  int messageIndex = 0;
  char buffer[3][50];
  char initvalue[50];

  // Result tracking for TEST SUMMARY
  int step1_passed = 0;
  int step2_passed = 0;
  int step3_passed = 0;
  int step4_passed = 0;
  int step5_passed = 0;
  int step6_passed = 0;
  int step7_passed = 0;
  int step8_passed = 0;
  int step9_passed = 0;
}

// ============================================================================
// RS232 Helper Functions for Power Supply Control
// ============================================================================

void Rs232SendString(int port, int model, char text[]) {
  byte sendBuffer[50];
  int i;
  int length;
  length = strlen(text);

  // Initialize buffer
  for (i = 0; i < length; i++)
    sendBuffer[i] = 0;

  // char to byte
  for (i = 0; i < length; i++)
    sendBuffer[i] = text[i];

  // Add line feed for OPE305QI and GPP2323
  if ((model == OPE305QI) || (model == GPP2323)) {
    sendBuffer[length] = 0xA; // Line Feed
    if (1 == RS232Send(port, sendBuffer, length + 1))
      write("RS232 Send: %s", text);
  } else if (model == TL305TP) {
    if (1 == RS232Send(port, sendBuffer, length))
      write("RS232 Send: %s", text);
  }
}

void string_PLUS_double(char inputString[], double inputValue,
                        char outputString[]) {
  char STRING[50];
  char tempBuffer[50];

  snprintf(outputString, 50, "%s", initvalue);
  snprintf(STRING, 50, "%s", inputString);

  snprintf(tempBuffer, elcount(tempBuffer), "%.1f", inputValue);

  snprintf(outputString, 50, "%s%s", STRING, tempBuffer);
}

// Initialize RS232 connection
int Init_PowerSupply() {
  write("=== Initializing Power Supply on COM%d ===", rs232_PortNum);

  if (RS232Open(rs232_PortNum)) {
    if (rs232Configure(rs232_PortNum, 9600, 8, 1, 0)) {
      write(">>> Power Supply connected successfully <<<");
      return 1;
    } else {
      write(">>> Power Supply configuration failed <<<");
      return 0;
    }
  } else {
    write(">>> Failed to open COM%d <<<", rs232_PortNum);
    return 0;
  }
}

// Close RS232 connection
void Close_PowerSupply() {
  write("=== Closing Power Supply connection ===");
  RS232Close(rs232_PortNum);
  write(">>> Power Supply disconnected <<<");
}

// Set power supply voltage on CH2
void Set_Voltage(double voltage) {
  write("=== Setting voltage to %.1f V on CH2 ===", voltage);

  switch (PowerSupplyModel) {
  case OPE305QI:
    // Select CH2 for OPE305QI
    snprintf(buffer[0], 11, "%s", "INST OUTP2");
    string_PLUS_double("VOLT ", voltage, buffer[1]);
    snprintf(buffer[2], 7, "%s", "CURR 5");

    Rs232SendString(rs232_PortNum, OPE305QI, buffer[0]);
    testWaitForTimeout(200);
    Rs232SendString(rs232_PortNum, OPE305QI, buffer[1]);
    testWaitForTimeout(200);
    Rs232SendString(rs232_PortNum, OPE305QI, buffer[2]);
    testWaitForTimeout(200);
    break;

  case TL305TP: {
    // CH2 for TL305TP: SET:001 (0=CH1, 1=CH2)
    char cmd[50];
    snprintf(cmd, 50, "SET:001,VS:%05.2f,IS:5.00/n", voltage);
    Rs232SendString(rs232_PortNum, TL305TP, cmd);
    testWaitForTimeout(200);
  } break;

  case GPP2323: {
    // CH2 for GPP2323: VSET2
    char voltCmd[50];
    string_PLUS_double("VSET2:", voltage, voltCmd);
    Rs232SendString(rs232_PortNum, GPP2323, voltCmd);
    testWaitForTimeout(200);
  } break;
  }

  testWaitForTimeout(1000); // Wait 1s for voltage stabilization
  write(">>> Voltage set to %.1f V on CH2 <<<", voltage);
}

// Turn ON power supply output (CH2)
void PowerSupply_OutputON() {
  write("=== Turning Power Supply Output ON (CH2) ===");

  switch (PowerSupplyModel) {
  case OPE305QI:
    // First select CH2, then turn on output
    Rs232SendString(rs232_PortNum, OPE305QI, "INST OUTP2");
    testWaitForTimeout(200);
    Rs232SendString(rs232_PortNum, OPE305QI, "OUTP ON");
    break;
  case TL305TP:
    // CH2 output for TL305TP
    Rs232SendString(rs232_PortNum, TL305TP, "OUTPUT1/n");
    break;
  case GPP2323:
    // For GPP2323, turn on all outputs
    Rs232SendString(rs232_PortNum, GPP2323, "ALLOUTON");
    break;
  }
  testWaitForTimeout(500);
}

// ============================================================================
// Panel Control Helper Functions
// ============================================================================

// Set SMK to IGN (0x4)
void Set_SMK_IGN() {
  write("=== Setting SMK to IGN (0x4) ===");
  setSignal(SMK_TrmnlCtrlGrpStaBDC, 0x4);
  testWaitForTimeout(2000); // Wait 2s for signal propagation
  write("  SMK_TrmnlCtrlGrpStaBDC = 0x%X", $SMK_TrmnlCtrlGrpStaBDC);
}

// Set SMK to OFF (0x0)
void Set_SMK_OFF() {
  write("=== Setting SMK to OFF (0x0) ===");
  setSignal(SMK_TrmnlCtrlGrpStaBDC, 0x0);
  testWaitForTimeout(2000); // Wait 2s for signal propagation
  write("  SMK_TrmnlCtrlGrpStaBDC = 0x%X", $SMK_TrmnlCtrlGrpStaBDC);
}

void Click_USM_Reset() {
  write("=== Clicking USM Reset button on panel ===");
  @panel::Button_USMReset = 1;
  testWaitForTimeout(5000);
  write("  USM Reset clicked");
}

// Click Rec Reset button on panel
void Click_Rec_Reset() {
  write("=== Clicking Rec Reset button on panel ===");
  @panel::Button_RecReset = 1;
  testWaitForTimeout(2000);
  write("  Rec Reset clicked");
}

void Click_TML_Start() {
  write("=== Clicking TML Start button on panel ===");
  @panel::Button_Timelaps_Start = 0;
  testWaitForTimeout(500);
  @panel::Button_Timelaps_Start = 1;
  testWaitForTimeout(3000);
  write("  TML Start clicked");
}

void Click_TML_Stop() {
  write("=== Clicking TML Stop button on panel ===");
  @panel::Button_Timelaps_Stop = 0;
  testWaitForTimeout(500);
  @panel::Button_Timelaps_Stop = 1;
  testWaitForTimeout(3000);
  write("  TML Stop clicked");
}

// Click Event Switch button (Manual Event Recording)
void Click_Evt_Switch() {
  write("=== Clicking Event Switch button ===");
  @panel::Button_SwitchEvt = 0;
  testWaitForTimeout(500);
  @panel::Button_SwitchEvt = 1;
  testWaitForTimeout(3000);
  write("  Event Switch clicked");
}

// Enter Built-in Cam mode
void Enter_BLTN_CAM() {
  int i;
  write(">>> Enter BLTN_CAM mode <<<");
  _HU_BLTN_CAM_PE_00_200ms.HU_BLTN_CAM_UI_Mode = 0x1;
  output(_HU_BLTN_CAM_PE_00_200ms);

  for (i = 0; i < 10; i++) {
    testWaitForTimeout(500);
    if (getSignal(BLTN_CAM_HU_UI_Mode) == 0x1) {
      write(">>> [OK] BLTN_CAM mode confirmed <<<");
      return;
    }
  }
  write(">>> [NG] Timeout: BLTN_CAM_HU_UI_Mode = 0x%X <<<",
        getSignal(BLTN_CAM_HU_UI_Mode));
}

// Exit Built-in Cam mode (Return to AVN)
void Exit_BLTN_CAM() {
  int i;
  write(">>> Exit to AVN mode <<<");
  _HU_BLTN_CAM_PE_00_200ms.HU_BLTN_CAM_UI_Mode = 0x0;
  output(_HU_BLTN_CAM_PE_00_200ms);

  for (i = 0; i < 10; i++) {
    testWaitForTimeout(500);
    if (getSignal(BLTN_CAM_HU_UI_Mode) == 0x0) {
      write(">>> [OK] AVN mode confirmed <<<");
      return;
    }
  }
  write(">>> [NG] Timeout: BLTN_CAM_HU_UI_Mode = 0x%X <<<",
        getSignal(BLTN_CAM_HU_UI_Mode));
}

// Turn ON OWD via panel (Continuous driving recording)
void Turn_ON_OWD() {
  int retry = 0;
  write("=== Turn ON OWD via panel ===");

  while ($BLTN_CAM_RecSet_OWD != 0x2 && retry < 10) {
    @panel::LED_Ctrl_SetOWD = 1;
    testWaitForTimeout(2000);
    write("  Attempt %d: RecSet_OWD=0x%X", retry + 1, $BLTN_CAM_RecSet_OWD);
    retry++;
  }

  if ($BLTN_CAM_RecSet_OWD == 0x2)
    write(">>> SUCCESS: OWD = ON (0x2) <<<");
  else
    write(">>> FAILED: Could not set OWD to ON <<<");
}

// Turn ON OWP via panel (Time Lapse parking recording)
void Turn_ON_OWP() {
  int retry = 0;
  write("=== Turn ON OWP via panel (Time Lapse Parking) ===");

  // Requires SMK OFF First
  setSignal(SMK_TrmnlCtrlGrpStaBDC, 0x0);
  testWaitForTimeout(2000);

  while ($BLTN_CAM_RecSet_OWP != 0x2 && retry < 10) {
    @panel::LED_Ctrl_SetOWP = 1;
    testWaitForTimeout(2000);
    write("  Attempt %d: RecSet_OWP=0x%X", retry + 1, $BLTN_CAM_RecSet_OWP);
    retry++;
  }

  // Restore SMK IGN
  setSignal(SMK_TrmnlCtrlGrpStaBDC, 0x4);
  testWaitForTimeout(2000);

  if ($BLTN_CAM_RecSet_OWP == 0x2)
    write(">>> SUCCESS: OWP = ON (0x2) <<<");
  else
    write(">>> FAILED: Could not set OWP to ON <<<");
}

// Trigger Manual Recording (DEV) - prompt user to manually trigger
void Trigger_DEV() {
  int retry = 0;
  write("");
  write("*************************************************************");
  write("*** MANUAL ACTION REQUIRED: Please trigger DEV event now! ***");
  write("*** (e.g. press manual recording button on device)          ***");
  write("*** Waiting up to 20 seconds for DEV to start...           ***");
  write("*************************************************************");
  write("");

  while ($BLTN_CAM_RecSta_DEV != 0x1 && retry < 20) {
    testWaitForTimeout(1000);
    retry++;
  }

  if ($BLTN_CAM_RecSta_DEV == 0x1)
    write(">>> SUCCESS: DEV Recording triggered (RecSta_DEV = 0x1) <<<");
  else
    write(">>> FAILED: DEV Recording not triggered within 20s <<<");
}

// Trigger Event Recording (PEV) via CAN signal
void Trigger_PEV() {
  write("=== Triggering Event Recording (PEV) via signal ===");
  // Typically triggered by high G-sensor or crash signal
  // $ACU_CrashOutputStaMsgAliveCnt = 0x1;  // Signal not available
  // testWaitForTimeout(2000);
  // $ACU_CrashOutputStaMsgAliveCnt = 0x0;

  if ($BLTN_CAM_RecSta_PEV == 0x1)
    write(">>> SUCCESS: PEV Recording triggered (RecSta_PEV = 0x1) <<<");
  else
    write(">>> FAILED: PEV Recording not triggered <<<");
}

// Capture graph window screenshot
void CaptureGraphics(char signalList[]) {
  testWaitForTimeout(3000);
  testReportAddWindowCapture("OWD", signalList, "Screenshot");
  write(">>> Screenshot captured <<<");
}

// Check RecSta_OWD = 0x1 (ON) after 30 seconds
int Verify_OWD_Recording(long seconds) {
  long elapsed = 0;
  byte rec_sta = 0;

  write("=== Waiting %d seconds then verifying OWD Recording ===", seconds);

  while (elapsed < (seconds * 1000)) {
    testWaitForTimeout(1000);
    elapsed += 1000;

    if (elapsed % 10000 == 0) // Log every 10s
    {
      write("  Elapsed: %d s", elapsed / 1000);
    }
  }

  rec_sta = $BLTN_CAM_RecSta_OWD;
  write("  BLTN_CAM_RecSta_OWD = 0x%X", rec_sta);

  if (rec_sta == 0x1) {
    write(">>> PASS: OWD Recording is ON <<<");
    return 1;
  } else {
    write(">>> FAIL: OWD Recording is NOT ON <<<");
    return 0;
  }
}

// ============================================================================
// Main Test Case
// ============================================================================

testcase OWD_005_Init() {
  write("========================================");
  write("=== START TEST OWD_005 ===");
  write("========================================");

  // Initialize Power Supply
  if (0 == Init_PowerSupply()) {
    write(">>> ERROR: Failed to configure Power Supply on COM%d. <<<",
          rs232_PortNum);
  }

  // Enable CGW NM
  @panel::Switch_CGWNM = 1;
  testWaitForTimeout(3000);
}

testcase OWD_005_1() {
  write("");
  write("===================================================================");
  write("=== STEP 1: Set SMK to IGN, click USM Reset, check RecSet_OWD ===");
  write("===================================================================");
  testStep("Step1", "Boot check RecSet_OWD");

  Set_SMK_IGN();
  Click_USM_Reset();

  write("Waiting 10s for boot...");
  testWaitForTimeout(10000);

  if ($BLTN_CAM_RecSet_OWD == 0x2) {
    step1_passed = 1;
    testStepPass("Step1", "BLTN_CAM_RecSet_OWD is ON (0x2)");
  } else {
    step1_passed = 0;
    testStepFail("Step1", "BLTN_CAM_RecSet_OWD is NOT ON");
  }

  CaptureGraphics("BLTN_CAM_RecSet_OWD");
}

testcase OWD_005_2() {
  write("");
  write("===================================================================");
  write("=== STEP 2: Switch to HU UI mode = 0, click TML Start ===");
  write("===================================================================");
  testStep("Step2", "Start TML recording in AVN mode");

  Exit_BLTN_CAM(); // Switch to AVN mode

  write("Wait 3s, then Click TML Start...");
  testWaitForTimeout(3000);
  Click_TML_Start();

  write("Verifying TML status...");
  testWaitForTimeout(5000);

  if ($BLTN_CAM_RecSta_TML == 0x1) {
    step2_passed = 1;
    testStepPass("Step2", "BLTN_CAM_RecSta_TML is Recording (0x1)");
  } else {
    step2_passed = 0;
    testStepFail("Step2", "BLTN_CAM_RecSta_TML is NOT Recording");
  }

  CaptureGraphics("BLTN_CAM_RecSta_TML");
}

testcase OWD_005_3() {
  write("");
  write("===================================================================");
  write("=== STEP 3: Click Evt Switch, check BLTN_CAM_RecSta_MAR ===");
  write("===================================================================");
  testStep("Step3", "Trigger MAR recording");

  Click_Evt_Switch();

  write("Verifying MAR status...");
  testWaitForTimeout(5000);

  if ($BLTN_CAM_RecSta_MAR == 0x1) {
    step3_passed = 1;
    testStepPass("Step3", "BLTN_CAM_RecSta_MAR is Recording (0x1)");
  } else {
    step3_passed = 0;
    testStepFail("Step3", "BLTN_CAM_RecSta_MAR is NOT Recording");
  }

  CaptureGraphics("BLTN_CAM_RecSta_MAR");
}

testcase OWD_005_4() {
  int retry = 0;
  write("");
  write("===================================================================");
  write("=== STEP 4: Wait for BLTN_CAM_RecSta_DEV = 0x1 ===");
  write("===================================================================");
  testStep("Step4", "Verify DEV recording");

  write("Waiting up to 20s for Event Recording (DEV) to start...");
  while ($BLTN_CAM_RecSta_DEV != 0x1 && retry < 200) {
    testWaitForTimeout(1000);
    retry++;
    write("retry = %d", retry);
  }

  if ($BLTN_CAM_RecSta_DEV == 0x1) {
    write("pass BLTN_CAM_RecSta_DEV = 0x%X", $BLTN_CAM_RecSta_DEV);
    step4_passed = 1;
    testStepPass("Step4", "BLTN_CAM_RecSta_DEV is Recording (0x1)");
  } else {
    write("fail BLTN_CAM_RecSta_DEV = 0x%X", $BLTN_CAM_RecSta_DEV);
    step4_passed = 0;
    testStepFail("Step4", "BLTN_CAM_RecSta_DEV is NOT Recording");
  }

  CaptureGraphics("BLTN_CAM_RecSta_DEV");
}

testcase OWD_005_5() {
  write("");
  write("===================================================================");
  write("=== STEP 5: Click TML Stop, wait 65s, verify DEV recording ===");
  write("===================================================================");
  testStep("Step5", "Stop TML and verify DEV");

  Click_TML_Stop();
  testWaitForTimeout(5000);

  if ($BLTN_CAM_RecSta_TML == 0x0) {
    write("TML Stopped successfully.");
  }

  write("Waiting 65s for recording operations to finish...");
  testWaitForTimeout(65000);

  // After 65s, DEV should have finished
  if ($BLTN_CAM_RecSta_DEV == 0x0) {
    step5_passed = 1;
    testStepPass("Step5", "DEV recording finished (0x0)");
  } else {
    step5_passed = 0;
    testStepFail("Step5", "DEV still recording after 65s wait");
  }

  CaptureGraphics("BLTN_CAM_RecSta_TML;BLTN_CAM_RecSta_DEV");
}

testcase OWD_005_6() {
  int i = 0;
  write("");
  write("===================================================================");
  write("=== STEP 6: Enter/Exit Built-in Cam mode 5 times ===");
  write("===================================================================");
  testStep("Step6", "UI Mode transition");

  for (i = 0; i < 5; i++) {
    Enter_BLTN_CAM();
    testWaitForTimeout(2000);
    Exit_BLTN_CAM();
    testWaitForTimeout(2000);
  }

  if ($BLTN_CAM_HU_UI_Mode == 0x0) {
    step6_passed = 1;
    testStepPass("Step6", "UI mode transitions complete (Mode=AVN)");
  } else {
    step6_passed = 0;
    testStepFail("Step6", "UI mode transition failed");
  }

  CaptureGraphics("BLTN_CAM_HU_UI_Mode");
}

testcase OWD_005_7() {
  write("");
  write("===================================================================");
  write("=== STEP 7: Log video verification ===");
  write("===================================================================");
  testStep("Step7", "Log video verification");

  write(">>> VERIFICATION REQUIRED <<<");
  write(">>> Please manually check the SD Card for the recorded files: <<<");
  write(">>> 1. MAR and DEV files <<<");
  write(">>> 2. TML file matching timestamps <<<");

  step7_passed = 1;
  testStepPass("Step7", "Video log instruction displayed");
}

testcase OWD_005_8() {
  write("");
  write("===================================================================");
  write("=== STEP 8: Set voltage to 9V via COM3, wait 60s at AVN mode ===");
  write("===================================================================");
  testStep("Step8", "9V voltage test in AVN mode");

  // Ensure AVN Mode
  Exit_BLTN_CAM();
  testWaitForTimeout(1000);

  write("[8.1] Setting voltage to 9V...");
  Set_Voltage(9.6);
  PowerSupply_OutputON();
  testWaitForTimeout(2000);

  write("[8.2] Waiting 60 seconds at AVN mode...");
  testWaitForTimeout(60000);

  write("[8.3] Status after 60s at 9V:");
  write("  BLTN_CAM_RecSet_OWD = 0x%X", $BLTN_CAM_RecSet_OWD);
  write("  AIN (Voltage) = %.2f V", @sysvar::IO::VN1600_1::AIN);
  if (@sysvar::IO::VN1600_1::AIN <= 10 && @sysvar::IO::VN1600_1::AIN >= 6) {
    write(">>> Voltage is within expected range (8.5V - 10.5V) <<<");
    step8_passed = 1;
  } else {
    write(">>> Voltage is OUT of expected range! <<<");
  }
  CaptureGraphics("BLTN_CAM_RecSet_OWD;AIN");

  testStepPass("Step8", "9V testing complete");
}

testcase OWD_005_9() {
  write("");
  write("===================================================================");
  write("=== STEP 9: Set voltage to 16V via COM3, wait 60s at AVN mode ===");
  write("===================================================================");
  testStep("Step9", "16V voltage test in AVN mode");

  // Ensure AVN Mode
  Exit_BLTN_CAM();
  testWaitForTimeout(1000);

  write("[9.1] Setting voltage to 16V...");
  Set_Voltage(16.6);
  testWaitForTimeout(2000);

  write("[9.2] Waiting 60 seconds at AVN mode...");
  testWaitForTimeout(60000);

  write("[9.3] Status after 60s at 16V:");
  write("  BLTN_CAM_RecSet_OWD = 0x%X", $BLTN_CAM_RecSet_OWD);
  write("  AIN (Voltage) = %.2f V", @sysvar::IO::VN1600_1::AIN);

  CaptureGraphics("BLTN_CAM_RecSet_OWD;AIN");
  if (@sysvar::IO::VN1600_1::AIN >= 15) {
    write(">>> Voltage is within expected range (15.5V - 16.5V) <<<");
    step9_passed = 1;
  } else {
    write(">>> Voltage is OUT of expected range! <<<");
  }

  testStepPass("Step9", "16V testing complete");
}

testcase OWD_005_Summary() {
  write("");
  write("========================================");
  write("=== TEST OWD_005 COMPLETE ===");
  write("========================================");

  // Restore voltage to normal (12V)
  write("Restoring voltage to 12.0V...");
  Set_Voltage(12.0);
  testWaitForTimeout(1000);

  // Close power supply connection
  Close_PowerSupply();

  // Cleanup - disable CGW NM
  @panel::Switch_CGWNM = 0;

  write("");
  write("=== FINAL STATUS ===");
  write("  SMK_TrmnlCtrlGrpStaBDC = 0x%X", $SMK_TrmnlCtrlGrpStaBDC);
  write("  BLTN_CAM_RecSet_OWD = 0x%X", $BLTN_CAM_RecSet_OWD);
  write("  BLTN_CAM_RecSta_OWD = 0x%X", $BLTN_CAM_RecSta_OWD);
  write("  BLTN_CAM_RecSta_DEV = 0x%X", $BLTN_CAM_RecSta_DEV);
  write("  BLTN_CAM_RecSta_MAR = 0x%X", $BLTN_CAM_RecSta_MAR);
  write("  BLTN_CAM_RecSta_TML = 0x%X", $BLTN_CAM_RecSta_TML);

  //============================================================================
  // Overall Test Verdict
  //============================================================================
  if (step1_passed == 1 && step2_passed == 1 && step3_passed == 1 &&
      step4_passed == 1 && step5_passed == 1 && step6_passed == 1 &&
      step7_passed == 1 && step8_passed == 1 && step9_passed == 1) {
    testStepPass("Overall_Verdict", "Test OWD_005: PASS");
    write("=== OVERALL VERDICT: PASS ===");
  } else {
    testStepFail("Overall_Verdict", "Test OWD_005: FAIL");
    write("=== OVERALL VERDICT: FAIL ===");
  }

  write("");
  write("=== TEST SUMMARY ===");
  if (step1_passed)
    write("Step 1: SMK IGN + USM Reset + RecSet_OWD = ON check: PASS");
  else
    write("Step 1: SMK IGN + USM Reset + RecSet_OWD = ON check: FAIL");
  if (step2_passed)
    write("Step 2: AVN HU UI mode + TML Start + RecSta_TML = Recording check: "
          "PASS");
  else
    write("Step 2: AVN HU UI mode + TML Start + RecSta_TML = Recording check: "
          "FAIL");
  if (step3_passed)
    write("Step 3: Evt Switch + RecSta_MAR = Recording check: PASS");
  else
    write("Step 3: Evt Switch + RecSta_MAR = Recording check: FAIL");
  if (step4_passed)
    write("Step 4: Driving Event + RecSta_DEV = Recording check: PASS");
  else
    write("Step 4: Driving Event + RecSta_DEV = Recording check: FAIL");
  if (step5_passed)
    write("Step 5: TML Stop + 65s wait + DEV recording verification: PASS");
  else
    write("Step 5: TML Stop + 65s wait + DEV recording verification: FAIL");
  if (step6_passed)
    write("Step 6: Enter/Exit Built-in Cam 5 times: PASS");
  else
    write("Step 6: Enter/Exit Built-in Cam 5 times: FAIL");
  if (step7_passed)
    write("Step 7: Video files verification log: PASS");
  else
    write("Step 7: Video files verification log: FAIL");
  if (step8_passed)
    write("Step 8: 9V voltage test at AVN (60s): PASS");
  else
    write("Step 8: 9V voltage test at AVN (60s): FAIL");
  if (step9_passed)
    write("Step 9: 16V voltage test at AVN (60s): PASS");
  else
    write("Step 9: 16V voltage test at AVN (60s): FAIL");
}

void MainTest() {
  testReportFileName("TestReports\\OWD_005 - 2.0 generation_report");
  OWD_005_Init();
  OWD_005_1();

  OWD_005_2();
  OWD_005_3();
  OWD_005_4();
  OWD_005_5();
  OWD_005_6();
  OWD_005_7();

  OWD_005_8();
  OWD_005_9();
  OWD_005_Summary();
}
