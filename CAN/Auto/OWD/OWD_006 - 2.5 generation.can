/*@!Encoding:65001*/

/*
  Test Case: OWD_006
  Title: [OWD Recording Test - ACC/IGN Mode with Build-in Cam Entry/Exit]
  Verification items: Check OWD recording behavior in ACC and IGN modes with BLTN_CAM UI operations

  Preconditions:
    - ACC and IGN and ccNC/ccIC switch OFF, AVN mode

  Step 1: Set SMK to IGN, click USM Reset, check BLTN_CAM_RecSta_OWD = 0x1 (Recording)
  Step 2: Log - Cannot enter build-in cam in ACC mode
  Step 3: Log - Cannot enter build-in cam in ACC mode
  Step 4: Set SMK to ACC, TML Start, wait for DEV=0x1 (max 60s), Evt Switch, check all 4 signals = 0x1
  Step 5: Log - Cannot enter build-in cam in ACC mode
  Step 6: Log - Check video in real device
  Step 7: Set SMK to IGN, check BLTN_CAM_RecSet_OWD = 0x2 (ON)
  Step 8: Enter/Exit Build-in Cam 3 times, end at AVN HU UI mode
  Step 9: Log - Check video images
  Step 10: Set SMK to IGN, TML Start, wait for DEV=0x1 (max 60s), Evt Switch, check all 4 signals = 0x1
  Step 11: Enter/Exit Build-in Cam 3 times, end at AVN HU UI mode
  Step 12: Log - Check video in real device

  NOTE: Uses BLTN_CAM_HU_UI_Mode for screenshots (response signal with delay consideration).
        Added 2s delay for state transitions.
*/

variables
{
  long max_wait_time = 60000;  // 60 seconds max wait for DEV recording

  // Result tracking variables for TEST SUMMARY
  int step1_passed = 0;
  int step4_passed = 0;
  int step7_passed = 0;
  int step8_passed = 0;
  int step10_passed = 0;
  int step11_passed = 0;

  // Message declarations
  // CAN FD Message Declaration
  message HU_BLTN_CAM_02_200ms _HU_BLTN_CAM_02_200ms;
}

// ============================================================================
// Panel Control Helper Functions
// ============================================================================

// Set SMK to IGN (0x2) via panel
void Set_SMK_IGN()
{
  write("=== Setting SMK to IGN (0x2) via panel ===");
  setSignal(SMK_TrmnlCtrlGrpStaBDC, 0x2);  // IGN
  testWaitForTimeout(2000);  // Wait 2s for signal propagation
  write("  SMK_TrmnlCtrlGrpStaBDC = 0x%X (IGN)", $SMK_TrmnlCtrlGrpStaBDC);
}

// Set SMK to ACC (0x1) via panel
void Set_SMK_ACC()
{
  write("=== Setting SMK to ACC (0x1) via panel ===");
  setSignal(SMK_TrmnlCtrlGrpStaBDC, 0x1);  // ACC
  testWaitForTimeout(2000);  // Wait 2s for signal propagation
  write("  SMK_TrmnlCtrlGrpStaBDC = 0x%X (ACC)", $SMK_TrmnlCtrlGrpStaBDC);
}

// Set SMK to OFF (0x0) via panel
void Set_SMK_OFF()
{
  write("=== Setting SMK to OFF (0x0) via panel ===");
  setSignal(SMK_TrmnlCtrlGrpStaBDC, 0x0);  // OFF
  testWaitForTimeout(2000);  // Wait 2s for signal propagation
  write("  SMK_TrmnlCtrlGrpStaBDC = 0x%X (OFF)", $SMK_TrmnlCtrlGrpStaBDC);
}

// Get SMK status string
void Get_SMK_Status_String(char result[])
{
  byte smk_val;
  smk_val = $SMK_TrmnlCtrlGrpStaBDC;

  if(smk_val == 0x4)
    snprintf(result, 10, "%s", "IGN");
  else if(smk_val == 0x3)
    snprintf(result, 10, "%s", "ACC");
  else if(smk_val == 0x0)
    snprintf(result, 10, "%s", "OFF");
  else
    snprintf(result, 10, "%s", "Unknown");
}

void Click_USM_Reset()
{
  write("=== Clicking USM Reset button on panel ===");
  @panel::Button_USMReset = 1;
  testWaitForTimeout(5000);
  write("  USM Reset clicked");
}

void Click_TML_Start()
{
  write("=== Clicking TML Start button on panel ===");
  @panel::Button_Timelaps_Start = 1;
  testWaitForTimeout(3000);
  write("  TML Start clicked");
}

// Click TML Stop button via panel
void Click_TML_Stop()
{
  write("=== Clicking TML Stop button on panel ===");
  @panel::Button_Timelaps_Stop = 1;
  testWaitForTimeout(3000);
  write("  TML Stop clicked");
}

// Click Event Switch button via panel (Manual Event Recording)
void Click_Evt_Switch()
{
  write("=== Clicking Event Switch button on panel ===");
  @panel::Button_SwitchEvt = 1;
  testWaitForTimeout(3000);
  write("  Event Switch clicked");
}

// Enter Built-in Cam mode (HU_BLTN_CAM_UI_Mode = 0x1)
void Enter_BLTN_CAM()
{
  write(">>> Enter BLTN_CAM mode <<<");
  _HU_BLTN_CAM_02_200ms.HU_BLTN_CAM_UI_Mode = 0x1;
  output(_HU_BLTN_CAM_02_200ms);
  testWaitForTimeout(3000);
}

// Exit to AVN HU UI mode (HU_BLTN_CAM_UI_Mode = 0x0)
void Exit_BLTN_CAM()
{
  write(">>> Exit BLTN_CAM mode <<<");
  _HU_BLTN_CAM_02_200ms.HU_BLTN_CAM_UI_Mode = 0x0;
  output(_HU_BLTN_CAM_02_200ms);
  testWaitForTimeout(3000);
}

// ============================================================================
// Check Functions
// ============================================================================

// Check BLTN_CAM_RecSta_OWD = 0x1 (Recording)
int Check_RecSta_OWD_Recording()
{
  byte rec_sta_owd = 0;

  rec_sta_owd = $BLTN_CAM_RecSta_OWD;
  write("  BLTN_CAM_RecSta_OWD = 0x%X", rec_sta_owd);

  if(rec_sta_owd == 0x1)
  {
    write(">>> PASS: BLTN_CAM_RecSta_OWD = 0x1 (Recording) <<<");
    return 1;
  }
  else
  {
    write(">>> FAIL: BLTN_CAM_RecSta_OWD is NOT Recording <<<");
    return 0;
  }
}

// Check BLTN_CAM_RecSet_OWD = 0x2 (ON)
int Check_RecSet_OWD_ON()
{
  byte rec_set_owd = 0;

  rec_set_owd = $BLTN_CAM_RecSet_OWD;
  write("  BLTN_CAM_RecSet_OWD = 0x%X", rec_set_owd);

  if(rec_set_owd == 0x2)
  {
    write(">>> PASS: BLTN_CAM_RecSet_OWD = 0x2 (ON) <<<");
    return 1;
  }
  else
  {
    write(">>> FAIL: BLTN_CAM_RecSet_OWD is NOT ON <<<");
    return 0;
  }
}

// Check BLTN_CAM_RecSta_TML = 0x1 (Recording)
int Check_RecSta_TML_Recording()
{
  byte rec_sta_tml = 0;

  rec_sta_tml = $BLTN_CAM_RecSta_TML;
  write("  BLTN_CAM_RecSta_TML = 0x%X", rec_sta_tml);

  if(rec_sta_tml == 0x1)
  {
    write(">>> PASS: BLTN_CAM_RecSta_TML = 0x1 (Recording) <<<");
    return 1;
  }
  else
  {
    write(">>> FAIL: BLTN_CAM_RecSta_TML is NOT Recording <<<");
    return 0;
  }
}

// Check BLTN_CAM_RecSta_DEV = 0x1 (Recording)
int Check_RecSta_DEV_Recording()
{
  byte rec_sta_dev = 0;

  rec_sta_dev = $BLTN_CAM_RecSta_DEV;
  write("  BLTN_CAM_RecSta_DEV = 0x%X", rec_sta_dev);

  if(rec_sta_dev == 0x1)
  {
    write(">>> PASS: BLTN_CAM_RecSta_DEV = 0x1 (Recording) <<<");
    return 1;
  }
  else
  {
    write(">>> FAIL: BLTN_CAM_RecSta_DEV is NOT Recording <<<");
    return 0;
  }
}

// Check BLTN_CAM_RecSta_MAR = 0x1 (Recording)
int Check_RecSta_MAR_Recording()
{
  byte rec_sta_mar = 0;

  rec_sta_mar = $BLTN_CAM_RecSta_MAR;
  write("  BLTN_CAM_RecSta_MAR = 0x%X", rec_sta_mar);

  if(rec_sta_mar == 0x1)
  {
    write(">>> PASS: BLTN_CAM_RecSta_MAR = 0x1 (Recording) <<<");
    return 1;
  }
  else
  {
    write(">>> FAIL: BLTN_CAM_RecSta_MAR is NOT Recording <<<");
    return 0;
  }
}

// Wait for BLTN_CAM_RecSta_DEV = 0x1 with timeout (max 60s)
int WaitFor_RecSta_DEV_Recording(long timeout_ms)
{
  long elapsed = 0;
  long check_interval = 2000;  // Check every 2 seconds
  long log_interval;
  byte rec_sta_dev = 0;

  write("=== Waiting for DEV Recording (max %d seconds) ===", timeout_ms/1000);
  write("Checking every %d seconds...", check_interval/1000);

  log_interval = (timeout_ms / 6 / check_interval) * check_interval;
  if(log_interval < check_interval) log_interval = check_interval;

  while(elapsed < timeout_ms)
  {
    rec_sta_dev = $BLTN_CAM_RecSta_DEV;

    if(elapsed == 0 || elapsed % log_interval == 0)
    {
      write("  [%d s / %d s] BLTN_CAM_RecSta_DEV = 0x%X",
            elapsed/1000, timeout_ms/1000, rec_sta_dev);
    }

    // Check if DEV recording is active
    if(rec_sta_dev == 0x1)
    {
      write(">>> DETECTED: DEV Recording started after %d seconds <<<", elapsed/1000);
      write(">>> PASS: BLTN_CAM_RecSta_DEV = 0x1 (Recording) <<<");
      return 1;
    }

    testWaitForTimeout(check_interval);
    elapsed += check_interval;
  }

  // Timeout - DEV recording not detected
  write(">>> TIMEOUT: DEV Recording NOT detected after %d seconds <<<", timeout_ms/1000);
  write(">>> FAIL: BLTN_CAM_RecSta_DEV is still 0x%X <<<", rec_sta_dev);
  return 0;
}

// Check all 4 recording signals = 0x1 (Recording)
int Check_All_Recording_Signals()
{
  int result = 1;
  byte rec_owd, rec_tml, rec_dev, rec_mar;

  write("=== Checking all 4 recording signals ===");

  rec_owd = $BLTN_CAM_RecSta_OWD;
  rec_tml = $BLTN_CAM_RecSta_TML;
  rec_dev = $BLTN_CAM_RecSta_DEV;
  rec_mar = $BLTN_CAM_RecSta_MAR;

  write("  BLTN_CAM_RecSta_OWD = 0x%X", rec_owd);
  write("  BLTN_CAM_RecSta_TML = 0x%X", rec_tml);
  write("  BLTN_CAM_RecSta_DEV = 0x%X", rec_dev);
  write("  BLTN_CAM_RecSta_MAR = 0x%X", rec_mar);

  if(rec_owd != 0x1)
  {
    write(">>> FAIL: BLTN_CAM_RecSta_OWD is NOT Recording <<<");
    result = 0;
  }
  if(rec_tml != 0x1)
  {
    write(">>> FAIL: BLTN_CAM_RecSta_TML is NOT Recording <<<");
    result = 0;
  }
  if(rec_dev != 0x1)
  {
    write(">>> FAIL: BLTN_CAM_RecSta_DEV is NOT Recording <<<");
    result = 0;
  }
  if(rec_mar != 0x1)
  {
    write(">>> FAIL: BLTN_CAM_RecSta_MAR is NOT Recording <<<");
    result = 0;
  }

  if(result == 1)
  {
    write(">>> PASS: All 4 recording signals = 0x1 (Recording) <<<");
  }

  return result;
}

// Check HU_BLTN_CAM_UI_Mode (using BLTN_CAM_HU_UI_Mode for response)
int Check_BLTN_CAM_UI_Mode(byte expected_mode)
{
  byte ui_mode = 0;

  // Wait 2s for signal delay
  testWaitForTimeout(2000);

  ui_mode = $BLTN_CAM_HU_UI_Mode;
  write("  BLTN_CAM_HU_UI_Mode = 0x%X", ui_mode);

  if(ui_mode == expected_mode)
  {
    if(expected_mode == 0x0)
      write(">>> PASS: BLTN_CAM_HU_UI_Mode = 0x0 (AVN HU UI Mode) <<<");
    else if(expected_mode == 0x1)
      write(">>> PASS: BLTN_CAM_HU_UI_Mode = 0x1 (Build-in Cam Mode) <<<");
    return 1;
  }
  else
  {
    write(">>> FAIL: BLTN_CAM_HU_UI_Mode != 0x%X <<<", expected_mode);
    return 0;
  }
}

// ============================================================================
// Capture Screenshot Function
// ============================================================================

void CaptureGraphics(char signalList[], char filename[])
{
  char filepath[256];
  snprintf(filepath, elcount(filepath), "D:\\project\\CAN FD\\[CANoe] CANFD\\Screenshots\\%s", filename);
  testWaitForTimeout(3000);
  testReportAddWindowCapture("OWD", signalList, "Screenshot", filepath);
  write(">>> Screenshot captured: %s <<<", filepath);
}

// ============================================================================
// Main Test Case
// ============================================================================

testcase OWD_006()
{
  int i = 0;
  int result = 0;
  char smk_status[10];

  write("========================================");
  write("=== START TEST OWD_006 ===");
  write("========================================");

  // Enable CGW NM
  @panel::Switch_CGWNM = 1;
  testWaitForTimeout(3000);

  //============================================================================
  // STEP 1: Set SMK to IGN, click USM Reset, check BLTN_CAM_RecSta_OWD = 0x1
  //============================================================================
  write("");
  write("=================================================================");
  write("=== STEP 1: Set SMK_Signal to IGN, USM Reset, Check RecSta_OWD ===");
  write("=================================================================");
  testStep("Step1", "SMK IGN + USM Reset + RecSta_OWD = 0x1 verification");

  // 1.1 Set SMK to IGN via Profile Settings panel
  write("[1.1] Setting SMK_Signal to IGN via Profile Settings panel...");
  Set_SMK_IGN();
  testWaitForTimeout(2000);

  // 1.2 Click USM Reset button
  write("[1.2] Clicking USM Reset button...");
  Click_USM_Reset();
  testWaitForTimeout(3000);

  // 1.3 Check BLTN_CAM_RecSta_OWD = 0x1 (Recording)
  write("[1.3] Checking BLTN_CAM_RecSta_OWD...");
  result = Check_RecSta_OWD_Recording();

  // Capture screenshot with all related signals including SMK status
  write("[1.4] Capturing screenshot...");
  CaptureGraphics("BLTN_CAM_RecSta_OWD;BLTN_CAM_RecSet_OWD;BLTN_CAM_HU_UI_Mode;SMK_TrmnlCtrlGrpStaBDC", "OWD_006_01.jpg");

  if(result == 1)
  {
    step1_passed = 1;
    testStepPass("Step1", "BLTN_CAM_RecSta_OWD = 0x1 (Recording) - PASS");
  }
  else
  {
    step1_passed = 0;
    testStepFail("Step1", "BLTN_CAM_RecSta_OWD is NOT Recording - FAIL");
  }

  //============================================================================
  // STEP 2 & 3: Log - Cannot enter build-in cam in ACC mode
  //============================================================================
  write("");
  write("=================================================================");
  write("=== STEP 2 & 3: ACC Mode - Cannot Enter Build-in Cam ===");
  write("=================================================================");
  testStep("Step2_3", "ACC mode build-in cam restriction log");

  write("");
  write("*************************************************************");
  write("*** STEP 2 & 3: LOG INFORMATION ***");
  write("*** In ACC mode, cannot enter Build-in Cam screen ***");
  write("*** This is expected behavior - no operation needed ***");
  write("*************************************************************");
  write("");

  testStepPass("Step2_3", "ACC mode build-in cam restriction logged");

  //============================================================================
  // STEP 4: Set SMK to ACC, TML Start, wait DEV=0x1 (60s), Evt Switch, check 4 signals
  //============================================================================
  write("");
  write("=================================================================");
  write("=== STEP 4: ACC Mode - TML Start, Wait DEV, Evt Switch ===");
  write("=================================================================");
  testStep("Step4", "ACC + TML Start + DEV wait + Evt Switch + 4 signals check");

  // 4.1 Set SMK to ACC via Profile Settings panel
  write("[4.1] Setting SMK_Signal to ACC via Profile Settings panel...");
  Set_SMK_ACC();
  testWaitForTimeout(2000);

  // 4.2 Click TML Start button via BLTN_CAM_Setting panel
  write("[4.2] Clicking TML Start button via BLTN_CAM_Setting panel...");
  Click_TML_Start();
  testWaitForTimeout(2000);

  // 4.3 Wait for BLTN_CAM_RecSta_DEV = 0x1 (max 60 seconds)
  write("[4.3] Waiting for BLTN_CAM_RecSta_DEV = 0x1 (max 60 seconds)...");
  result = WaitFor_RecSta_DEV_Recording(max_wait_time);

  if(result == 1)
  {
    write(">>> DEV Recording detected, proceeding to Evt Switch <<<");
  }
  else
  {
    write(">>> WARNING: DEV Recording not detected within 60s, proceeding anyway <<<");
  }

  // 4.4 Click Evt Switch button via BLTN_CAM_Setting panel
  write("[4.4] Clicking Evt Switch button via BLTN_CAM_Setting panel...");
  Click_Evt_Switch();
  

  // 4.5 Set SMK to IGN via Profile Settings panel before checking signals
  write("[4.5] Setting SMK_Signal to IGN via Profile Settings panel...");
  Set_SMK_IGN();
  testWaitForTimeout(2000);

  // 4.6 Check all 4 recording signals = 0x1
  write("[4.6] Checking all 4 recording signals...");
  result = Check_All_Recording_Signals(); 

  testWaitForTimeout(10000);
  // Capture screenshot with all related signals including SMK status
  write("[4.7] Capturing screenshot...");
  CaptureGraphics("BLTN_CAM_RecSta_OWD;BLTN_CAM_RecSta_TML;BLTN_CAM_RecSta_DEV;BLTN_CAM_RecSta_MAR;BLTN_CAM_HU_UI_Mode;SMK_TrmnlCtrlGrpStaBDC", "OWD_006_02.jpg");

  // 4.8 Click TML Stop button to stop TML recording
  write("[4.8] Clicking TML Stop button to stop TML recording...");
  Click_TML_Stop();
  testWaitForTimeout(2000);

  if(result == 1)
  {
    step4_passed = 1;
    testStepPass("Step4", "All 4 signals = 0x1 (Recording) in ACC mode - PASS");
  }
  else
  {
    step4_passed = 0;
    testStepFail("Step4", "Not all signals are Recording in ACC mode - FAIL");
  }

  //============================================================================
  // STEP 5: Log - Cannot enter build-in cam in ACC mode
  //============================================================================
  write("");
  write("=================================================================");
  write("=== STEP 5: ACC Mode - Cannot Enter Build-in Cam ===");
  write("=================================================================");
  testStep("Step5", "ACC mode build-in cam restriction log");

  write("");
  write("*************************************************************");
  write("*** STEP 5: LOG INFORMATION ***");
  write("*** Cannot enter Build-in Cam screen while in ACC mode ***");
  write("*** This is expected behavior ***");
  write("*************************************************************");
  write("");

  testStepPass("Step5", "ACC mode build-in cam restriction logged");

  //============================================================================
  // STEP 6: Log - Check video in real device
  //============================================================================
  write("");
  write("=================================================================");
  write("=== STEP 6: Video Verification Log ===");
  write("=================================================================");
  testStep("Step6", "Video verification log");

  write("");
  write("*************************************************************");
  write("*** STEP 6: LOG INFORMATION ***");
  write("*** Please check video recording on real device ***");
  write("*** Verify OWD/TML/DEV/MAR video files are saved ***");
  write("*************************************************************");
  write("");

  testStepPass("Step6", "Video verification logged - Manual check required");

  //============================================================================
  // STEP 7: Set SMK to IGN, check BLTN_CAM_RecSet_OWD = 0x2 (ON)
  //============================================================================
  write("");
  write("=================================================================");
  write("=== STEP 7: Set SMK to IGN, Check RecSet_OWD = ON ===");
  write("=================================================================");
  testStep("Step7", "SMK IGN + RecSet_OWD = 0x2 verification");

  // 7.1 Set SMK to IGN via Profile Settings panel
  write("[7.1] Setting SMK_Signal to IGN via Profile Settings panel...");
  Set_SMK_IGN();
  testWaitForTimeout(3000);

  // 7.2 Check BLTN_CAM_RecSet_OWD = 0x2 (ON)
  write("[7.2] Checking BLTN_CAM_RecSet_OWD...");
  result = Check_RecSet_OWD_ON();

  // Capture screenshot with all related signals including SMK status
  write("[7.3] Capturing screenshot...");
  CaptureGraphics("BLTN_CAM_RecSet_OWD;BLTN_CAM_RecSta_OWD;BLTN_CAM_HU_UI_Mode;SMK_TrmnlCtrlGrpStaBDC", "OWD_006_03.jpg");

  if(result == 1)
  {
    step7_passed = 1;
    testStepPass("Step7", "BLTN_CAM_RecSet_OWD = 0x2 (ON) in IGN mode - PASS");
  }
  else
  {
    step7_passed = 0;
    testStepFail("Step7", "BLTN_CAM_RecSet_OWD is NOT ON in IGN mode - FAIL");
  }

  //============================================================================
  // STEP 8: Enter/Exit Build-in Cam 3 times, end at AVN HU UI mode
  //============================================================================
  write("");
  write("=================================================================");
  write("=== STEP 8: Enter/Exit Build-in Cam 3 Times (IGN Mode) ===");
  write("=================================================================");
  testStep("Step8", "Mode cycling 3 times in IGN mode");

  for(i = 1; i <= 3; i++)
  {
    write("");
    write("--- Cycle %d of 3 ---", i);

    // Enter Built-in Cam mode
    write("[8.%d.1] Entering Build-in Cam mode...", i);
    Enter_BLTN_CAM();
    testWaitForTimeout(2000);  // Wait 2s for signal delay

    // Log current mode (using BLTN_CAM_HU_UI_Mode for response)
    write("  After Enter: BLTN_CAM_HU_UI_Mode = 0x%X | SMK = 0x%X",
          $BLTN_CAM_HU_UI_Mode, $SMK_TrmnlCtrlGrpStaBDC);

    // Exit to AVN mode
    write("[8.%d.2] Exiting to AVN HU UI mode...", i);
    Exit_BLTN_CAM();
    testWaitForTimeout(2000);  // Wait 2s for signal delay

    // Log current mode
    write("  After Exit: BLTN_CAM_HU_UI_Mode = 0x%X | SMK = 0x%X",
          $BLTN_CAM_HU_UI_Mode, $SMK_TrmnlCtrlGrpStaBDC);
  }

  // Verify final state is AVN HU UI mode (0x0)
  write("");
  write("[8.4] Verifying final state is AVN HU UI mode...");
  result = Check_BLTN_CAM_UI_Mode(0x0);

  // Capture screenshot with SMK status
  write("[8.5] Capturing screenshot...");
  CaptureGraphics("BLTN_CAM_HU_UI_Mode;HU_BLTN_CAM_UI_Mode;BLTN_CAM_RecSet_OWD;BLTN_CAM_RecSta_OWD;SMK_TrmnlCtrlGrpStaBDC", "OWD_006_04.jpg");

  if(result == 1)
  {
    step8_passed = 1;
    testStepPass("Step8", "Mode cycling 3 times completed, final state AVN HU UI mode - PASS");
  }
  else
  {
    step8_passed = 0;
    testStepFail("Step8", "Mode cycling failed - FAIL");
  }

  //============================================================================
  // STEP 9: Log - Check video images
  //============================================================================
  write("");
  write("=================================================================");
  write("=== STEP 9: Video Images Verification Log ===");
  write("=================================================================");
  testStep("Step9", "Video images verification log");

  write("");
  write("*************************************************************");
  write("*** STEP 9: LOG INFORMATION ***");
  write("*** Please check the captured video images ***");
  write("*** Verify video quality and timestamps ***");
  write("*************************************************************");
  write("");

  testStepPass("Step9", "Video images verification logged - Manual check required");

  //============================================================================
  // STEP 10: Set SMK to IGN, TML Start, wait DEV=0x1 (60s), Evt Switch, check 4 signals
  //============================================================================
  write("");
  write("=================================================================");
  write("=== STEP 10: IGN Mode - TML Start, Wait DEV, Evt Switch ===");
  write("=================================================================");
  testStep("Step10", "IGN + TML Start + DEV wait + Evt Switch + 4 signals check");

  // 10.1 Set SMK to IGN via Profile Settings panel
  write("[10.1] Setting SMK_Signal to IGN via Profile Settings panel...");
  Set_SMK_IGN();
  testWaitForTimeout(2000);

  // 10.2 Click TML Start button via BLTN_CAM_Setting panel
  write("[10.2] Clicking TML Start button via BLTN_CAM_Setting panel...");
  Click_TML_Start();
  testWaitForTimeout(2000);

  // 10.3 Wait for BLTN_CAM_RecSta_DEV = 0x1 (max 60 seconds)
  write("[10.3] Waiting for BLTN_CAM_RecSta_DEV = 0x1 (max 60 seconds)...");
  result = WaitFor_RecSta_DEV_Recording(max_wait_time);

  if(result == 1)
  {
    write(">>> DEV Recording detected, proceeding to Evt Switch <<<");
  }
  else
  {
    write(">>> WARNING: DEV Recording not detected within 60s, proceeding anyway <<<");
  }

  // 10.4 Click Evt Switch button via BLTN_CAM_Setting panel
  write("[10.4] Clicking Evt Switch button via BLTN_CAM_Setting panel...");
  Click_Evt_Switch();
  

  // 10.5 Check all 4 recording signals = 0x1
  write("[10.5] Checking all 4 recording signals...");
  result = Check_All_Recording_Signals();
  
  testWaitForTimeout(10000);
  // Capture screenshot with all related signals including SMK status
  write("[10.6] Capturing screenshot...");
  CaptureGraphics("BLTN_CAM_RecSta_OWD;BLTN_CAM_RecSta_TML;BLTN_CAM_RecSta_DEV;BLTN_CAM_RecSta_MAR;BLTN_CAM_HU_UI_Mode;SMK_TrmnlCtrlGrpStaBDC", "OWD_006_05.jpg");

  // 10.7 Click TML Stop button to stop TML recording
  write("[10.7] Clicking TML Stop button to stop TML recording...");
  Click_TML_Stop();
  testWaitForTimeout(2000);

  if(result == 1)
  {
    step10_passed = 1;
    testStepPass("Step10", "All 4 signals = 0x1 (Recording) in IGN mode - PASS");
  }
  else
  {
    step10_passed = 0;
    testStepFail("Step10", "Not all signals are Recording in IGN mode - FAIL");
  }

  //============================================================================
  // STEP 11: Enter/Exit Build-in Cam 3 times, end at AVN HU UI mode
  //============================================================================
  write("");
  write("=================================================================");
  write("=== STEP 11: Enter/Exit Build-in Cam 3 Times (IGN Mode) ===");
  write("=================================================================");
  testStep("Step11", "Mode cycling 3 times in IGN mode after recording");

  for(i = 1; i <= 3; i++)
  {
    write("");
    write("--- Cycle %d of 3 ---", i);

    // Enter Built-in Cam mode
    write("[11.%d.1] Entering Build-in Cam mode...", i);
    Enter_BLTN_CAM();
    testWaitForTimeout(2000);  // Wait 2s for signal delay

    // Log current mode (using BLTN_CAM_HU_UI_Mode for response)
    write("  After Enter: BLTN_CAM_HU_UI_Mode = 0x%X | SMK = 0x%X",
          $BLTN_CAM_HU_UI_Mode, $SMK_TrmnlCtrlGrpStaBDC);

    // Exit to AVN mode
    write("[11.%d.2] Exiting to AVN HU UI mode...", i);
    Exit_BLTN_CAM();
    testWaitForTimeout(2000);  // Wait 2s for signal delay

    // Log current mode
    write("  After Exit: BLTN_CAM_HU_UI_Mode = 0x%X | SMK = 0x%X",
          $BLTN_CAM_HU_UI_Mode, $SMK_TrmnlCtrlGrpStaBDC);
  }

  // Verify final state is AVN HU UI mode (0x0)
  write("");
  write("[11.4] Verifying final state is AVN HU UI mode...");
  result = Check_BLTN_CAM_UI_Mode(0x0);

  // Capture screenshot with SMK status
  write("[11.5] Capturing screenshot...");
  CaptureGraphics("BLTN_CAM_HU_UI_Mode;HU_BLTN_CAM_UI_Mode;BLTN_CAM_RecSet_OWD;BLTN_CAM_RecSta_OWD;SMK_TrmnlCtrlGrpStaBDC", "OWD_006_06.jpg");

  if(result == 1)
  {
    step11_passed = 1;
    testStepPass("Step11", "Mode cycling 3 times completed, final state AVN HU UI mode - PASS");
  }
  else
  {
    step11_passed = 0;
    testStepFail("Step11", "Mode cycling failed - FAIL");
  }

  //============================================================================
  // STEP 12: Log - Check video in real device
  //============================================================================
  write("");
  write("=================================================================");
  write("=== STEP 12: Final Video Verification Log ===");
  write("=================================================================");
  testStep("Step12", "Final video verification log");

  write("");
  write("*************************************************************");
  write("*** STEP 12: LOG INFORMATION ***");
  write("*** Please check video recording on real device ***");
  write("*** Verify all recording modes (OWD/TML/DEV/MAR) ***");
  write("*** Check video quality after mode cycling ***");
  write("*************************************************************");
  write("");

  testStepPass("Step12", "Final video verification logged - Manual check required");

  //============================================================================
  // TEST COMPLETE
  //============================================================================
  write("");
  write("========================================");
  write("=== TEST OWD_006 COMPLETE ===");
  write("========================================");

  // Cleanup - disable CGW NM
  @panel::Switch_CGWNM = 0;

  write("");
  write("=== FINAL STATUS ===");
  Get_SMK_Status_String(smk_status);
  write("  SMK_TrmnlCtrlGrpStaBDC = 0x%X (%s)", $SMK_TrmnlCtrlGrpStaBDC, smk_status);
  write("  BLTN_CAM_RecSet_OWD = 0x%X", $BLTN_CAM_RecSet_OWD);
  write("  BLTN_CAM_RecSta_OWD = 0x%X", $BLTN_CAM_RecSta_OWD);
  write("  BLTN_CAM_RecSta_DEV = 0x%X", $BLTN_CAM_RecSta_DEV);
  write("  BLTN_CAM_RecSta_MAR = 0x%X", $BLTN_CAM_RecSta_MAR);
  write("  BLTN_CAM_RecSta_TML = 0x%X", $BLTN_CAM_RecSta_TML);
  write("  BLTN_CAM_HU_UI_Mode = 0x%X", $BLTN_CAM_HU_UI_Mode);

  //============================================================================
  // Overall Test Verdict
  //============================================================================
  if(step1_passed == 1 && step4_passed == 1 && step7_passed == 1 && step8_passed == 1 && step10_passed == 1 && step11_passed == 1)
  {
    testStepPass("Overall_Verdict", "Test OWD_006: PASS");
    write("=== OVERALL VERDICT: PASS ===");
  }
  else
  {
    testStepFail("Overall_Verdict", "Test OWD_006: FAIL");
    write("=== OVERALL VERDICT: FAIL ===");
  }

  write("");
  write("=== TEST SUMMARY ===");

  if(step1_passed == 1)
    write("Step 1: SMK IGN + USM Reset + RecSta_OWD = 0x1 (Recording) check [Screenshot] => PASS");
  else
    write("Step 1: SMK IGN + USM Reset + RecSta_OWD = 0x1 (Recording) check [Screenshot] => FAIL");

  write("Step 2-3: ACC mode - Cannot enter Build-in Cam [Log only] => PASS");

  if(step4_passed == 1)
    write("Step 4: ACC mode - TML Start + DEV wait + Evt Switch + 4 signals check [Screenshot] => PASS");
  else
    write("Step 4: ACC mode - TML Start + DEV wait + Evt Switch + 4 signals check [Screenshot] => FAIL");

  write("Step 5: ACC mode - Cannot enter Build-in Cam [Log only] => PASS");
  write("Step 6: Video verification [Log only] => PASS");

  if(step7_passed == 1)
    write("Step 7: SMK IGN + RecSet_OWD = 0x2 (ON) check [Screenshot] => PASS");
  else
    write("Step 7: SMK IGN + RecSet_OWD = 0x2 (ON) check [Screenshot] => FAIL");

  if(step8_passed == 1)
    write("Step 8: IGN mode - Enter/Exit Build-in Cam 3 times [Screenshot] => PASS");
  else
    write("Step 8: IGN mode - Enter/Exit Build-in Cam 3 times [Screenshot] => FAIL");

  write("Step 9: Video images verification [Log only] => PASS");

  if(step10_passed == 1)
    write("Step 10: IGN mode - TML Start + DEV wait + Evt Switch + 4 signals check [Screenshot] => PASS");
  else
    write("Step 10: IGN mode - TML Start + DEV wait + Evt Switch + 4 signals check [Screenshot] => FAIL");

  if(step11_passed == 1)
    write("Step 11: IGN mode - Enter/Exit Build-in Cam 3 times [Screenshot] => PASS");
  else
    write("Step 11: IGN mode - Enter/Exit Build-in Cam 3 times [Screenshot] => FAIL");

  write("Step 12: Final video verification [Log only] => PASS");
}

void MainTest()
{
  testReportFileName("TestReports\\OWD_006 - 2.5 generation_report");
  OWD_006();
}
