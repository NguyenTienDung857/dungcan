/*@!Encoding:65001*/

/*
  Test Case: OWD_010
  Title: [DEV Recording Test - IGN/ACC Mode with Driving Event]
  Verification items:
    - Check DEV recording setting and status in IGN and ACC modes
    - Verify DEV recording behavior with driving events
    - Monitor BLTN_CAM_RecSta_DEV changes during driving

  Preconditions:
    - ACC and IGN and ccNC/ccIC switch OFF, AVN mode

  Test Steps:
    Step 1: Set SMK to IGN, USM Reset, check BLTN_CAM_RecSet_DEV = 0x2 (ON)
            Enter Build-in Cam, trigger driving recording, monitor RecSta_DEV = 0x0 for 15s
    Step 2-3: Log - LED OFF photo capture (manual)
    Step 4: Return to AVN HU UI mode, check BLTN_CAM_RecSta_DEV = 0x0 (OFF)
    Step 5-6: Log - LED ON photo capture (manual)
    Step 7: Trigger driving event, within 50s check BLTN_CAM_RecSta_DEV = 0x1 (Recording)
    Step 8, 10: Log - LED ON photo capture (manual)
    Step 9: Wait 15s, capture AIN and BLTN_CAM_RecSta_DEV
    Step 11: Capture AIN and BLTN_CAM_RecSta_DEV
    Step 12: Switch to ACC mode, check BLTN_CAM_RecSta_DEV = 0x0 (OFF)
    Step 13-14: Log - LED photo capture (manual)
    Step 15: In ACC mode, trigger driving event, within 50s check BLTN_CAM_RecSta_DEV = 0x1 (Recording)
    Step 16, 18: Log - LED photo capture (manual)
    Step 17, 19: Wait 15s, capture AIN and BLTN_CAM_RecSta_DEV

  NOTE: Uses 3-5s delay for signal propagation after each state transition.
*/

variables
{
  long max_wait_time_15s = 15000;   // 15 seconds for monitoring
  long max_wait_time_50s = 50000;   // 50 seconds for DEV recording detection

  // Message declarations
  // CAN FD Message Declaration
  message HU_BLTN_CAM_02_200ms _HU_BLTN_CAM_02_200ms;

  // Result tracking variables for steps with pass/fail logic
  int step1_passed = 0;
  int step4_passed = 0;
  int step7_passed = 0;
  int step12_passed = 0;
  int step15_passed = 0;
}

// ============================================================================
// Panel Control Helper Functions
// ============================================================================

// Set SMK to IGN (0x2) via panel
void Set_SMK_IGN()
{
  write("=== Setting SMK_Signal to IGN via panel ===");
  setSignal(SMK_TrmnlCtrlGrpStaBDC, 0x2);  // IGN
  testWaitForTimeout(5000);  // Wait 5s for signal propagation
  write("  SMK_TrmnlCtrlGrpStaBDC = 0x%X (IGN)", $SMK_TrmnlCtrlGrpStaBDC);
}

// Set SMK to ACC (0x1) via panel
void Set_SMK_ACC()
{
  write("=== Setting SMK_Signal to ACC via panel ===");
  setSignal(SMK_TrmnlCtrlGrpStaBDC, 0x1);  // ACC
  testWaitForTimeout(5000);  // Wait 5s for signal propagation
  write("  SMK_TrmnlCtrlGrpStaBDC = 0x%X (ACC)", $SMK_TrmnlCtrlGrpStaBDC);
}

// Get SMK status string
void Get_SMK_Status_String(char result[])
{
  byte smk_val;
  smk_val = $SMK_TrmnlCtrlGrpStaBDC;

  if(smk_val == 0x2)
    snprintf(result, 10, "%s", "IGN");
  else if(smk_val == 0x1)
    snprintf(result, 10, "%s", "ACC");
  else if(smk_val == 0x0)
    snprintf(result, 10, "%s", "OFF");
  else
    snprintf(result, 10, "%s", "Unknown");
}

void Click_USM_Reset()
{
  write("=== Clicking USM Reset button on panel ===");
  @panel::Button_USMReset = 1;
  testWaitForTimeout(5000);
  write("  USM Reset clicked");
}

// Enter Built-in Cam mode (HU_BLTN_CAM_UI_Mode = 0x1)
void Enter_BLTN_CAM()
{
  write(">>> Enter BLTN_CAM mode <<<");
  _HU_BLTN_CAM_02_200ms.HU_BLTN_CAM_UI_Mode = 0x1;
  output(_HU_BLTN_CAM_02_200ms);
  testWaitForTimeout(3000);
}

// Exit to AVN HU UI mode (HU_BLTN_CAM_UI_Mode = 0x0)
void Exit_BLTN_CAM()
{
  write(">>> Exit BLTN_CAM mode <<<");
  _HU_BLTN_CAM_02_200ms.HU_BLTN_CAM_UI_Mode = 0x0;
  output(_HU_BLTN_CAM_02_200ms);
  testWaitForTimeout(3000);
}

// Enable Driving Info simulation
void Enable_DrivingInfo()
{
  write("=== Enabling Driving Info Simulation ===");
  @sysvar::panel::EnableDrvInfo = 1;
  testWaitForTimeout(3000);
  write("  EnableDrvInfo = 1 (ON)");
}

// Disable Driving Info simulation
void Disable_DrivingInfo()
{
  write("=== Disabling Driving Info Simulation ===");
  @sysvar::panel::EnableDrvInfo = 0;
  testWaitForTimeout(3000);
  write("  EnableDrvInfo = 0 (OFF)");
}

// ============================================================================
// Check Functions
// ============================================================================

// Check BLTN_CAM_RecSet_DEV = 0x2 (ON)
int Check_RecSet_DEV_ON()
{
  byte rec_set_dev = 0;

  rec_set_dev = $BLTN_CAM_RecSet_DEV;
  write("  BLTN_CAM_RecSet_DEV = 0x%X", rec_set_dev);

  if(rec_set_dev == 0x2)
  {
    write(">>> PASS: BLTN_CAM_RecSet_DEV = 0x2 (ON) <<<");
    return 1;
  }
  else
  {
    write(">>> FAIL: BLTN_CAM_RecSet_DEV is NOT ON <<<");
    return 0;
  }
}

// Check BLTN_CAM_RecSta_DEV = 0x0 (OFF)
int Check_RecSta_DEV_OFF()
{
  byte rec_sta_dev = 0;

  rec_sta_dev = $BLTN_CAM_RecSta_DEV;
  write("  BLTN_CAM_RecSta_DEV = 0x%X", rec_sta_dev);

  if(rec_sta_dev == 0x0)
  {
    write(">>> PASS: BLTN_CAM_RecSta_DEV = 0x0 (OFF) <<<");
    return 1;
  }
  else
  {
    write(">>> FAIL: BLTN_CAM_RecSta_DEV is NOT OFF <<<");
    return 0;
  }
}

// Check BLTN_CAM_RecSta_DEV = 0x1 (Recording)
int Check_RecSta_DEV_Recording()
{
  byte rec_sta_dev = 0;

  rec_sta_dev = $BLTN_CAM_RecSta_DEV;
  write("  BLTN_CAM_RecSta_DEV = 0x%X", rec_sta_dev);

  if(rec_sta_dev == 0x1)
  {
    write(">>> PASS: BLTN_CAM_RecSta_DEV = 0x1 (Recording) <<<");
    return 1;
  }
  else
  {
    write(">>> FAIL: BLTN_CAM_RecSta_DEV is NOT Recording <<<");
    return 0;
  }
}

// Monitor BLTN_CAM_RecSta_DEV = 0x0 (OFF) for specified duration
// Returns 1 if always OFF, 0 if any change to ON
int Monitor_RecSta_DEV_AlwaysOFF(long timeout_ms)
{
  long elapsed = 0;
  long check_interval = 1000;  // Check every 1 second
  byte rec_sta_dev = 0;
  int always_off = 1;
  long log_interval;

  write("=== Monitoring BLTN_CAM_RecSta_DEV for %d seconds ===", timeout_ms/1000);
  write("Expected: Should always be 0x0 (OFF)");

  log_interval = (timeout_ms / 6 / check_interval) * check_interval;
  if(log_interval < check_interval) log_interval = check_interval;

  while(elapsed < timeout_ms)
  {
    rec_sta_dev = $BLTN_CAM_RecSta_DEV;

    if(elapsed == 0 || elapsed % log_interval == 0)
    write("  [%d s / %d s] BLTN_CAM_RecSta_DEV = 0x%X",
          elapsed/1000, timeout_ms/1000, rec_sta_dev);

    // Check if DEV became ON (unexpected)
    if(rec_sta_dev != 0x0)
    {
      write(">>> WARNING: BLTN_CAM_RecSta_DEV changed to 0x%X (not OFF) <<<", rec_sta_dev);
      always_off = 0;
    }

    testWaitForTimeout(check_interval);
    elapsed += check_interval;
  }

  if(always_off == 1)
  {
    write(">>> PASS: BLTN_CAM_RecSta_DEV remained 0x0 (OFF) for %d seconds <<<", timeout_ms/1000);
  }
  else
  {
    write(">>> FAIL: BLTN_CAM_RecSta_DEV was NOT always OFF <<<");
  }

  return always_off;
}

// Wait for BLTN_CAM_RecSta_DEV = 0x1 with timeout
int WaitFor_RecSta_DEV_Recording(long timeout_ms)
{
  long elapsed = 0;
  long check_interval = 2000;  // Check every 2 seconds
  byte rec_sta_dev = 0;
  long log_interval;

  write("=== Waiting for DEV Recording (max %d seconds) ===", timeout_ms/1000);
  write("Checking every %d seconds...", check_interval/1000);

  log_interval = (timeout_ms / 6 / check_interval) * check_interval;
  if(log_interval < check_interval) log_interval = check_interval;

  while(elapsed < timeout_ms)
  {
    rec_sta_dev = $BLTN_CAM_RecSta_DEV;

    if(elapsed == 0 || elapsed % log_interval == 0)
    write("  [%d s / %d s] BLTN_CAM_RecSta_DEV = 0x%X",
          elapsed/1000, timeout_ms/1000, rec_sta_dev);

    // Check if DEV recording is active
    if(rec_sta_dev == 0x1)
    {
      write(">>> DETECTED: DEV Recording started after %d seconds <<<", elapsed/1000);
      write(">>> PASS: BLTN_CAM_RecSta_DEV = 0x1 (Recording) <<<");
      return 1;
    }

    testWaitForTimeout(check_interval);
    elapsed += check_interval;
  }

  // Timeout - DEV recording not detected
  write(">>> TIMEOUT: DEV Recording NOT detected after %d seconds <<<", timeout_ms/1000);
  write(">>> FAIL: BLTN_CAM_RecSta_DEV is still 0x%X <<<", rec_sta_dev);
  return 0;
}

// ============================================================================
// Capture Screenshot Function
// ============================================================================

void CaptureGraphics(char signalList[], char filename[])
{
  char filepath[256];
  snprintf(filepath, elcount(filepath), "D:\\project\\CAN FD\\[CANoe] CANFD\\Screenshots\\%s", filename);
  testWaitForTimeout(3000);
  testReportAddWindowCapture("OWD", signalList, "Screenshot", filepath);
  write(">>> Screenshot captured: %s <<<", filepath);
}

// ============================================================================
// Main Test Case
// ============================================================================

testcase OWD_010()
{
  int result = 0;
  char smk_status[10];

  write("========================================");
  write("=== START TEST OWD_010 ===");
  write("=== DEV Recording Test - IGN/ACC Mode ===");
  write("========================================");

  // Enable CGW NM
  @panel::Switch_CGWNM = 1;
  testWaitForTimeout(3000);

  //============================================================================
  // STEP 1: Set SMK to IGN, USM Reset, check RecSet_DEV = ON (0x2)
  //         Enter Build-in Cam, monitor RecSta_DEV = OFF for 15s
  //============================================================================
  write("");
  write("=================================================================");
  write("=== STEP 1: SMK IGN + USM Reset + Check RecSet_DEV = 0x2 (ON) ===");
  write("===         Enter Build-in Cam + Monitor RecSta_DEV for 15s  ===");
  write("=================================================================");
  testStep("Step1", "SMK IGN + USM Reset + RecSet_DEV ON + BLTN_CAM + Monitor 15s");

  // 1.1 Set SMK to IGN via panel
  write("[1.1] Setting SMK_Signal to IGN via panel...");
  Set_SMK_IGN();
  testWaitForTimeout(5000);  // 5s delay for signal propagation

  // 1.2 Click USM Reset button
  write("[1.2] Clicking USM Reset button...");
  Click_USM_Reset();
  testWaitForTimeout(5000);  // 5s delay for signal propagation

  // 1.3 Check BLTN_CAM_RecSet_DEV = 0x2 (ON)
  write("[1.3] Checking BLTN_CAM_RecSet_DEV = 0x2 (ON)...");
  result = Check_RecSet_DEV_ON();

  if(result != 1)
  {
    write(">>> WARNING: RecSet_DEV is not ON, test may not be accurate <<<");
  }

  // 1.4 Enter Build-in Cam mode
  write("");
  write("*************************************************************");
  write("*** ACTION REQUIRED ***");
  write("*** Please enter Build-in Cam screen now! ***");
  write("*** Script will automatically set UI mode to Build-in Cam ***");
  write("*************************************************************");
  write("");

  write("[1.4] Entering Build-in Cam mode...");
  Enter_BLTN_CAM();
  testWaitForTimeout(5000);  // 5s delay

  // 1.5 Log - Ask user to trigger driving recording
  write("");
  write("*************************************************************");
  write("*** ACTION REQUIRED ***");
  write("*** Please trigger driving recording now! ***");
  write("*** (Turn on driving event trigger on real device) ***");
  write("*************************************************************");
  write("");

  // 1.6 Monitor BLTN_CAM_RecSta_DEV = 0x0 (OFF) for 15s
  write("[1.6] Monitoring BLTN_CAM_RecSta_DEV = 0x0 (OFF) for 15 seconds...");
  result = Monitor_RecSta_DEV_AlwaysOFF(max_wait_time_15s);

  // 1.7 Capture screenshot
  write("[1.7] Capturing screenshot...");
  CaptureGraphics("BLTN_CAM_RecSet_DEV;BLTN_CAM_RecSta_DEV;BLTN_CAM_HU_UI_Mode;SMK_TrmnlCtrlGrpStaBDC", "OWD_010_01.jpg");

  if(result == 1)
  {
    step1_passed = 1;
    testStepPass("Step1", "BLTN_CAM_RecSta_DEV = 0x0 (OFF) for 15s in Build-in Cam - PASS");
  }
  else
  {
    step1_passed = 0;
    testStepFail("Step1", "BLTN_CAM_RecSta_DEV was NOT always OFF - FAIL");
  }

  //============================================================================
  // STEP 2 & 3: Log - LED OFF photo capture (manual)
  //============================================================================
  write("");
  write("=================================================================");
  write("=== STEP 2 & 3: LED OFF Photo Capture (Manual) ===");
  write("=================================================================");
  testStep("Step2_3", "LED OFF photo capture");

  write("");
  write("*************************************************************");
  write("*** STEP 2 & 3: LOG INFORMATION ***");
  write("*** Please capture LED OFF photo directly ***");
  write("*** Check that LED is OFF on the device ***");
  write("*** Include this photo in the test report ***");
  write("*************************************************************");
  write("");

  testStepPass("Step2_3", "LED OFF photo capture logged - Manual photo required");

  //============================================================================
  // STEP 4: Return to AVN HU UI mode, check BLTN_CAM_RecSta_DEV = 0x0 (OFF)
  //============================================================================
  write("");
  write("=================================================================");
  write("=== STEP 4: Return to AVN HU UI Mode + Check RecSta_DEV = OFF ===");
  write("=================================================================");
  testStep("Step4", "Exit BLTN_CAM + RecSta_DEV = 0x0 (OFF) verification");

  // 4.1 Exit to AVN HU UI mode
  write("[4.1] Exiting to AVN HU UI mode...");
  Exit_BLTN_CAM();
  testWaitForTimeout(5000);  // 5s delay for signal propagation

  // 4.2 Check BLTN_CAM_RecSta_DEV = 0x0 (OFF)
  write("[4.2] Checking BLTN_CAM_RecSta_DEV = 0x0 (OFF)...");
  result = Check_RecSta_DEV_OFF();

  // 4.3 Capture screenshot
  write("[4.3] Capturing screenshot...");
  CaptureGraphics("BLTN_CAM_RecSta_DEV;BLTN_CAM_RecSet_DEV;BLTN_CAM_HU_UI_Mode;SMK_TrmnlCtrlGrpStaBDC", "OWD_010_02.jpg");

  if(result == 1)
  {
    step4_passed = 1;
    testStepPass("Step4", "BLTN_CAM_RecSta_DEV = 0x0 (OFF) in AVN HU UI mode - PASS");
  }
  else
  {
    step4_passed = 0;
    testStepFail("Step4", "BLTN_CAM_RecSta_DEV is NOT OFF in AVN mode - FAIL");
  }

  //============================================================================
  // STEP 5 & 6: Log - LED ON photo capture (manual)
  //============================================================================
  write("");
  write("=================================================================");
  write("=== STEP 5 & 6: LED ON Photo Capture (Manual) ===");
  write("=================================================================");
  testStep("Step5_6", "LED ON photo capture");

  write("");
  write("*************************************************************");
  write("*** STEP 5 & 6: LOG INFORMATION ***");
  write("*** Please capture LED ON photo directly ***");
  write("*** Check that LED is ON on the device ***");
  write("*** Include this photo in the test report ***");
  write("*************************************************************");
  write("");

  testStepPass("Step5_6", "LED ON photo capture logged - Manual photo required");

  //============================================================================
  // STEP 7: Trigger driving event, within 50s check RecSta_DEV = 0x1 (Recording)
  //============================================================================
  write("");
  write("=================================================================");
  write("=== STEP 7: Trigger Driving Event + Wait for DEV Recording ===");
  write("=================================================================");
  testStep("Step7", "Driving event + RecSta_DEV = 0x1 (Recording) within 50s");

  // 7.1 Log - Ask user to trigger driving event
  write("");
  write("*************************************************************");
  write("*** ACTION REQUIRED ***");
  write("*** Please trigger driving event now! ***");
  write("*** (Act/trigger driving event on real device) ***");
  write("*** Script will monitor for DEV recording within 50 seconds ***");
  write("*************************************************************");
  write("");

  // 7.2 Enable driving info simulation (optional - if simulation is used)
  // Enable_DrivingInfo();

  // 7.3 Wait for BLTN_CAM_RecSta_DEV = 0x1 (Recording) within 50s
  write("[7.3] Waiting for BLTN_CAM_RecSta_DEV = 0x1 (Recording) within 50 seconds...");
  result = WaitFor_RecSta_DEV_Recording(max_wait_time_50s);

  // 7.4 Capture screenshot
  write("[7.4] Capturing screenshot...");
  CaptureGraphics("BLTN_CAM_RecSta_DEV;BLTN_CAM_RecSet_DEV;BLTN_CAM_HU_UI_Mode;SMK_TrmnlCtrlGrpStaBDC", "OWD_010_03.jpg");

  if(result == 1)
  {
    step7_passed = 1;
    testStepPass("Step7", "BLTN_CAM_RecSta_DEV = 0x1 (Recording) detected - PASS");
  }
  else
  {
    step7_passed = 0;
    testStepFail("Step7", "BLTN_CAM_RecSta_DEV Recording NOT detected within 50s - FAIL");
  }

  //============================================================================
  // STEP 8: Log - LED ON photo capture (manual)
  //============================================================================
  write("");
  write("=================================================================");
  write("=== STEP 8: LED ON Photo Capture (Manual) ===");
  write("=================================================================");
  testStep("Step8", "LED ON photo capture during recording");

  write("");
  write("*************************************************************");
  write("*** STEP 8: LOG INFORMATION ***");
  write("*** Please capture LED ON photo during recording ***");
  write("*** Check that LED is ON (recording indicator) ***");
  write("*** Include this photo in the test report ***");
  write("*************************************************************");
  write("");

  testStepPass("Step8", "LED ON photo capture logged - Manual photo required");

  //============================================================================
  // STEP 9: Wait 15s, capture AIN and BLTN_CAM_RecSta_DEV
  //============================================================================
  write("");
  write("=================================================================");
  write("=== STEP 9: Wait 15s + Capture AIN and RecSta_DEV ===");
  write("=================================================================");
  testStep("Step9", "Wait 15s + AIN and RecSta_DEV capture");

  // 9.1 Wait 15 seconds
  write("[9.1] Waiting 15 seconds...");
  testWaitForTimeout(15000);

  // 9.2 Capture screenshot with AIN and BLTN_CAM_RecSta_DEV
  write("[9.2] Capturing screenshot with AIN and BLTN_CAM_RecSta_DEV...");
  // Note: AIN may refer to analog input or specific signal - using common signals
  CaptureGraphics("BLTN_CAM_RecSta_DEV;BLTN_CAM_RecSet_DEV;SMK_TrmnlCtrlGrpStaBDC", "OWD_010_04.jpg");

  testStepPass("Step9", "Wait 15s + AIN and RecSta_DEV captured - PASS");

  //============================================================================
  // STEP 10: Log - LED ON photo capture (manual)
  //============================================================================
  write("");
  write("=================================================================");
  write("=== STEP 10: LED ON Photo Capture (Manual) ===");
  write("=================================================================");
  testStep("Step10", "LED ON photo capture");

  write("");
  write("*************************************************************");
  write("*** STEP 10: LOG INFORMATION ***");
  write("*** Please capture LED ON photo ***");
  write("*** Check that LED is still ON ***");
  write("*** Include this photo in the test report ***");
  write("*************************************************************");
  write("");

  testStepPass("Step10", "LED ON photo capture logged - Manual photo required");

  //============================================================================
  // STEP 11: Capture AIN and BLTN_CAM_RecSta_DEV
  //============================================================================
  write("");
  write("=================================================================");
  write("=== STEP 11: Capture AIN and RecSta_DEV ===");
  write("=================================================================");
  testStep("Step11", "AIN and RecSta_DEV capture");

  // 11.1 Capture screenshot with AIN and BLTN_CAM_RecSta_DEV
  write("[11.1] Capturing screenshot with AIN and BLTN_CAM_RecSta_DEV...");
  CaptureGraphics("BLTN_CAM_RecSta_DEV;BLTN_CAM_RecSet_DEV;SMK_TrmnlCtrlGrpStaBDC", "OWD_010_05.jpg");

  testStepPass("Step11", "AIN and RecSta_DEV captured - PASS");

  //============================================================================
  // STEP 12: Switch to ACC mode, check BLTN_CAM_RecSta_DEV = 0x0 (OFF)
  //============================================================================
  write("");
  write("=================================================================");
  write("=== STEP 12: Switch to ACC Mode + Check RecSta_DEV = OFF ===");
  write("=================================================================");
  testStep("Step12", "SMK ACC + RecSta_DEV = 0x0 (OFF) verification");

  // 12.1 Set SMK to ACC via panel
  write("[12.1] Setting SMK_Signal to ACC via panel...");
  Set_SMK_ACC();
  testWaitForTimeout(5000);  // 5s delay for signal propagation

  // 12.2 Check BLTN_CAM_RecSta_DEV = 0x0 (OFF)
  write("[12.2] Checking BLTN_CAM_RecSta_DEV = 0x0 (OFF)...");
  result = Check_RecSta_DEV_OFF();

  // 12.3 Capture screenshot
  write("[12.3] Capturing screenshot...");
  CaptureGraphics("BLTN_CAM_RecSta_DEV;BLTN_CAM_RecSet_DEV;BLTN_CAM_HU_UI_Mode;SMK_TrmnlCtrlGrpStaBDC", "OWD_010_06.jpg");

  if(result == 1)
  {
    step12_passed = 1;
    testStepPass("Step12", "BLTN_CAM_RecSta_DEV = 0x0 (OFF) in ACC mode - PASS");
  }
  else
  {
    step12_passed = 0;
    testStepFail("Step12", "BLTN_CAM_RecSta_DEV is NOT OFF in ACC mode - FAIL");
  }

  //============================================================================
  // STEP 13 & 14: Log - LED photo capture (manual)
  //============================================================================
  write("");
  write("=================================================================");
  write("=== STEP 13 & 14: LED Photo Capture (Manual) ===");
  write("=================================================================");
  testStep("Step13_14", "LED photo capture in ACC mode");

  write("");
  write("*************************************************************");
  write("*** STEP 13 & 14: LOG INFORMATION ***");
  write("*** Please capture LED photo in ACC mode ***");
  write("*** Check LED status on the device ***");
  write("*** Include this photo in the test report ***");
  write("*************************************************************");
  write("");

  testStepPass("Step13_14", "LED photo capture logged - Manual photo required");

  //============================================================================
  // STEP 15: In ACC mode, trigger driving event, within 50s check RecSta_DEV = 0x1
  //============================================================================
  write("");
  write("=================================================================");
  write("=== STEP 15: ACC Mode + Driving Event + DEV Recording ===");
  write("=================================================================");
  testStep("Step15", "ACC mode + Driving event + RecSta_DEV = 0x1 within 50s");

  // 15.1 Log - Ask user to trigger driving event in ACC mode
  write("");
  write("*************************************************************");
  write("*** ACTION REQUIRED ***");
  write("*** Still in ACC mode on AVN screen ***");
  write("*** Please trigger driving event now! ***");
  write("*** (Act/trigger driving event on real device) ***");
  write("*** Script will monitor for DEV recording within 50 seconds ***");
  write("*************************************************************");
  write("");

  // 15.2 Wait for BLTN_CAM_RecSta_DEV = 0x1 (Recording) within 50s
  write("[15.2] Waiting for BLTN_CAM_RecSta_DEV = 0x1 (Recording) within 50 seconds...");
  result = WaitFor_RecSta_DEV_Recording(max_wait_time_50s);

  // 15.3 Capture screenshot
  write("[15.3] Capturing screenshot...");
  CaptureGraphics("BLTN_CAM_RecSta_DEV;BLTN_CAM_RecSet_DEV;BLTN_CAM_HU_UI_Mode;SMK_TrmnlCtrlGrpStaBDC", "OWD_010_07.jpg");

  if(result == 1)
  {
    step15_passed = 1;
    testStepPass("Step15", "BLTN_CAM_RecSta_DEV = 0x1 (Recording) in ACC mode - PASS");
  }
  else
  {
    step15_passed = 0;
    testStepFail("Step15", "BLTN_CAM_RecSta_DEV Recording NOT detected in ACC mode - FAIL");
  }

  //============================================================================
  // STEP 16: Log - LED photo capture (manual)
  //============================================================================
  write("");
  write("=================================================================");
  write("=== STEP 16: LED Photo Capture (Manual) ===");
  write("=================================================================");
  testStep("Step16", "LED photo capture during ACC mode recording");

  write("");
  write("*************************************************************");
  write("*** STEP 16: LOG INFORMATION ***");
  write("*** Please capture LED photo during ACC mode recording ***");
  write("*** Check that LED indicates recording ***");
  write("*** Include this photo in the test report ***");
  write("*************************************************************");
  write("");

  testStepPass("Step16", "LED photo capture logged - Manual photo required");

  //============================================================================
  // STEP 17: Wait 15s, capture AIN and BLTN_CAM_RecSta_DEV
  //============================================================================
  write("");
  write("=================================================================");
  write("=== STEP 17: Wait 15s + Capture AIN and RecSta_DEV ===");
  write("=================================================================");
  testStep("Step17", "Wait 15s + AIN and RecSta_DEV capture in ACC mode");

  // 17.1 Wait 15 seconds
  write("[17.1] Waiting 15 seconds...");
  testWaitForTimeout(15000);

  // 17.2 Capture screenshot with AIN and BLTN_CAM_RecSta_DEV
  write("[17.2] Capturing screenshot with AIN and BLTN_CAM_RecSta_DEV...");
  CaptureGraphics("BLTN_CAM_RecSta_DEV;BLTN_CAM_RecSet_DEV;SMK_TrmnlCtrlGrpStaBDC", "OWD_010_08.jpg");

  testStepPass("Step17", "Wait 15s + AIN and RecSta_DEV captured in ACC mode - PASS");

  //============================================================================
  // STEP 18: Log - LED photo capture (manual)
  //============================================================================
  write("");
  write("=================================================================");
  write("=== STEP 18: LED Photo Capture (Manual) ===");
  write("=================================================================");
  testStep("Step18", "LED photo capture");

  write("");
  write("*************************************************************");
  write("*** STEP 18: LOG INFORMATION ***");
  write("*** Please capture LED photo ***");
  write("*** Check LED status ***");
  write("*** Include this photo in the test report ***");
  write("*************************************************************");
  write("");

  testStepPass("Step18", "LED photo capture logged - Manual photo required");

  //============================================================================
  // STEP 19: Wait 15s, capture AIN and BLTN_CAM_RecSta_DEV
  //============================================================================
  write("");
  write("=================================================================");
  write("=== STEP 19: Wait 15s + Capture AIN and RecSta_DEV ===");
  write("=================================================================");
  testStep("Step19", "Wait 15s + Final AIN and RecSta_DEV capture");

  // 19.1 Wait 15 seconds
  write("[19.1] Waiting 15 seconds...");
  testWaitForTimeout(15000);

  // 19.2 Capture screenshot with AIN and BLTN_CAM_RecSta_DEV
  write("[19.2] Capturing screenshot with AIN and BLTN_CAM_RecSta_DEV...");
  CaptureGraphics("BLTN_CAM_RecSta_DEV;BLTN_CAM_RecSet_DEV;SMK_TrmnlCtrlGrpStaBDC", "OWD_010_09.jpg");

  testStepPass("Step19", "Wait 15s + Final AIN and RecSta_DEV captured - PASS");

  //============================================================================
  // Overall Test Verdict
  //============================================================================
  if(step1_passed == 1 && step4_passed == 1 && step7_passed == 1 && step12_passed == 1 && step15_passed == 1)
  {
    testStepPass("Overall_Verdict", "Test OWD_010: PASS");
    write("=== OVERALL VERDICT: PASS ===");
  }
  else
  {
    testStepFail("Overall_Verdict", "Test OWD_010: FAIL");
    write("=== OVERALL VERDICT: FAIL ===");
  }

  //============================================================================
  // TEST COMPLETE
  //============================================================================
  write("");
  write("========================================");
  write("=== TEST OWD_010 COMPLETE ===");
  write("========================================");

  // Cleanup - disable CGW NM and driving info
  @panel::Switch_CGWNM = 0;
  Disable_DrivingInfo();

  write("");
  write("=== FINAL STATUS ===");
  Get_SMK_Status_String(smk_status);
  write("  SMK_TrmnlCtrlGrpStaBDC = 0x%X (%s)", $SMK_TrmnlCtrlGrpStaBDC, smk_status);
  write("  BLTN_CAM_RecSet_DEV = 0x%X", $BLTN_CAM_RecSet_DEV);
  write("  BLTN_CAM_RecSta_DEV = 0x%X", $BLTN_CAM_RecSta_DEV);
  write("  BLTN_CAM_HU_UI_Mode = 0x%X", $BLTN_CAM_HU_UI_Mode);

  write("");
  write("=== TEST SUMMARY ===");
  if(step1_passed == 1)
    write("Step 1: SMK IGN + USM Reset + RecSet_DEV ON + BLTN_CAM + Monitor 15s [Screenshot] - PASS");
  else
    write("Step 1: SMK IGN + USM Reset + RecSet_DEV ON + BLTN_CAM + Monitor 15s [Screenshot] - FAIL");
  write("Step 2-3: LED OFF photo capture [Manual - Include in Report] - PASS");
  if(step4_passed == 1)
    write("Step 4: Exit to AVN + RecSta_DEV = 0x0 (OFF) [Screenshot] - PASS");
  else
    write("Step 4: Exit to AVN + RecSta_DEV = 0x0 (OFF) [Screenshot] - FAIL");
  write("Step 5-6: LED ON photo capture [Manual - Include in Report] - PASS");
  if(step7_passed == 1)
    write("Step 7: Driving event + DEV Recording within 50s [Screenshot] - PASS");
  else
    write("Step 7: Driving event + DEV Recording within 50s [Screenshot] - FAIL");
  write("Step 8: LED ON photo during recording [Manual - Include in Report] - PASS");
  write("Step 9: Wait 15s + AIN & RecSta_DEV capture [Screenshot] - PASS");
  write("Step 10: LED ON photo [Manual - Include in Report] - PASS");
  write("Step 11: AIN & RecSta_DEV capture [Screenshot] - PASS");
  if(step12_passed == 1)
    write("Step 12: SMK ACC + RecSta_DEV = 0x0 (OFF) [Screenshot] - PASS");
  else
    write("Step 12: SMK ACC + RecSta_DEV = 0x0 (OFF) [Screenshot] - FAIL");
  write("Step 13-14: LED photo in ACC mode [Manual - Include in Report] - PASS");
  if(step15_passed == 1)
    write("Step 15: ACC mode + Driving event + DEV Recording within 50s [Screenshot] - PASS");
  else
    write("Step 15: ACC mode + Driving event + DEV Recording within 50s [Screenshot] - FAIL");
  write("Step 16: LED photo during ACC recording [Manual - Include in Report] - PASS");
  write("Step 17: Wait 15s + AIN & RecSta_DEV in ACC mode [Screenshot] - PASS");
  write("Step 18: LED photo [Manual - Include in Report] - PASS");
  write("Step 19: Wait 15s + Final AIN & RecSta_DEV [Screenshot] - PASS");
}

void MainTest()
{
  testReportFileName("TestReports\\OWD_010 - 2.5 generation_report");
  OWD_010();
}
