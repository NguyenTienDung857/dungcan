/*@!Encoding:65001*/

/*
  Test Case: OWD_012
  Title: [DEV Recording Test - Drive Event Recording with Multiple Events]
  Verification items:
    - Check DEV recording status when driving event is triggered (BLTN_CAM_RecSta_DEV = 0x1)
    - Verify continuous DEV recording during consecutive driving events
    - Verify DEV recording behavior when entering Build-in Cam mode
    - Verify DEV recording behavior when switching to ACC mode
    - Manual verification step

  Preconditions:
    - ACC and IGN and ccNC/ccIC switch OFF, AVN mode

  Test Steps:
    Step 1: Set SMK to IGN, USM Reset, Rec Reset
            Log "Tac dong su kien ghi hinh khi lai xe", wait 60s for BLTN_CAM_RecSta_DEV = ON
            Wait 10s, capture screenshot, log "Check man hinh"
    Step 2: Log "Tac dong tiep su kien ghi hinh", wait 60s for RecSta_DEV = ON
            Trigger again, check RecSta_DEV still ON after 4s -> PASS
            Capture screenshot, log "Check man hinh"
    Step 3: Log "Tac dong su kien ghi hinh", wait 60s for RecSta_DEV = ON
            Immediately enter Build-in Cam, capture screenshot, log "Check file video"
    Step 4: Log "Tac dong su kien ghi hinh", wait 60s for RecSta_DEV = ON
            Immediately switch to ACC mode, capture screenshot, log "Check file khi tat may"
    Step 5: Log "Phai tu lam bang tay"
    Steps 6-10: Log only (Giong steps 1-5) - No execution, only logging

  NOTE: Uses 2s delay for signal propagation after each state transition.
*/

variables
{
  long max_wait_time_60s = 60000;   // 60 seconds for DEV recording detection
  long wait_time_10s = 10000;       // 10 seconds wait
  long wait_time_4s = 4000;         // 4 seconds wait for continuous recording check

  // Message declarations
  // CAN FD Message Declaration
  message HU_BLTN_CAM_02_200ms _HU_BLTN_CAM_02_200ms;

  // Result tracking variables
  int step1_passed = 0;
  int step2_passed = 0;
  int step3_passed = 0;
  int step4_passed = 0;
}

// ============================================================================
// Panel Control Helper Functions
// ============================================================================

// Set SMK to IGN (0x2) via panel
void Set_SMK_IGN()
{
  write("=== Setting SMK_Signal to IGN via panel ===");
  setSignal(SMK_TrmnlCtrlGrpStaBDC, 0x2);  // IGN
  testWaitForTimeout(2000);  // Wait 2s for signal propagation
  write("  SMK_TrmnlCtrlGrpStaBDC = 0x%X (IGN)", $SMK_TrmnlCtrlGrpStaBDC);
}

// Set SMK to ACC (0x1) via panel
void Set_SMK_ACC()
{
  write("=== Setting SMK_Signal to ACC via panel ===");
  setSignal(SMK_TrmnlCtrlGrpStaBDC, 0x1);  // ACC
  testWaitForTimeout(2000);  // Wait 2s for signal propagation
  write("  SMK_TrmnlCtrlGrpStaBDC = 0x%X (ACC)", $SMK_TrmnlCtrlGrpStaBDC);
}

// Get SMK status string
void Get_SMK_Status_String(char result[])
{
  byte smk_val;
  smk_val = $SMK_TrmnlCtrlGrpStaBDC;

  if(smk_val == 0x2)
    snprintf(result, 10, "%s", "IGN");
  else if(smk_val == 0x1)
    snprintf(result, 10, "%s", "ACC");
  else if(smk_val == 0x0)
    snprintf(result, 10, "%s", "OFF");
  else
    snprintf(result, 10, "%s", "Unknown");
}

void Click_USM_Reset()
{
  write("=== Clicking USM Reset button on panel ===");
  @panel::Button_USMReset = 1;
  testWaitForTimeout(5000);
  write("  USM Reset clicked");
}

void Click_Rec_Reset()
{
  write("=== Clicking Rec Reset button on panel ===");
  @panel::Button_RecReset = 1;
  testWaitForTimeout(5000);
  write("  Rec Reset clicked");
}

// Enter Built-in Cam mode (HU_BLTN_CAM_UI_Mode = 0x1)
void Enter_BLTN_CAM()
{
  write(">>> Enter BLTN_CAM mode <<<");
  _HU_BLTN_CAM_02_200ms.HU_BLTN_CAM_UI_Mode = 0x1;
  output(_HU_BLTN_CAM_02_200ms);
  testWaitForTimeout(3000);
}

// Exit to AVN HU UI mode (HU_BLTN_CAM_UI_Mode = 0x0)
void Exit_BLTN_CAM()
{
  write(">>> Exit BLTN_CAM mode <<<");
  _HU_BLTN_CAM_02_200ms.HU_BLTN_CAM_UI_Mode = 0x0;
  output(_HU_BLTN_CAM_02_200ms);
  testWaitForTimeout(3000);
}

// ============================================================================
// Check Functions
// ============================================================================

// Wait for BLTN_CAM_RecSta_DEV = 0x1 (ON) with timeout
int WaitFor_RecSta_DEV_ON(long timeout_ms)
{
  long elapsed = 0;
  long check_interval = 2000;  // Check every 2 seconds
  byte rec_sta_dev = 0;
  long log_interval;

  write("=== Waiting for DEV Recording ON (max %d seconds) ===", timeout_ms / 1000);
  write("Checking every %d seconds...", check_interval / 1000);

  log_interval = (timeout_ms / 6 / check_interval) * check_interval;
  if(log_interval < check_interval) log_interval = check_interval;

  while(elapsed < timeout_ms)
  {
    rec_sta_dev = $BLTN_CAM_RecSta_DEV;

    if(elapsed == 0 || elapsed % log_interval == 0)
    write("  [%d s / %d s] BLTN_CAM_RecSta_DEV = 0x%X",
          elapsed / 1000, timeout_ms / 1000, rec_sta_dev);

    // Check if DEV recording is ON
    if(rec_sta_dev == 0x1)
    {
      write(">>> DETECTED: DEV Recording ON after %d seconds <<<", elapsed / 1000);
      write(">>> PASS: BLTN_CAM_RecSta_DEV = 0x1 (ON) <<<");
      return 1;
    }

    testWaitForTimeout(check_interval);
    elapsed += check_interval;
  }

  // Timeout - DEV recording not detected
  write(">>> TIMEOUT: DEV Recording NOT detected after %d seconds <<<", timeout_ms / 1000);
  write(">>> FAIL: BLTN_CAM_RecSta_DEV is still 0x%X <<<", rec_sta_dev);
  return 0;
}

// Check BLTN_CAM_RecSta_DEV remains ON (0x1) for specified duration
int Check_RecSta_DEV_Still_ON(long timeout_ms)
{
  long elapsed = 0;
  long check_interval = 2000;  // Check every 2 seconds
  byte rec_sta_dev = 0;
  long log_interval;

  write("=== Checking DEV Recording stays ON for %d seconds ===", timeout_ms / 1000);

  log_interval = (timeout_ms / 6 / check_interval) * check_interval;
  if(log_interval < check_interval) log_interval = check_interval;

  while(elapsed < timeout_ms)
  {
    rec_sta_dev = $BLTN_CAM_RecSta_DEV;

    if(elapsed == 0 || elapsed % log_interval == 0)
    write("  [%d s / %d s] BLTN_CAM_RecSta_DEV = 0x%X",
          elapsed / 1000, timeout_ms / 1000, rec_sta_dev);

    if(rec_sta_dev != 0x1)
    {
      write(">>> FAIL: DEV Recording turned OFF at %d seconds <<<", elapsed / 1000);
      return 0;
    }

    testWaitForTimeout(check_interval);
    elapsed += check_interval;
  }

  write(">>> PASS: DEV Recording remained ON for %d seconds <<<", timeout_ms / 1000);
  return 1;
}

// ============================================================================
// Capture Screenshot Function
// ============================================================================

void CaptureGraphics(char signalList[], char filename[])
{
  char filepath[256];
  snprintf(filepath, elcount(filepath), "D:\\project\\CAN FD\\[CANoe] CANFD\\Screenshots\\%s", filename);
  testWaitForTimeout(3000);
  testReportAddWindowCapture("OWD", signalList, "Screenshot", filepath);
  write(">>> Screenshot captured: %s <<<", filepath);
}

// ============================================================================
// Main Test Case
// ============================================================================

testcase OWD_012()
{
  int result = 0;
  int result2 = 0;
  char smk_status[10];

  write("========================================");
  write("=== START TEST OWD_012 ===");
  write("=== DEV Recording - Multiple Events Test ===");
  write("========================================");

  // Enable CGW NM
  @panel::Switch_CGWNM = 1;
  testWaitForTimeout(3000);

  //############################################################################
  //### ROUND 1: Steps 1-5
  //############################################################################
  write("");
  write("###############################################################");
  write("### ROUND 1: Steps 1 - 5 ###");
  write("###############################################################");

  //============================================================================
  // STEP 1: Set SMK to IGN, USM Reset, Rec Reset
  //         Trigger DEV event, wait 60s for RecSta_DEV = ON
  //         Wait 10s, capture screenshot, log check screen
  //============================================================================
  write("");
  write("=================================================================");
  write("=== STEP 1: SMK IGN + USM Reset + Rec Reset + DEV Recording ===");
  write("=================================================================");
  testStep("Step1", "SMK IGN + USM Reset + Rec Reset + DEV Recording Check");

  // 1.1 Set SMK to IGN via panel
  write("[1.1] Setting SMK_Signal to IGN via panel...");
  Set_SMK_IGN();
  testWaitForTimeout(2000);

  // 1.2 Click USM Reset button
  write("[1.2] Clicking USM Reset button...");
  Click_USM_Reset();
  testWaitForTimeout(2000);

  // 1.3 Click Rec Reset button
  write("[1.3] Clicking Rec Reset button...");
  Click_Rec_Reset();
  testWaitForTimeout(2000);

  // 1.4 Log action required
  write("");
  write("*************************************************************");
  write("*** TAC DONG SU KIEN GHI HINH KHI LAI XE ***");
  write("*** Please trigger driving recording event now! ***");
  write("*************************************************************");
  write("");

  // 1.5 Wait for RecSta_DEV = ON within 60s
  write("[1.5] Waiting for BLTN_CAM_RecSta_DEV = ON within 60 seconds...");
  result = WaitFor_RecSta_DEV_ON(max_wait_time_60s);

  if(result == 1)
  {
    // 1.6 Wait 10 seconds
    write("[1.6] DEV Recording ON - Waiting 10 seconds...");
    testWaitForTimeout(wait_time_10s);

    // 1.7 Capture screenshot
    write("[1.7] Capturing screenshot...");
    CaptureGraphics("BLTN_CAM_RecSta_DEV;BLTN_CAM_RecSet_DEV;AIN;ENG_AccelPdlVal;CLU_DisSpdVal;SMK_TrmnlCtrlGrpStaBDC", "OWD_012_01.jpg");

    write("");
    write("*************************************************************");
    write("*** STEP 1: CHECK MAN HINH ***");
    write("*** Vui long kiem tra man hinh ghi hinh ***");
    write("*************************************************************");
    write("");

    step1_passed = 1;
    testStepPass("Step1", "DEV Recording ON detected + Wait 10s + Screenshot - PASS");
  }
  else
  {
    CaptureGraphics("BLTN_CAM_RecSta_DEV;BLTN_CAM_RecSet_DEV;AIN;SMK_TrmnlCtrlGrpStaBDC", "OWD_012_01.jpg");
    step1_passed = 0;
    testStepFail("Step1", "DEV Recording NOT detected within 60s - FAIL");
  }

  //============================================================================
  // STEP 2: Trigger consecutive DEV event
  //         Wait 60s for RecSta_DEV = ON, log trigger again
  //         Check RecSta_DEV still ON after 8s -> PASS
  //         Capture screenshot, log check screen
  //============================================================================
  write("");
  write("=================================================================");
  write("=== STEP 2: Consecutive DEV Event + Continuous Recording 8s ===");
  write("=================================================================");
  testStep("Step2", "Consecutive DEV Event + Continuous Recording Check");

  // 2.1 Log action required
  write("");
  write("*************************************************************");
  write("*** TAC DONG TIEP SU KIEN GHI HINH KHI LAI XE ***");
  write("*** Please trigger another driving recording event! ***");
  write("*************************************************************");
  write("");

  // 2.2 Wait for RecSta_DEV = ON within 60s
  write("[2.2] Waiting for BLTN_CAM_RecSta_DEV = ON within 60 seconds...");
  result = WaitFor_RecSta_DEV_ON(max_wait_time_60s);

  if(result == 1)
  {
    // 2.3 Log trigger again
    write("");
    write("*************************************************************");
    write("*** TAC DONG TIEP! ***");
    write("*** DEV Recording ON detected - Triggering again ***");
    write("*************************************************************");
    write("");

    // 2.4 Check RecSta_DEV still ON for 4 seconds
    write("[2.4] Checking DEV Recording stays ON for 4 seconds...");
    result2 = Check_RecSta_DEV_Still_ON(wait_time_4s);

    // 2.5 Capture screenshot
    write("[2.5] Capturing screenshot...");
    CaptureGraphics("BLTN_CAM_RecSta_DEV;BLTN_CAM_RecSet_DEV;AIN;ENG_AccelPdlVal;CLU_DisSpdVal;SMK_TrmnlCtrlGrpStaBDC", "OWD_012_02.jpg");

    write("");
    write("*************************************************************");
    write("*** STEP 2: CHECK MAN HINH ***");
    write("*** Vui long kiem tra man hinh ghi hinh ***");
    write("*************************************************************");
    write("");

    if(result2 == 1)
    {
      step2_passed = 1;
      testStepPass("Step2", "DEV Recording remained ON for 4s - PASS");
    }
    else
    {
      step2_passed = 0;
      testStepFail("Step2", "DEV Recording did NOT remain ON for 4s - FAIL");
    }
  }
  else
  {
    CaptureGraphics("BLTN_CAM_RecSta_DEV;BLTN_CAM_RecSet_DEV;AIN;SMK_TrmnlCtrlGrpStaBDC", "OWD_012_02.jpg");
    step2_passed = 0;
    testStepFail("Step2", "DEV Recording NOT detected within 60s - FAIL");
  }

  //============================================================================
  // STEP 3: Trigger DEV event, wait 60s for RecSta_DEV = ON
  //         Immediately enter Build-in Cam
  //         Capture screenshot, log check video file
  //============================================================================
  write("");
  write("=================================================================");
  write("=== STEP 3: DEV Event + Enter Build-in Cam ===");
  write("=================================================================");
  testStep("Step3", "DEV Event + Enter Build-in Cam");

  // 3.1 Log action required
  write("");
  write("*************************************************************");
  write("*** TAC DONG SU KIEN GHI HINH KHI LAI XE ***");
  write("*** Please trigger driving recording event now! ***");
  write("*************************************************************");
  write("");

  // 3.2 Wait for RecSta_DEV = ON within 60s
  write("[3.2] Waiting for BLTN_CAM_RecSta_DEV = ON within 60 seconds...");
  result = WaitFor_RecSta_DEV_ON(max_wait_time_60s);

  if(result == 1)
  {
    // 3.3 Immediately enter Build-in Cam mode
    write("[3.3] DEV Recording ON - Immediately entering Build-in Cam...");
    Enter_BLTN_CAM();

    // 3.4 Capture screenshot
    write("[3.4] Capturing screenshot...");
    CaptureGraphics("BLTN_CAM_RecSta_DEV;BLTN_CAM_RecSet_DEV;BLTN_CAM_HU_UI_Mode;AIN;SMK_TrmnlCtrlGrpStaBDC", "OWD_012_03.jpg");

    write("");
    write("*************************************************************");
    write("*** STEP 3: CHECK FILE VIDEO ***");
    write("*** Vui long kiem tra file video ghi hinh ***");
    write("*************************************************************");
    write("");

    step3_passed = 1;
    testStepPass("Step3", "DEV Recording ON + Entered Build-in Cam + Screenshot - PASS");
  }
  else
  {
    CaptureGraphics("BLTN_CAM_RecSta_DEV;BLTN_CAM_RecSet_DEV;BLTN_CAM_HU_UI_Mode;AIN;SMK_TrmnlCtrlGrpStaBDC", "OWD_012_03.jpg");
    step3_passed = 0;
    testStepFail("Step3", "DEV Recording NOT detected within 60s - FAIL");
  }

  // Exit Build-in Cam to return to AVN mode for next step
  write("[3.5] Returning to AVN HU UI mode...");
  Exit_BLTN_CAM();
  testWaitForTimeout(2000);

  //============================================================================
  // STEP 4: Trigger DEV event, wait 60s for RecSta_DEV = ON
  //         Immediately switch to ACC mode
  //         Capture screenshot, log check file when engine off
  //============================================================================
  write("");
  write("=================================================================");
  write("=== STEP 4: DEV Event + Switch to ACC Mode ===");
  write("=================================================================");
  testStep("Step4", "DEV Event + Switch to ACC Mode");

  // 4.1 Log action required
  write("");
  write("*************************************************************");
  write("*** TAC DONG SU KIEN GHI HINH KHI LAI XE ***");
  write("*** Please trigger driving recording event now! ***");
  write("*************************************************************");
  write("");

  // 4.2 Wait for RecSta_DEV = ON within 60s
  write("[4.2] Waiting for BLTN_CAM_RecSta_DEV = ON within 60 seconds...");
  result = WaitFor_RecSta_DEV_ON(max_wait_time_60s);

  if(result == 1)
  {
    // 4.3 Immediately switch to ACC mode
    write("[4.3] DEV Recording ON - Immediately switching to ACC mode...");
    Set_SMK_ACC();

    // 4.4 Capture screenshot
    write("[4.4] Capturing screenshot...");
    CaptureGraphics("BLTN_CAM_RecSta_DEV;BLTN_CAM_RecSet_DEV;AIN;SMK_TrmnlCtrlGrpStaBDC", "OWD_012_04.jpg");

    write("");
    write("*************************************************************");
    write("*** STEP 4: CHECK FILE KHI TAT MAY ***");
    write("*** Vui long kiem tra file ghi hinh khi tat may ***");
    write("*************************************************************");
    write("");

    step4_passed = 1;
    testStepPass("Step4", "DEV Recording ON + Switched to ACC + Screenshot - PASS");
  }
  else
  {
    CaptureGraphics("BLTN_CAM_RecSta_DEV;BLTN_CAM_RecSet_DEV;AIN;SMK_TrmnlCtrlGrpStaBDC", "OWD_012_04.jpg");
    step4_passed = 0;
    testStepFail("Step4", "DEV Recording NOT detected within 60s - FAIL");
  }

  //============================================================================
  // STEP 5: Manual verification step
  //============================================================================
  write("");
  write("=================================================================");
  write("=== STEP 5: Manual Verification Required ===");
  write("=================================================================");
  testStep("Step5", "Manual Verification Required");

  write("");
  write("*************************************************************");
  write("*** STEP 5: PHAI TU LAM BANG TAY ***");
  write("*** Buoc nay phai thuc hien thu cong ***");
  write("*** Vui long thuc hien buoc nay bang tay ***");
  write("*************************************************************");
  write("");

  testStepPass("Step5", "Manual verification step logged");

  //############################################################################
  //### ROUND 2: Steps 6-10 (Giong buoc 1-5 - CHI GHI LOG)
  //############################################################################
  write("");
  write("###############################################################");
  write("### ROUND 2: Steps 6 - 10 (Giong buoc 1 - 5) ###");
  write("###############################################################");

  //============================================================================
  // STEP 6: (Giong Step 1) - Log only
  //============================================================================
  write("");
  write("=================================================================");
  write("=== STEP 6: (Giong Step 1) - LOG ONLY ===");
  write("=================================================================");
  testStep("Step6", "(Giong Step 1) Log only - No execution");

  write("");
  write("*************************************************************");
  write("*** STEP 6: GIONG BUOC 1 ***");
  write("*** Set SMK to IGN, USM Reset, Rec Reset ***");
  write("*** Tac dong su kien ghi hinh khi lai xe ***");
  write("*** Wait 60s for BLTN_CAM_RecSta_DEV = ON ***");
  write("*** Wait 10s, capture screenshot, check man hinh ***");
  write("*************************************************************");
  write("");

  testStepPass("Step6", "(Giong Step 1) - Log only");

  //============================================================================
  // STEP 7: (Giong Step 2) - Log only
  //============================================================================
  write("");
  write("=================================================================");
  write("=== STEP 7: (Giong Step 2) - LOG ONLY ===");
  write("=================================================================");
  testStep("Step7", "(Giong Step 2) Log only - No execution");

  write("");
  write("*************************************************************");
  write("*** STEP 7: GIONG BUOC 2 ***");
  write("*** Tac dong tiep su kien ghi hinh khi lai xe ***");
  write("*** Wait 60s for RecSta_DEV = ON ***");
  write("*** Trigger again, check RecSta_DEV still ON after 4s -> PASS ***");
  write("*** Capture screenshot, check man hinh ***");
  write("*************************************************************");
  write("");

  testStepPass("Step7", "(Giong Step 2) - Log only");

  //============================================================================
  // STEP 8: (Giong Step 3) - Log only
  //============================================================================
  write("");
  write("=================================================================");
  write("=== STEP 8: (Giong Step 3) - LOG ONLY ===");
  write("=================================================================");
  testStep("Step8", "(Giong Step 3) Log only - No execution");

  write("");
  write("*************************************************************");
  write("*** STEP 8: GIONG BUOC 3 ***");
  write("*** Tac dong su kien ghi hinh khi lai xe ***");
  write("*** Wait 60s for RecSta_DEV = ON ***");
  write("*** Immediately enter Build-in Cam ***");
  write("*** Capture screenshot, check file video ***");
  write("*************************************************************");
  write("");

  testStepPass("Step8", "(Giong Step 3) - Log only");

  //============================================================================
  // STEP 9: (Giong Step 4) - Log only
  //============================================================================
  write("");
  write("=================================================================");
  write("=== STEP 9: (Giong Step 4) - LOG ONLY ===");
  write("=================================================================");
  testStep("Step9", "(Giong Step 4) Log only - No execution");

  write("");
  write("*************************************************************");
  write("*** STEP 9: GIONG BUOC 4 ***");
  write("*** Tac dong su kien ghi hinh khi lai xe ***");
  write("*** Wait 60s for RecSta_DEV = ON ***");
  write("*** Immediately switch to ACC mode ***");
  write("*** Capture screenshot, check file khi tat may ***");
  write("*************************************************************");
  write("");

  testStepPass("Step9", "(Giong Step 4) - Log only");

  //============================================================================
  // STEP 10: (Giong Step 5) - Log only
  //============================================================================
  write("");
  write("=================================================================");
  write("=== STEP 10: (Giong Step 5) - LOG ONLY ===");
  write("=================================================================");
  testStep("Step10", "(Giong Step 5) Log only - No execution");

  write("");
  write("*************************************************************");
  write("*** STEP 10: GIONG BUOC 5 ***");
  write("*** PHAI TU LAM BANG TAY ***");
  write("*** Buoc nay phai thuc hien thu cong ***");
  write("*************************************************************");
  write("");

  testStepPass("Step10", "(Giong Step 5) - Log only");

  //============================================================================
  // Overall Test Verdict
  //============================================================================
  if(step1_passed == 1 && step2_passed == 1 && step3_passed == 1 && step4_passed == 1)
  {
    testStepPass("Overall_Verdict", "Test OWD_012: PASS");
    write("=== OVERALL VERDICT: PASS ===");
  }
  else
  {
    testStepFail("Overall_Verdict", "Test OWD_012: FAIL");
    write("=== OVERALL VERDICT: FAIL ===");
  }

  //============================================================================
  // TEST COMPLETE
  //============================================================================
  write("");
  write("========================================");
  write("=== TEST OWD_012 COMPLETE ===");
  write("========================================");

  // Cleanup - disable CGW NM
  @panel::Switch_CGWNM = 0;

  write("");
  write("=== FINAL STATUS ===");
  Get_SMK_Status_String(smk_status);
  write("  SMK_TrmnlCtrlGrpStaBDC = 0x%X (%s)", $SMK_TrmnlCtrlGrpStaBDC, smk_status);
  write("  BLTN_CAM_RecSet_DEV = 0x%X", $BLTN_CAM_RecSet_DEV);
  write("  BLTN_CAM_RecSta_DEV = 0x%X", $BLTN_CAM_RecSta_DEV);
  write("  BLTN_CAM_HU_UI_Mode = 0x%X", $BLTN_CAM_HU_UI_Mode);

  write("");
  write("=== TEST SUMMARY ===");
  write("--- Round 1 ---");
  if(step1_passed == 1)
    write("Step 1: SMK IGN + USM Reset + Rec Reset + DEV Recording (60s) + Wait 10s [Screenshot] -> PASS");
  else
    write("Step 1: SMK IGN + USM Reset + Rec Reset + DEV Recording (60s) + Wait 10s [Screenshot] -> FAIL");
  if(step2_passed == 1)
    write("Step 2: Consecutive DEV Event + Continuous Recording 4s [Screenshot] -> PASS");
  else
    write("Step 2: Consecutive DEV Event + Continuous Recording 4s [Screenshot] -> FAIL");
  if(step3_passed == 1)
    write("Step 3: DEV Event + Enter Build-in Cam [Screenshot] -> PASS");
  else
    write("Step 3: DEV Event + Enter Build-in Cam [Screenshot] -> FAIL");
  if(step4_passed == 1)
    write("Step 4: DEV Event + Switch to ACC [Screenshot] -> PASS");
  else
    write("Step 4: DEV Event + Switch to ACC [Screenshot] -> FAIL");
  write("Step 5: Manual verification [Log only] -> PASS");
  write("--- Round 2 ---");
  write("Step 6: (Giong Step 1) - LOG ONLY -> PASS");
  write("Step 7: (Giong Step 2) - LOG ONLY -> PASS");
  write("Step 8: (Giong Step 3) - LOG ONLY -> PASS");
  write("Step 9: (Giong Step 4) - LOG ONLY -> PASS");
  write("Step 10: (Giong Step 5) - LOG ONLY -> PASS");
}

void MainTest()
{
  testReportFileName("TestReports\\OWD_012 - 2.5 generation_report");
  OWD_012();
}
