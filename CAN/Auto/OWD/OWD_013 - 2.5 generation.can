/*@!Encoding:65001*/

includes {
#include "../DeclarationFunction_Gen2.5.h"
}

// Preconditions: - ACC and IGN and ccNC/ccIC switch OFF, AVN mode
// Add signal to graphic 2: BLTN_CAM_RecSta_DEV;AIN
variables {
  // Global Variable Declaration
  float count_DEVRec_time = 0.0;
  byte value_Bfr = 0x0;
  byte value_Aft = 0x0;
  // Message Declaration for CAN FD (required by header functions)
  message HU_BLTN_CAM_PE_00_200ms _HU_BLTN_CAM_PE_00_200ms;
  message HU_BLTN_CAM_E_01 _HU_BLTN_CAM_E_01;
  message HU_CLOCK_PE_02 _HU_CLOCK_PE_02;

  // Result tracking variables
  int step1_passed = 0;
  int step2_passed = 0;
  int step3_passed = 0;
}

void BLTN_CAM_Settings(int Choose_Option) {
  switch (Choose_Option) {
  case (1):
    if ($BLTN_CAM_RecSet_DEV == 0x1) {
      @panel::LED_Ctrl_SetDEV = 1;

      testWaitForTimeout(500);

      if ($BLTN_CAM_RecSet_DEV == 0x2) {

        write("DEV: 0x%X (ON)", $BLTN_CAM_RecSet_DEV);
      } else if ($BLTN_CAM_RecSet_DEV == 0x1) {

        write("DEV: 0x%X (OFF)", $BLTN_CAM_RecSet_DEV);
      }
    }
    testWaitForTimeout(500);
    value_Bfr = 0x0;
    write("Bft: -10");
    @panel::TrackBar_EV_Time_Bfr = 3; /*Before Time Setting: -10s*/
    testWaitForTimeout(500);
    value_Aft = 0x0;
    write("Aft: +10");
    @panel::TrackBar_EV_Time_Aft = 10; /*After Time Setting: +10s*/
    break;
  case (2):
    if ($BLTN_CAM_RecSet_DEV == 0x1) {
      @panel::LED_Ctrl_SetDEV = 1;

      if ($BLTN_CAM_RecSet_DEV == 0x2) {

        write("DEV: 0x%X (ON)", $BLTN_CAM_RecSet_DEV);
      } else if ($BLTN_CAM_RecSet_DEV == 0x1) {

        write("DEV: 0x%X (OFF)", $BLTN_CAM_RecSet_DEV);
      }
    }
    testWaitForTimeout(500);
    value_Bfr = 0x0;
    write("Bft: -10");
    @panel::TrackBar_EV_Time_Bfr = 3; /*Before Time Setting: -10s*/
    testWaitForTimeout(500);
    value_Aft = 0x5;
    write("Bft: +15");
    @panel::TrackBar_EV_Time_Aft = 15; /*After Time Setting: +15s*/
    break;
  case (3):
    if ($BLTN_CAM_RecSet_DEV == 0x1) {
      @panel::LED_Ctrl_SetDEV = 1;

      if ($BLTN_CAM_RecSet_DEV == 0x2) {

        write("DEV: 0x%X (ON)", $BLTN_CAM_RecSet_DEV);
      } else if ($BLTN_CAM_RecSet_DEV == 0x1) {

        write("DEV: 0x%X (OFF)", $BLTN_CAM_RecSet_DEV);
      }
    }
    testWaitForTimeout(500);
    value_Bfr = 0x0;
    write("Bft: -10");
    @panel::TrackBar_EV_Time_Bfr = 3; /*Before Time Setting: -10s*/
    testWaitForTimeout(500);
    value_Aft = 0xA;
    write("Bft: +20");
    @panel::TrackBar_EV_Time_Aft = 20; /*After Time Setting: +20s*/
    break;
  }

  testWaitForTimeout(500);

  if ($BLTN_CAM_Set_EV_BfrTime != value_Bfr) {

    write("Bfr_time is not match");

    write("Stop test");
    //stop();

  } else if ($BLTN_CAM_Set_EV_AftTime != value_Aft) {

    write("Aft_time is not match");

    write("Stop test");
    //stop();
  }
}

void Setup_Function(int Option) {
  float start_sec, end_sec;

  @panel::Switch_CGWNM = 1;

  KEY_ON();
  testWaitForTimeout(3000);

  Enter_BLTN_CAM();
  testWaitForTimeout(3000);

  BLTN_CAM_Settings(Option);
  testWaitForTimeout(2000);

  @panel::Switch_Clock = 1;

  Exit_BLTN_CAM();

  testWaitForTimeout(11000);

  if (WaitFor_RecSta_DEV_Recording(100) == 1) {
    start_sec = timeNow() / 100000.0;
  } else {
    write("Error: DEV recording hasn't started. Stop test !!!");
    //stop();
  }

  if (WaitFor_RecSta_DEV_OFF(100) == 1) {
    end_sec = timeNow() / 100000.0;
  }

  count_DEVRec_time = end_sec - start_sec;
}

testcase OWD_013_1() {
  Send_Value_To_COM(11301);
  SetTestStep("Bước 1 - OWD_013");
  StartTestTimer();

  testStep("Notification", "Start test OWD_013_1");
  testStep("Step1", "DEV recording time check: BfrTime=-10s, AftTime=+10s -> "
                    "expected duration 9~11s");
  write("=== START OWD_013_1 ===");

  Set_SMK_IGN();
  Click_USM_Reset();
  Click_Rec_Reset();

  Setup_Function(1);
  write("Run Setup_Function()");

  if (count_DEVRec_time >= 9 && count_DEVRec_time <= 11) {
    step1_passed = 1;
    testStepPass("Pass", "Test-case is OK");
    write("count_DEVRec_time = %.2f", count_DEVRec_time);
  } else {
    step1_passed = 0;
    write(">>> FAIL REASON: count_DEVRec_time=%.2f is outside expected range "
          "[9-11]s <<<",
          count_DEVRec_time);
    Log_Error_Details();
    testStepFail("Fail", "Test-case is NG");
    write("count_DEVRec_time = %.2f", count_DEVRec_time);
  }

  CaptureGraphics("OWD", "BLTN_CAM_RecSta_DEV;AIN");
  write("Run CaptureGraphics()");

  testWaitForTimeout(1000);

  @panel::Switch_CGWNM = 0;

  @panel::Switch_Clock = 0;

  count_DEVRec_time = 0.0;

  KEY_OFF();
  write("Run KEY_OFF()");

  write("");
  write("=== TEST SUMMARY ===");
  if (step1_passed == 1)
    write("OWD_013_1: PASS");
  else
    write("OWD_013_1: FAIL");

  testStep("Notifications", "Finish OWD_013_1");
  write("=== FINISH OWD_013_1 ===");
  StopTestTimer();
  Send_Value_To_COM(44);
}

testcase OWD_013_2() {
  Send_Value_To_COM(11302);
  SetTestStep("Bước 2 - OWD_013");
  StartTestTimer();

  testStep("Notification", "Start test OWD_013_2");
  testStep("Step2", "DEV recording time check: BfrTime=-10s, AftTime=+15s -> "
                    "expected duration 14~16s");
  write("=== START OWD_013_2 ===");

  Setup_Function(2);
  write("Run Setup_Function()");

  if (count_DEVRec_time >= 14 && count_DEVRec_time <= 16) {
    step2_passed = 1;
    testStepPass("Pass", "Test-case is OK");
    write("count_DEVRec_time = %.2f", count_DEVRec_time);
  } else {
    step2_passed = 0;
    write(">>> FAIL REASON: count_DEVRec_time=%.2f is outside expected range "
          "[14-16]s <<<",
          count_DEVRec_time);
    Log_Error_Details();
    testStepFail("Fail", "Test-case is NG");
    write("count_DEVRec_time = %.2f", count_DEVRec_time);
  }

  CaptureGraphics("OWD", "BLTN_CAM_RecSta_DEV;AIN");
  write("Run CaptureGraphics()");

  testWaitForTimeout(1000);

  @panel::Switch_CGWNM = 0;

  @panel::Switch_Clock = 0;

  count_DEVRec_time = 0.0;

  KEY_OFF();
  write("Run KEY_OFF()");

  write("");
  write("=== TEST SUMMARY ===");
  if (step2_passed == 1)
    write("OWD_013_2: PASS");
  else
    write("OWD_013_2: FAIL");

  testStep("Notifications", "Finish OWD_013_2");
  write("=== FINISH OWD_013_2 ===");
  StopTestTimer();
  Send_Value_To_COM(44);
}

testcase OWD_013_3() {
  Send_Value_To_COM(11303);
  SetTestStep("Bước 3 - OWD_013");
  StartTestTimer();

  testStep("Notification", "Start test OWD_013_3");
  testStep("Step3", "DEV recording time check: BfrTime=-10s, AftTime=+20s -> "
                    "expected duration 19~21s");
  write("=== START OWD_013_3 ===");

  Setup_Function(3);
  write("Run Setup_Function()");

  if (count_DEVRec_time >= 19 && count_DEVRec_time <= 21) {
    step3_passed = 1;
    testStepPass("Pass", "Test-case is OK");
    write("count_DEVRec_time = %.2f", count_DEVRec_time);
  } else {
    step3_passed = 0;
    write(">>> FAIL REASON: count_DEVRec_time=%.2f is outside expected range "
          "[19-21]s <<<",
          count_DEVRec_time);
    Log_Error_Details();
    testStepFail("Fail", "Test-case is NG");
    write("count_DEVRec_time = %.2f", count_DEVRec_time);
  }

  CaptureGraphics("OWD", "BLTN_CAM_RecSta_DEV;AIN");
  write("Run CaptureGraphics()");

  testWaitForTimeout(1000);

  @panel::Switch_CGWNM = 0;

  @panel::Switch_Clock = 0;

  count_DEVRec_time = 0.0;

  KEY_OFF();
  write("Run KEY_OFF()");

  testStep("Notifications", "Finish OWD_013_3");
  write("=== FINISH OWD_013_3 ===");
  StopTestTimer();
  Send_Value_To_COM(44);
}

testcase OWD_013_Init() {
  Send_Value_To_COM(11300);
  testStep("Notification", "Start OWD_013 Initialization");
  write("Run Rec_Reset()");
  Rec_Reset();
  Send_Value_To_COM(44);
}


void MainTest() {
  testReportFileName("TestReports\\OWD_013 - 2.5 generation_report");

  OWD_013_Init();
  OWD_013_1();
  OWD_013_2();
  OWD_013_3();
}
