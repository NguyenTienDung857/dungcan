/*@!Encoding:65001*/

includes
{
  #include "../DeclarationFunction_Gen2.5.h"
}

/*
  Test Case: OWD_018
  Title: [MAR Recording Test - ACC Mode + Event Switch in AVN Mode]
  Verification items:
    - Check that BLTN_CAM mode CANNOT be entered when in ACC mode
    - Verify BLTN_CAM_RecSta_MAR = 0x0 (OFF) in AVN mode
    - Verify MAR recording starts when Evt Switch clicked in AVN mode (ACC)

  Preconditions:
    - ACC and IGN and ccNC/ccIC switch OFF, AVN mode

  Test Steps:
    Step 1: Set SMK to ACC, USM Reset, Rec Reset
            Log: Cannot enter Build-in Cam in ACC mode
    Step 2-3: Log - LED photo capture (manual)
    Step 4: Return to AVN HU UI mode home, check BLTN_CAM_RecSta_MAR = 0x0 (OFF) - Screenshot
    Step 5-6: Log - LED photo capture (manual)
    Step 7: Click Evt Switch on panel Recording_Setting,
            check BLTN_CAM_RecSta_MAR = 0x1 (Recording) - Screenshot with AIN
    Step 8-11: Log - LED photo capture (manual)

  NOTE: Uses 2s delay for signal propagation after each state transition.
*/

variables
{
  long max_wait_time_10s = 10000;   // 10 seconds for MAR recording detection

  // Message Declaration for CAN FD
  message HU_BLTN_CAM_PE_00_200ms _HU_BLTN_CAM_PE_00_200ms;
  message HU_BLTN_CAM_E_01 _HU_BLTN_CAM_E_01;
  message HU_CLOCK_PE_02 _HU_CLOCK_PE_02;

  // Result tracking variables
  int step1_passed = 0;
  int step4_passed = 0;
  int step7_passed = 0;

}

// ============================================================================
// Main Test Case
// ============================================================================

testcase OWD_018_Init()
{
  Send_Value_To_COM(11800);
  write("========================================");
  write("=== START TEST OWD_018 ===");
  write("=== MAR Recording Test - ACC Mode   ===");
  write("========================================");
  Send_Value_To_COM(44);
}

testcase OWD_018_1()
{
  int result = 0;

  //============================================================================
  // STEP 1: Set SMK to ACC, USM Reset, Rec Reset
  //         Log: Cannot enter Build-in Cam mode in ACC mode
  //============================================================================
  Send_Value_To_COM(11801);
  SetTestStep("Bước 1 - OWD_018");
  StartTestTimer();

  write("");
  write("=================================================================");
  write("=== STEP 1: SMK ACC + USM Reset + Rec Reset                 ===");
  write("===         Log: Cannot enter BLTN_CAM in ACC mode           ===");
  write("=================================================================");
  testStep("Step1", "Set ACC mode + USM Reset + Rec Reset - Cannot enter BLTN_CAM");

  // 1.1 Set SMK to ACC via panel combo box
  write("[1.1] Setting SMK_Signal to ACC via panel...");
  Set_SMK_ACC();
  testWaitForTimeout(2000);

  // 1.2 Click USM Reset button
  write("[1.2] Clicking USM Reset button...");
  Click_USM_Reset();
  testWaitForTimeout(2000);

  // 1.3 Click Rec Reset button
  write("[1.3] Clicking Rec Reset button...");
  Click_Rec_Reset();
  testWaitForTimeout(2000);

  // 1.4 Log: Cannot enter Build-in Cam in ACC mode
  write("");
  write("*************************************************************");
  write("*** STEP 1: NOTIFICATION ***");
  write("*** ACC mode is active (SMK = 0x1) ***");
  write("*** Cannot enter Build-in Cam (BLTN_CAM) mode in ACC ***");
  write("*** BLTN_CAM mode requires IGN (SMK = 0x2) or higher ***");
  write("*************************************************************");
  write("");
  write("  Current SMK_TrmnlCtrlGrpStaBDC = 0x%X (ACC)", $SMK_TrmnlCtrlGrpStaBDC);

  step1_passed = 1;
  testStepPass("Step1", "ACC mode set, USM Reset done, Rec Reset done - Cannot enter BLTN_CAM in ACC - PASS");

  write("[Capture] Wait 5 seconds before screenshot");
  testWaitForTimeout(5000);
  CaptureGraphics("OWD", "SMK_TrmnlCtrlGrpStaBDC;BLTN_CAM_RecSet_OWD;BLTN_CAM_RecSta_OWD");
  StopTestTimer();
  Send_Value_To_COM(44);
}

testcase OWD_018_2_3()
{
  //============================================================================
  // STEP 2 & 3: Log - LED Photo Capture (Manual)
  //============================================================================
  Send_Value_To_COM(11802);
  write("");
  write("=================================================================");
  write("=== STEP 2 & 3: LED Photo Capture (Manual) ===");
  write("=================================================================");
  testStep("Step2_3", "LED photo capture - check signal light");

  write("");
  write("*************************************************************");
  write("*** STEP 2 & 3: LOG INFORMATION ***");
  write("*** Please capture LED photo directly ***");
  write("*** Check LED signal light status on the device ***");
  write("*** Include this photo in the test report ***");
  write("*************************************************************");
  write("");

  testStepPass("Step2_3", "LED photo capture logged - Manual photo required");
  Send_Value_To_COM(44);
}

testcase OWD_018_4()
{
  int result = 0;

  //============================================================================
  // STEP 4: Return to AVN HU UI mode home,
  //         Check BLTN_CAM_RecSta_MAR = 0x0 (OFF) - Screenshot
  //============================================================================
  Send_Value_To_COM(11804);
  SetTestStep("Bước 4 - OWD_018");
  StartTestTimer();

  write("");
  write("=================================================================");
  write("=== STEP 4: AVN HU UI mode + Check RecSta_MAR = 0x0 (OFF)   ===");
  write("=================================================================");
  testStep("Step4", "AVN HU UI mode home + RecSta_MAR OFF verification");

  // 4.1 Ensure we are in AVN HU UI mode (Exit BLTN_CAM just in case)
  write("[4.1] Ensuring AVN HU UI mode (home screen)...");
  Exit_BLTN_CAM();
  testWaitForTimeout(2000);
  write("  HU_BLTN_CAM_UI_Mode = 0x%X (AVN mode)", $BLTN_CAM_HU_UI_Mode);

  // 4.2 Check BLTN_CAM_RecSta_MAR = 0x0 (OFF)
  write("[4.2] Checking BLTN_CAM_RecSta_MAR = 0x0 (OFF)...");
  result = Check_RecSta_MAR_OFF();

  // 4.3 Capture screenshot
  write("[4.3] Capturing screenshot...");
  CaptureGraphics("OWD", "BLTN_CAM_RecSta_MAR;BLTN_CAM_HU_UI_Mode;SMK_TrmnlCtrlGrpStaBDC");

  if(result == 1)
  {
    step4_passed = 1;
    testStepPass("Step4", "BLTN_CAM_RecSta_MAR = 0x0 (OFF) in AVN mode - PASS");
  }
  else
  {
    step4_passed = 0;
    write(">>> FAIL REASON: BLTN_CAM_RecSta_MAR expected 0x0 (OFF) but got 0x%X <<<", $BLTN_CAM_RecSta_MAR);
    Log_Error_Details();
    testStepFail("Step4", "BLTN_CAM_RecSta_MAR is NOT OFF in AVN mode - FAIL");
  }
  StopTestTimer();
  Send_Value_To_COM(44);
}

testcase OWD_018_5_6()
{
  //============================================================================
  // STEP 5 & 6: Log - LED Photo Capture (Manual)
  //============================================================================
  Send_Value_To_COM(11805);
  write("");
  write("=================================================================");
  write("=== STEP 5 & 6: LED Photo Capture (Manual) ===");
  write("=================================================================");
  testStep("Step5_6", "LED photo capture - check signal light");

  write("");
  write("*************************************************************");
  write("*** STEP 5 & 6: LOG INFORMATION ***");
  write("*** Please capture LED photo directly ***");
  write("*** Check LED signal light status on the device ***");
  write("*** Include this photo in the test report ***");
  write("*************************************************************");
  write("");

  testStepPass("Step5_6", "LED photo capture logged - Manual photo required");
  Send_Value_To_COM(44);
}

testcase OWD_018_7()
{
  int result = 0;

  //============================================================================
  // STEP 7: Click Evt Switch on panel Recording_Setting,
  //         Check BLTN_CAM_RecSta_MAR = 0x1 (Recording) - Screenshot with AIN
  //============================================================================
  Send_Value_To_COM(11807);
  SetTestStep("Bước 7 - OWD_018");
  StartTestTimer();

  write("");
  write("=================================================================");
  write("=== STEP 7: Click Evt Switch + Wait for MAR Recording (10s) ===");
  write("=================================================================");
  testStep("Step7", "Evt Switch + RecSta_MAR = 0x1 (Recording) within 10s");

  // 7.1 Click Evt Switch button on panel Recording_Setting
  write("[7.1] Clicking Evt Switch button on panel Recording_Setting...");
  Click_Evt_Switch();

  // 7.2 Wait for BLTN_CAM_RecSta_MAR = 0x1 (Recording) within 10s
  write("[7.2] Waiting for BLTN_CAM_RecSta_MAR = 0x1 (Recording) within 10 seconds...");
  result = WaitFor_RecSta_MAR_Recording(max_wait_time_10s);

  // 7.3 Capture screenshot with MAR signal and AIN
  write("[7.3] Capturing screenshot with MAR and AIN signals...");
  CaptureGraphics("OWD", "BLTN_CAM_RecSta_MAR;AIN;BLTN_CAM_HU_UI_Mode;SMK_TrmnlCtrlGrpStaBDC");

  if(result == 1)
  {
    step7_passed = 1;
    testStepPass("Step7", "BLTN_CAM_RecSta_MAR = 0x1 (Recording) detected within 10s - PASS");
  }
  else
  {
    step7_passed = 0;
    write(">>> FAIL REASON: BLTN_CAM_RecSta_MAR expected 0x1 (Recording) but got 0x%X <<<", $BLTN_CAM_RecSta_MAR);
    Log_Error_Details();
    testStepFail("Step7", "BLTN_CAM_RecSta_MAR Recording NOT detected within 10s - FAIL");
  }
  StopTestTimer();
  Send_Value_To_COM(44);
}

testcase OWD_018_8_9()
{
  //============================================================================
  // STEP 8 & 9: Log - LED Photo Capture (Manual)
  //============================================================================
  Send_Value_To_COM(11808);
  write("");
  write("=================================================================");
  write("=== STEP 8 & 9: LED Photo Capture (Manual) ===");
  write("=================================================================");
  testStep("Step8_9", "LED photo capture - check signal light");

  write("");
  write("*************************************************************");
  write("*** STEP 8 & 9: LOG INFORMATION ***");
  write("*** Please capture LED photo directly ***");
  write("*** Check LED signal light status on the device ***");
  write("*** Include this photo in the test report ***");
  write("*************************************************************");
  write("");

  testStepPass("Step8_9", "LED photo capture logged - Manual photo required");
  Send_Value_To_COM(44);
}

testcase OWD_018_10_11()
{
  //============================================================================
  // STEP 10 & 11: Log - LED Photo Capture (Manual)
  //============================================================================
  Send_Value_To_COM(11810);
  write("");
  write("=================================================================");
  write("=== STEP 10 & 11: LED Photo Capture (Manual) ===");
  write("=================================================================");
  testStep("Step10_11", "LED photo capture - check signal light");

  write("");
  write("*************************************************************");
  write("*** STEP 10 & 11: LOG INFORMATION ***");
  write("*** Please capture LED photo directly ***");
  write("*** Check LED signal light status on the device ***");
  write("*** Include this photo in the test report ***");
  write("*************************************************************");
  write("");

  testStepPass("Step10_11", "LED photo capture logged - Manual photo required");
  Send_Value_To_COM(44);
}


void MainTest()
{
  testReportFileName("TestReports\\OWD_018 - 2.5 generation_report");

  //write("Run Rec_Reset()"); Rec_Reset();

  OWD_018_Init();
  OWD_018_1();
  OWD_018_2_3();
  OWD_018_4();
  OWD_018_5_6();
  OWD_018_7();
  OWD_018_8_9();
  OWD_018_10_11();
}
