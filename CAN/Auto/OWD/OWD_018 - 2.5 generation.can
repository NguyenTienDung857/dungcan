/*@!Encoding:65001*/

/*
  Test Case: OWD_018
  Title: [MAR Recording Test - ACC Mode + Event Switch in AVN Mode]
  Verification items:
    - Check that BLTN_CAM mode CANNOT be entered when in ACC mode
    - Verify BLTN_CAM_RecSta_MAR = 0x0 (OFF) in AVN mode
    - Verify MAR recording starts when Evt Switch clicked in AVN mode (ACC)

  Preconditions:
    - ACC and IGN and ccNC/ccIC switch OFF, AVN mode

  Test Steps:
    Step 1: Set SMK to ACC, USM Reset, Rec Reset
            Log: Cannot enter Build-in Cam in ACC mode
    Step 2-3: Log - LED photo capture (manual)
    Step 4: Return to AVN HU UI mode home, check BLTN_CAM_RecSta_MAR = 0x0 (OFF) - Screenshot
    Step 5-6: Log - LED photo capture (manual)
    Step 7: Click Evt Switch on panel Recording_Setting,
            check BLTN_CAM_RecSta_MAR = 0x1 (Recording) - Screenshot with AIN
    Step 8-11: Log - LED photo capture (manual)

  NOTE: Uses 2s delay for signal propagation after each state transition.
*/

variables
{
  long max_wait_time_10s = 10000;   // 10 seconds for MAR recording detection

  // Message declarations for CAN FD
  message HU_BLTN_CAM_02_200ms _HU_BLTN_CAM_02_200ms;
  message HU_BLTN_CAM_01_00ms _HU_BLTN_CAM_01_00ms;
  message HU_CLOCK_01_1000ms _HU_CLOCK_01_1000ms;

  // Result tracking variables
  int step1_passed = 0;
  int step4_passed = 0;
  int step7_passed = 0;

  // Error counter for Turn_OFF_RecSet
  int flag_RecSet_error = 0;
}

// ============================================================================
// Panel Control Helper Functions
// ============================================================================

// Set SMK to ACC (0x1) via panel combo box
void Set_SMK_ACC()
{
  write("=== Setting SMK_Signal to ACC via panel ===");
  @panel::Switch_CGWNM = 1;
  testWaitForTimeout(2000);
  setSignal(SMK_TrmnlCtrlGrpStaBDC, 0x1);  // ACC
  testWaitForTimeout(2000);
  write("  SMK_TrmnlCtrlGrpStaBDC = 0x%X (ACC)", $SMK_TrmnlCtrlGrpStaBDC);
}

// Set SMK to IGN (0x2) via panel combo box
void Set_SMK_IGN()
{
  write("=== Setting SMK_Signal to IGN via panel ===");
  @panel::Switch_CGWNM = 1;
  testWaitForTimeout(2000);
  setSignal(SMK_TrmnlCtrlGrpStaBDC, 0x2);  // IGN
  testWaitForTimeout(2000);
  write("  SMK_TrmnlCtrlGrpStaBDC = 0x%X (IGN)", $SMK_TrmnlCtrlGrpStaBDC);
}

// Click USM Reset button on panel
void Click_USM_Reset()
{
  write("=== Clicking USM Reset button on panel ===");
  @panel::Button_USMReset = 1;
  testWaitForTimeout(2000);
  write("  USM Reset clicked");
}

// Click Rec Reset button on panel
void Click_Rec_Reset()
{
  write("=== Clicking Rec Reset button on panel ===");
  @panel::Button_RecReset = 1;
  testWaitForTimeout(2000);
  write("  Rec Reset clicked");
}

// Click Evt Switch button on panel (toggle off then on)
void Click_Evt_Switch()
{
  write("=== Clicking Event Switch button ===");
  @panel::Button_SwitchEvt = 1;
  //testWaitForTimeout(3000);
  testWaitForTimeout(2000);
  write("  Evt Switch clicked");
}

// Enter Built-in Cam mode (HU_BLTN_CAM_UI_Mode = 0x1)
void Enter_BLTN_CAM()
{
  write(">>> Enter BLTN_CAM mode <<<");
  _HU_BLTN_CAM_02_200ms.HU_BLTN_CAM_UI_Mode = 0x1;
  output(_HU_BLTN_CAM_02_200ms);
  testWaitForTimeout(2000);
}

// Exit to AVN HU UI mode (HU_BLTN_CAM_UI_Mode = 0x0)
void Exit_BLTN_CAM()
{
  write(">>> Exit BLTN_CAM mode - Return to AVN <<<");
  _HU_BLTN_CAM_02_200ms.HU_BLTN_CAM_UI_Mode = 0x0;
  output(_HU_BLTN_CAM_02_200ms);
  testWaitForTimeout(2000);
}

// ============================================================================
// Check Functions
// ============================================================================

// Check BLTN_CAM_RecSta_MAR = 0x0 (OFF)
int Check_RecSta_MAR_OFF()
{
  byte rec_sta_mar = 0;

  rec_sta_mar = $BLTN_CAM_RecSta_MAR;
  write("  BLTN_CAM_RecSta_MAR = 0x%X", rec_sta_mar);

  if(rec_sta_mar == 0x0)
  {
    write(">>> PASS: BLTN_CAM_RecSta_MAR = 0x0 (OFF) <<<");
    return 1;
  }
  else
  {
    write(">>> FAIL: BLTN_CAM_RecSta_MAR is NOT OFF (value = 0x%X) <<<", rec_sta_mar);
    return 0;
  }
}

// Wait for BLTN_CAM_RecSta_MAR = 0x1 (Recording) with timeout
int WaitFor_RecSta_MAR_Recording(long timeout_ms)
{
  long elapsed = 0;
  long check_interval = 1000;  // Check every 1 second
  byte rec_sta_mar = 0;
  long log_interval;

  write("=== Waiting for MAR Recording (max %d seconds) ===", timeout_ms / 1000);
  write("Checking every %d second...", check_interval / 1000);

  log_interval = (timeout_ms / 6 / check_interval) * check_interval;
  if(log_interval < check_interval) log_interval = check_interval;

  while(elapsed < timeout_ms)
  {
    rec_sta_mar = $BLTN_CAM_RecSta_MAR;

    if(elapsed == 0 || elapsed % log_interval == 0)
    {
      write("  [%d s / %d s] BLTN_CAM_RecSta_MAR = 0x%X",
            elapsed / 1000, timeout_ms / 1000, rec_sta_mar);
    }

    if(rec_sta_mar == 0x1)
    {
      write(">>> DETECTED: MAR Recording started after %d seconds <<<", elapsed / 1000);
      write(">>> PASS: BLTN_CAM_RecSta_MAR = 0x1 (Recording) <<<");
      return 1;
    }

    testWaitForTimeout(check_interval);
    elapsed += check_interval;
  }

  // Timeout - MAR recording not detected
  write(">>> TIMEOUT: MAR Recording NOT detected after %d seconds <<<", timeout_ms / 1000);
  write(">>> FAIL: BLTN_CAM_RecSta_MAR is still 0x%X <<<", rec_sta_mar);
  return 0;
}

// ============================================================================
// Turn OFF All Recording Settings
// ============================================================================
void Turn_OFF_RecSet()
{
  if (getSignal(BLTN_CAM_RecSet_OWD) == 0x2 || getSignal(BLTN_CAM_RecSet_OWP) == 0x2 || getSignal(BLTN_CAM_RecSet_DEV) == 0x2 || getSignal(BLTN_CAM_RecSet_PEV) == 0x2)
  {
    @panel::Switch_CGWNM = 1;

    setSignal(SMK_TrmnlCtrlGrpStaBDC, 0x2);
    testWaitForTimeout(3000);

    do {
      Enter_BLTN_CAM();
      testWaitForTimeout(3000);

      if (getSignal(BLTN_CAM_RecSet_OWD) == 0x2){
        write("OWD Off"); @panel::LED_Ctrl_SetOWD = 1; testWaitForTimeout(1000);
      }
      else if (getSignal(BLTN_CAM_RecSet_OWP) == 0x2){
        write("OWP Off"); @panel::LED_Ctrl_SetOWP = 1; testWaitForTimeout(1000);
      }
      else if (getSignal(BLTN_CAM_RecSet_DEV) == 0x2){
        write("DEV Off"); @panel::LED_Ctrl_SetDEV = 1; testWaitForTimeout(1000);
      }
      else if (getSignal(BLTN_CAM_RecSet_PEV) == 0x2){
        write("PEV Off"); @panel::LED_Ctrl_SetPEV = 1; testWaitForTimeout(1000);
      }

      Exit_BLTN_CAM();

      flag_RecSet_error++;

    } while((getSignal(BLTN_CAM_RecSet_OWD) == 0x2 || getSignal(BLTN_CAM_RecSet_OWP) == 0x2 || getSignal(BLTN_CAM_RecSet_DEV) == 0x2 || getSignal(BLTN_CAM_RecSet_PEV) == 0x2) && (flag_RecSet_error <= 15));

    flag_RecSet_error = 0;

    testWaitForTimeout(3000);
    setSignal(SMK_TrmnlCtrlGrpStaBDC, 0x0);
  }
  else
  {
    write("Notifications: All recording settings are turned OFF.");
  }
}

// ============================================================================
// Rec Reset Function
// ============================================================================
void Rec_Reset()
{
  @panel::Switch_CGWNM = 1;

  setSignal(SMK_TrmnlCtrlGrpStaBDC, 0x2);
  testWaitForTimeout(2000);

  while (getSignal(BLTN_CAM_SD_Format_Op_State) != 0x1)
  {
    @panel::Button_RecReset = 1;
    testWaitForSignalChange(BLTN_CAM_SD_Format_Op_State, 500);
  }

  setSignal(SMK_TrmnlCtrlGrpStaBDC, 0x0);
  testWaitForTimeout(2000);

  @panel::Switch_CGWNM = 0;
}

// ============================================================================
// Capture Screenshot Functions
// ============================================================================

// Capture screenshot with specified signal list
void CaptureGraphics(char signalList[], char filename[])
{
  char filepath[512];
  snprintf(filepath, elcount(filepath), "D:\\project\\CAN FD\\[CANoe] CANFD\\Screenshots\\%s", filename);
  write(">>> Capturing screenshot: %s <<<", filepath);
  testWaitForTimeout(3000);
  testReportAddWindowCapture("Graphics 2", signalList, "Screenshot", filepath);
  write(">>> Screenshot captured <<<");
}

// ============================================================================
// Main Test Case
// ============================================================================

testcase OWD_018()
{
  int result = 0;

  write("========================================");
  write("=== START TEST OWD_018 ===");
  write("=== MAR Recording Test - ACC Mode   ===");
  write("========================================");

  //============================================================================
  // STEP 1: Set SMK to ACC, USM Reset, Rec Reset
  //         Log: Cannot enter Build-in Cam mode in ACC mode
  //============================================================================
  write("");
  write("=================================================================");
  write("=== STEP 1: SMK ACC + USM Reset + Rec Reset                 ===");
  write("===         Log: Cannot enter BLTN_CAM in ACC mode           ===");
  write("=================================================================");
  testStep("Step1", "Set ACC mode + USM Reset + Rec Reset - Cannot enter BLTN_CAM");

  // 1.1 Set SMK to ACC via panel combo box
  write("[1.1] Setting SMK_Signal to ACC via panel...");
  Set_SMK_ACC();
  testWaitForTimeout(2000);

  // 1.2 Click USM Reset button
  write("[1.2] Clicking USM Reset button...");
  Click_USM_Reset();
  testWaitForTimeout(2000);

  // 1.3 Click Rec Reset button
  write("[1.3] Clicking Rec Reset button...");
  Click_Rec_Reset();
  testWaitForTimeout(2000);

  // 1.4 Log: Cannot enter Build-in Cam in ACC mode
  write("");
  write("*************************************************************");
  write("*** STEP 1: NOTIFICATION ***");
  write("*** ACC mode is active (SMK = 0x1) ***");
  write("*** Cannot enter Build-in Cam (BLTN_CAM) mode in ACC ***");
  write("*** BLTN_CAM mode requires IGN (SMK = 0x2) or higher ***");
  write("*************************************************************");
  write("");
  write("  Current SMK_TrmnlCtrlGrpStaBDC = 0x%X (ACC)", $SMK_TrmnlCtrlGrpStaBDC);

  step1_passed = 1;
  testStepPass("Step1", "ACC mode set, USM Reset done, Rec Reset done - Cannot enter BLTN_CAM in ACC - PASS");

  //============================================================================
  // STEP 2 & 3: Log - LED Photo Capture (Manual)
  //============================================================================
  write("");
  write("=================================================================");
  write("=== STEP 2 & 3: LED Photo Capture (Manual) ===");
  write("=================================================================");
  testStep("Step2_3", "LED photo capture - check signal light");

  write("");
  write("*************************************************************");
  write("*** STEP 2 & 3: LOG INFORMATION ***");
  write("*** Please capture LED photo directly ***");
  write("*** Check LED signal light status on the device ***");
  write("*** Include this photo in the test report ***");
  write("*************************************************************");
  write("");

  testStepPass("Step2_3", "LED photo capture logged - Manual photo required");

  //============================================================================
  // STEP 4: Return to AVN HU UI mode home,
  //         Check BLTN_CAM_RecSta_MAR = 0x0 (OFF) - Screenshot
  //============================================================================
  write("");
  write("=================================================================");
  write("=== STEP 4: AVN HU UI mode + Check RecSta_MAR = 0x0 (OFF)   ===");
  write("=================================================================");
  testStep("Step4", "AVN HU UI mode home + RecSta_MAR OFF verification");

  // 4.1 Ensure we are in AVN HU UI mode (Exit BLTN_CAM just in case)
  write("[4.1] Ensuring AVN HU UI mode (home screen)...");
  Exit_BLTN_CAM();
  testWaitForTimeout(2000);
  write("  HU_BLTN_CAM_UI_Mode = 0x%X (AVN mode)", $BLTN_CAM_HU_UI_Mode);

  // 4.2 Check BLTN_CAM_RecSta_MAR = 0x0 (OFF)
  write("[4.2] Checking BLTN_CAM_RecSta_MAR = 0x0 (OFF)...");
  result = Check_RecSta_MAR_OFF();

  // 4.3 Capture screenshot
  write("[4.3] Capturing screenshot...");
  CaptureGraphics("BLTN_CAM_RecSta_MAR;BLTN_CAM_HU_UI_Mode;SMK_TrmnlCtrlGrpStaBDC", "OWD_018_step4.jpg");

  if(result == 1)
  {
    step4_passed = 1;
    testStepPass("Step4", "BLTN_CAM_RecSta_MAR = 0x0 (OFF) in AVN mode - PASS");
  }
  else
  {
    step4_passed = 0;
    testStepFail("Step4", "BLTN_CAM_RecSta_MAR is NOT OFF in AVN mode - FAIL");
  }

  //============================================================================
  // STEP 5 & 6: Log - LED Photo Capture (Manual)
  //============================================================================
  write("");
  write("=================================================================");
  write("=== STEP 5 & 6: LED Photo Capture (Manual) ===");
  write("=================================================================");
  testStep("Step5_6", "LED photo capture - check signal light");

  write("");
  write("*************************************************************");
  write("*** STEP 5 & 6: LOG INFORMATION ***");
  write("*** Please capture LED photo directly ***");
  write("*** Check LED signal light status on the device ***");
  write("*** Include this photo in the test report ***");
  write("*************************************************************");
  write("");

  testStepPass("Step5_6", "LED photo capture logged - Manual photo required");

  //============================================================================
  // STEP 7: Click Evt Switch on panel Recording_Setting,
  //         Check BLTN_CAM_RecSta_MAR = 0x1 (Recording) - Screenshot with AIN
  //============================================================================
  write("");
  write("=================================================================");
  write("=== STEP 7: Click Evt Switch + Wait for MAR Recording (10s) ===");
  write("=================================================================");
  testStep("Step7", "Evt Switch + RecSta_MAR = 0x1 (Recording) within 10s");

  // 7.1 Click Evt Switch button on panel Recording_Setting
  write("[7.1] Clicking Evt Switch button on panel Recording_Setting...");
  Click_Evt_Switch();

  // 7.2 Wait for BLTN_CAM_RecSta_MAR = 0x1 (Recording) within 10s
  write("[7.2] Waiting for BLTN_CAM_RecSta_MAR = 0x1 (Recording) within 10 seconds...");
  result = WaitFor_RecSta_MAR_Recording(max_wait_time_10s);

  // 7.3 Capture screenshot with MAR signal and AIN
  write("[7.3] Capturing screenshot with MAR and AIN signals...");
  CaptureGraphics("BLTN_CAM_RecSta_MAR;AIN;BLTN_CAM_HU_UI_Mode;SMK_TrmnlCtrlGrpStaBDC", "OWD_018_step7.jpg");

  if(result == 1)
  {
    step7_passed = 1;
    testStepPass("Step7", "BLTN_CAM_RecSta_MAR = 0x1 (Recording) detected within 10s - PASS");
  }
  else
  {
    step7_passed = 0;
    testStepFail("Step7", "BLTN_CAM_RecSta_MAR Recording NOT detected within 10s - FAIL");
  }

  //============================================================================
  // STEP 8 & 9: Log - LED Photo Capture (Manual)
  //============================================================================
  write("");
  write("=================================================================");
  write("=== STEP 8 & 9: LED Photo Capture (Manual) ===");
  write("=================================================================");
  testStep("Step8_9", "LED photo capture - check signal light");

  write("");
  write("*************************************************************");
  write("*** STEP 8 & 9: LOG INFORMATION ***");
  write("*** Please capture LED photo directly ***");
  write("*** Check LED signal light status on the device ***");
  write("*** Include this photo in the test report ***");
  write("*************************************************************");
  write("");

  testStepPass("Step8_9", "LED photo capture logged - Manual photo required");

  //============================================================================
  // STEP 10 & 11: Log - LED Photo Capture (Manual)
  //============================================================================
  write("");
  write("=================================================================");
  write("=== STEP 10 & 11: LED Photo Capture (Manual) ===");
  write("=================================================================");
  testStep("Step10_11", "LED photo capture - check signal light");

  write("");
  write("*************************************************************");
  write("*** STEP 10 & 11: LOG INFORMATION ***");
  write("*** Please capture LED photo directly ***");
  write("*** Check LED signal light status on the device ***");
  write("*** Include this photo in the test report ***");
  write("*************************************************************");
  write("");

  testStepPass("Step10_11", "LED photo capture logged - Manual photo required");

  //============================================================================
  // Overall Test Verdict
  //============================================================================
  if(step1_passed == 1 && step4_passed == 1 && step7_passed == 1)
  {
    testStepPass("Overall_Verdict", "Test OWD_018: PASS");
    write("=== OVERALL VERDICT: PASS ===");
  }
  else
  {
    testStepFail("Overall_Verdict", "Test OWD_018: FAIL");
    write("=== OVERALL VERDICT: FAIL ===");
  }

  //============================================================================
  // TEST COMPLETE - Cleanup
  //============================================================================
  write("");
  write("========================================");
  write("=== TEST OWD_018 COMPLETE ===");
  write("========================================");

  // Cleanup
  setSignal(SMK_TrmnlCtrlGrpStaBDC, 0x0);  // KEY OFF
  testWaitForTimeout(2000);
  @panel::Switch_CGWNM = 0;

  // Final status
  write("");
  write("=== FINAL STATUS ===");
  write("  SMK_TrmnlCtrlGrpStaBDC = 0x%X", $SMK_TrmnlCtrlGrpStaBDC);
  write("  BLTN_CAM_RecSta_MAR = 0x%X", $BLTN_CAM_RecSta_MAR);
  write("  BLTN_CAM_HU_UI_Mode = 0x%X", $BLTN_CAM_HU_UI_Mode);

  write("");
  write("=== TEST SUMMARY ===");
  if(step1_passed == 1)
    write("Step 1: SMK ACC + USM Reset + Rec Reset - Cannot enter BLTN_CAM in ACC - PASS");
  else
    write("Step 1: SMK ACC + USM Reset + Rec Reset - Cannot enter BLTN_CAM in ACC - FAIL");
  write("Step 2-3: LED photo capture [Manual - Check LED] - PASS");
  if(step4_passed == 1)
    write("Step 4: AVN HU UI mode + RecSta_MAR = 0x0 (OFF) [Screenshot] - PASS");
  else
    write("Step 4: AVN HU UI mode + RecSta_MAR = 0x0 (OFF) [Screenshot] - FAIL");
  write("Step 5-6: LED photo capture [Manual - Check LED] - PASS");
  if(step7_passed == 1)
    write("Step 7: Evt Switch + MAR Recording within 10s [Screenshot+AIN] - PASS");
  else
    write("Step 7: Evt Switch + MAR Recording within 10s [Screenshot+AIN] - FAIL");
  write("Step 8-9: LED photo capture [Manual - Check LED] - PASS");
  write("Step 10-11: LED photo capture [Manual - Check LED] - PASS");
}

void MainTest()
{
  testReportFileName("TestReports\\OWD_018 - 2.5 generation_report");

  write("Run Turn_OFF_RecSet()"); Turn_OFF_RecSet();

  write("Run Rec_Reset()"); Rec_Reset();

  OWD_018();
}
