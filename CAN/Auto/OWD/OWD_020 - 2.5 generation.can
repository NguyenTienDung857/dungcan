/*@!Encoding:65001*/
includes
{
  #include "../DeclarationFunction_Gen2.5.h"
}

/*
  Test Case: OWD_020
  Title: [MAR Recording Test - DEV OFF + Evt Switch in AVN Mode]
  Verification items:
    - Enter BLTN_CAM mode, turn OFF DEV recording, verify BLTN_CAM_RecSet_DEV =
  0x1 (OFF)
    - Return to AVN mode, click Evt Switch, verify BLTN_CAM_RecSta_MAR = 0x1
  (Recording)
    - Manual LED photo capture steps

  Preconditions:
    - ACC and IGN and ccNC/ccIC switch OFF, AVN mode

  Test Steps:
    Step 1: Set SMK to IGN, USM Reset, Rec Reset, Enter BLTN_CAM,
            Click DEV to turn OFF, check BLTN_CAM_RecSet_DEV = 0x1 (OFF) -
  Screenshot Step 2: Return to AVN mode, Click Evt Switch, check
  BLTN_CAM_RecSta_MAR = 0x1 (Recording) - Screenshot with AIN Step 3: Log - LED
  photo capture (manual) Step 4: Log - LED photo capture (manual) Step 5: Log -
  LED photo capture (manual) Step 6: Log - LED photo capture (manual)

  NOTE: Uses 2s delay for signal propagation after each state transition.
*/

variables
{
  long max_wait_time_10s = 10000; // 10 seconds for MAR recording detection

  // Result tracking variables
  int step1_passed = 0;
  int step2_passed = 0;

}

// ============================================================================
// Main Test Case
// ============================================================================

testcase OWD_020_Init() {
  Send_Value_To_COM(12000);
  write("========================================");
  write("=== START TEST OWD_020 ===");
  write("=== DEV OFF + Evt Switch MAR Test   ===");
  write("========================================");
  Send_Value_To_COM(44);
}

testcase OWD_020_1() {
  int result = 0;

  //============================================================================
  // STEP 1: Set SMK to IGN, USM Reset, Rec Reset, Enter BLTN_CAM,
  //         Click DEV to turn OFF, Check BLTN_CAM_RecSet_DEV = 0x1 (OFF)
  //============================================================================
  Send_Value_To_COM(12001);
  SetTestStep("Bước 1 - OWD_020");
  StartTestTimer();

  write("");
  write("=================================================================");
  write("=== STEP 1: SMK IGN + USM Reset + Rec Reset + BLTN_CAM       ===");
  write("===         Click DEV OFF + Check RecSet_DEV = 0x1 (OFF)     ===");
  write("=================================================================");
  testStep("Step1",
           "SMK IGN + USM Reset + Rec Reset + Enter BLTN_CAM + DEV OFF");

  // 1.1 Set SMK to IGN via panel combo box
  write("[1.1] Setting SMK_Signal to IGN via panel...");
  Set_SMK_IGN();
  testWaitForTimeout(2000);

  // 1.2 Click USM Reset button
  write("[1.2] Clicking USM Reset button...");
  Click_USM_Reset();
  testWaitForTimeout(2000);

  // 1.3 Click Rec Reset button
  write("[1.3] Clicking Rec Reset button...");
  Click_Rec_Reset();
  testWaitForTimeout(2000);

  // 1.4 Enter Built-in Cam mode
  write("[1.4] Entering Built-in Cam mode...");
  Enter_BLTN_CAM();
  testWaitForTimeout(3000);

  // 1.5 Click DEV to turn it OFF
  write("[1.5] Clicking DEV to turn OFF...");
  write("  Current BLTN_CAM_RecSet_DEV = 0x%X", $BLTN_CAM_RecSet_DEV);

  // If DEV is currently ON (0x2), click to toggle OFF
  if ($BLTN_CAM_RecSet_DEV == 0x2) {
    write("  DEV is ON (0x2), clicking to turn OFF...");
    Turn_OFF_DEV();
    testWaitForTimeout(2000);
  } else if ($BLTN_CAM_RecSet_DEV == 0x1) {
    write("  DEV is already OFF (0x1), no action needed.");
  } else {
    // Unknown state, try toggling
    write("  DEV is in unknown state (0x%X), attempting toggle...",
          $BLTN_CAM_RecSet_DEV);
    Turn_OFF_DEV();
    testWaitForTimeout(2000);
  }

  // 1.6 Check BLTN_CAM_RecSet_DEV = 0x1 (OFF)
  write("[1.6] Checking BLTN_CAM_RecSet_DEV = 0x1 (OFF)...");
  result = Check_RecSet_DEV_OFF();

  // 1.7 Capture screenshot
  write("[1.7] Capturing screenshot...");
  CaptureGraphics(
      "OWD", "BLTN_CAM_RecSet_DEV;BLTN_CAM_HU_UI_Mode;SMK_TrmnlCtrlGrpStaBDC");

  if (result == 1) {
    step1_passed = 1;
    testStepPass("Step1", "BLTN_CAM_RecSet_DEV = 0x1 (OFF) - PASS");
  } else {
    step1_passed = 0;
    write(">>> FAIL REASON: BLTN_CAM_RecSet_DEV is NOT OFF, "
          "BLTN_CAM_RecSet_DEV = 0x%X <<<",
          $BLTN_CAM_RecSet_DEV);
    Log_Error_Details();
    testStepFail("Step1", "BLTN_CAM_RecSet_DEV is NOT OFF - FAIL");
  }
  StopTestTimer();
  Send_Value_To_COM(44);
}

testcase OWD_020_2() {
  int result = 0;

  //============================================================================
  // STEP 2: Return to AVN mode, Click Evt Switch,
  //         Check BLTN_CAM_RecSta_MAR = 0x1 (Recording) - Screenshot with AIN
  //============================================================================
  Send_Value_To_COM(12002);
  SetTestStep("Bước 2 - OWD_020");
  StartTestTimer();

  write("");
  write("=================================================================");
  write("=== STEP 2: Return to AVN + Evt Switch + MAR Recording       ===");
  write("=================================================================");
  testStep("Step2", "Exit to AVN + Evt Switch + RecSta_MAR = 0x1 (Recording)");

  // 2.1 Exit to AVN HU UI mode
  write("[2.1] Exiting to AVN HU UI mode...");
  Exit_BLTN_CAM();
  testWaitForTimeout(3000);
  write("  HU_BLTN_CAM_UI_Mode = 0x%X (AVN mode)", $BLTN_CAM_HU_UI_Mode);

  // 2.2 Click Evt Switch button
  write("[2.2] Clicking Evt Switch button...");
  Click_Evt_Switch();
  testWaitForTimeout(2000);

  // 2.3 Wait for BLTN_CAM_RecSta_MAR = 0x1 (Recording) within 10s
  write("[2.3] Waiting for BLTN_CAM_RecSta_MAR = 0x1 (Recording) within 10 "
        "seconds...");
  result = WaitFor_RecSta_MAR_Recording(max_wait_time_10s);

  // 2.4 Capture screenshot with MAR signal and AIN
  write("[2.4] Capturing screenshot with MAR and AIN signals...");
  CaptureGraphics(
      "OWD", "BLTN_CAM_RecSta_MAR;AIN;BLTN_CAM_RecSet_DEV;BLTN_CAM_HU_UI_Mode");

  if (result == 1) {
    step2_passed = 1;
    testStepPass(
        "Step2",
        "BLTN_CAM_RecSta_MAR = 0x1 (Recording) after Evt Switch in AVN - PASS");
  } else {
    step2_passed = 0;
    write(">>> FAIL REASON: MAR Recording NOT detected within 10s, "
          "BLTN_CAM_RecSta_MAR = 0x%X <<<",
          $BLTN_CAM_RecSta_MAR);
    Log_Error_Details();
    testStepFail("Step2", "BLTN_CAM_RecSta_MAR Recording NOT detected - FAIL");
  }
  StopTestTimer();
  Send_Value_To_COM(44);
}

testcase OWD_020_3() {
  //============================================================================
  // STEP 3: Log - LED Photo Capture (Manual)
  //============================================================================
  Send_Value_To_COM(12003);
  SetTestStep("Bước 3 - OWD_020");
  StartTestTimer();

  write("");
  write("=================================================================");
  write("=== STEP 3: LED Photo Capture (Manual) ===");
  write("=================================================================");
  testStep("Step3", "LED photo capture - check signal light");

  write("");
  write("*************************************************************");
  write("*** STEP 3: LOG INFORMATION ***");
  write("*** Please capture LED photo directly ***");
  write("*** Check signal light status on the device ***");
  write("*** Include this photo in the test report ***");
  write("*************************************************************");
  write("");

  testStepPass("Step3", "LED photo capture logged - Manual photo required");
  StopTestTimer();
  Send_Value_To_COM(44);
}

testcase OWD_020_4() {
  //============================================================================
  // STEP 4: Log - LED Photo Capture (Manual)
  //============================================================================
  Send_Value_To_COM(12004);
  SetTestStep("Bước 4 - OWD_020");
  StartTestTimer();

  write("");
  write("=================================================================");
  write("=== STEP 4: LED Photo Capture (Manual) ===");
  write("=================================================================");
  testStep("Step4", "LED photo capture - check signal light");

  write("");
  write("*************************************************************");
  write("*** STEP 4: LOG INFORMATION ***");
  write("*** Please capture LED photo directly ***");
  write("*** Check signal light status on the device ***");
  write("*** Include this photo in the test report ***");
  write("*************************************************************");
  write("");

  testStepPass("Step4", "LED photo capture logged - Manual photo required");
  StopTestTimer();
  Send_Value_To_COM(44);
}

testcase OWD_020_5() {
  //============================================================================
  // STEP 5: Log - LED Photo Capture (Manual)
  //============================================================================
  Send_Value_To_COM(12005);
  SetTestStep("Bước 5 - OWD_020");
  StartTestTimer();

  write("");
  write("=================================================================");
  write("=== STEP 5: LED Photo Capture (Manual) ===");
  write("=================================================================");
  testStep("Step5", "LED photo capture - check signal light");

  write("");
  write("*************************************************************");
  write("*** STEP 5: LOG INFORMATION ***");
  write("*** Please capture LED photo directly ***");
  write("*** Check signal light status on the device ***");
  write("*** Include this photo in the test report ***");
  write("*************************************************************");
  write("");

  testStepPass("Step5", "LED photo capture logged - Manual photo required");
  StopTestTimer();
  Send_Value_To_COM(44);
}

testcase OWD_020_6() {
  //============================================================================
  // STEP 6: Log - LED Photo Capture (Manual)
  //============================================================================
  Send_Value_To_COM(12006);
  SetTestStep("Bước 6 - OWD_020");
  StartTestTimer();

  write("");
  write("=================================================================");
  write("=== STEP 6: LED Photo Capture (Manual) ===");
  write("=================================================================");
  testStep("Step6", "LED photo capture - check signal light");

  write("");
  write("*************************************************************");
  write("*** STEP 6: LOG INFORMATION ***");
  write("*** Please capture LED photo directly ***");
  write("*** Check signal light status on the device ***");
  write("*** Include this photo in the test report ***");
  write("*************************************************************");
  write("");

  testStepPass("Step6", "LED photo capture logged - Manual photo required");
  StopTestTimer();
  Send_Value_To_COM(44);
}


void MainTest()
{
  testReportFileName("TestReports\\OWD_020 - 2.5 generation_report");

  // write("Run Rec_Reset()"); Rec_Reset();

  OWD_020_Init();
  OWD_020_1();
  OWD_020_2();
  OWD_020_3();
  OWD_020_4();
  OWD_020_5();
  OWD_020_6();
}
