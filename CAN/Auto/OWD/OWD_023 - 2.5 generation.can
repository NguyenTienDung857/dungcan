/*@!Encoding:65001*/
includes { #include "../DeclarationFunction_Gen2.5.h" }
//Preconditions: - ACC and IGN and ccNC/ccIC switch OFF, AVN mode
//Add signal to graphic 2: BLTN_CAM_RecSta_MAR
variables {
  // Global Variable Declaration
  int step1_passed = 0;
  float count_MARRec_time = 0.0;
  byte value_Bfr = 0x0;
  byte value_Aft = 0x0;
  //Message Declaration for CAN
  message HU_BLTN_CAM_PE_00_200ms _HU_BLTN_CAM_PE_00_200ms;
  message HU_BLTN_CAM_E_01 _HU_BLTN_CAM_E_01;
}

void BLTN_CAM_Settings(int Choose_Option){
  switch (Choose_Option){
    case(1):
      value_Bfr = 0x5; write("Bft: -15"); @panel::TrackBar_EV_Time_Bfr = 2;/*Before Time Setting: -15s*/
      testWaitForTimeout(500);
      value_Aft = 0x0; write("Aft: +10"); @panel::TrackBar_EV_Time_Aft = 10;/*After Time Setting: +10s*/break; 
    case(2):
      value_Bfr = 0x5; write("Bft: -15"); @panel::TrackBar_EV_Time_Bfr = 2;/*Before Time Setting: -15s*/
      testWaitForTimeout(500);
      value_Aft = 0x5; write("Aft: +15"); @panel::TrackBar_EV_Time_Aft = 15;/*After Time Setting: +15s*/break; 
    case(3):
      value_Bfr = 0x5; write("Bft: -15"); @panel::TrackBar_EV_Time_Bfr = 2;/*Before Time Setting: -15s*/
      testWaitForTimeout(500);
      value_Aft = 0xA; write("Aft: +20"); @panel::TrackBar_EV_Time_Aft = 20;/*After Time Setting: +20s*/break;     
  }
  
  testWaitForTimeout(1000);
  
  if($BLTN_CAM_Set_EV_BfrTime != value_Bfr){
      
    write("Bfr_time is not match");
    
    write("Stop test"); //stop();
    
  }
  else if($BLTN_CAM_Set_EV_AftTime != value_Aft){
    
    write("Aft_time is not match");
    
    write("Stop test"); //stop();
    
  }
}

void Setup_Function(int Option){
  float start_sec, end_sec;
  
  @panel::Switch_CGWNM = 1;
  
  KEY_ON();
  testWaitForTimeout(3000);
  
  
  Enter_BLTN_CAM();
  testWaitForTimeout(3000);

  BLTN_CAM_Settings(Option);
  testWaitForTimeout(2000);
  
  @panel::Switch_Clock = 1;
  
  Exit_BLTN_CAM();

  testWaitForTimeout(16000);
  
  _HU_BLTN_CAM_E_01.MEV_Rec_Req = 0x0;
  output(_HU_BLTN_CAM_E_01);
  
  testWaitForTimeout(500);
  
  _HU_BLTN_CAM_E_01.MEV_Rec_Req = 0x1;
  output(_HU_BLTN_CAM_E_01);
  
  if (testWaitForSignalChange(BLTN_CAM_RecSta_MAR,100000) == 1){
    write("MAR recording is started");
    start_sec = timeNow()/100000.0;
  }
  else{
    write("Error: MAR recording hasn't started. Stop test !!!");
    //stop();
  }
  
  if (testWaitForSignalChange(BLTN_CAM_RecSta_MAR,100000) == 1){
    write("MAR recording is stopped");
    end_sec = timeNow()/100000.0;
  }
  
  count_MARRec_time = end_sec - start_sec;
}

testcase OWD_023_Init(){
  Send_Value_To_COM(12300);
  write("Start test OWD_023 Initialization");
  write("Run Rec_Reset()"); Rec_Reset();
  Send_Value_To_COM(44);
}

testcase OWD_023_1(){
  Send_Value_To_COM(12301);
  SetTestStep("Bước 1 - OWD_023");
  StartTestTimer();

  testStep("Notification","Start test OWD_023_1");
  testStep("Step1", "MAR recording time check: BfrTime=-15s, AftTime=+10s -> expected duration 9~11s");
  write("Start test OWD_023_1");

  Set_SMK_IGN();
  Click_USM_Reset();
  Click_Rec_Reset();

  Setup_Function(1); write("Run Setup_Function()");
  
  if( count_MARRec_time >= 9 && count_MARRec_time <= 11){
    testStepPass("Pass","Test-case is OK");
    step1_passed = 1;
    write("count_MARRec_time = %.2f",count_MARRec_time);
  }
  else{
    write(">>> FAIL REASON: MAR recording time %.2f seconds is out of expected 9-11 range <<<", count_MARRec_time);
    Log_Error_Details();
    testStepFail("Fail","Test-case is NG");
    step1_passed = 0;
    write("count_MARRec_time = %.2f",count_MARRec_time);
  }
  
  CaptureGraphics("OWD", "BLTN_CAM_RecSta_MAR"); write("Run CaptureGraphics()");

  testWaitForTimeout(1000);

  @panel::Switch_CGWNM = 0;

  @panel::Switch_Clock = 0;

  count_MARRec_time = 0.0;

  KEY_OFF(); write("Run KEY_OFF()");

  testStep("TEST SUMMARY","--- OWD_023_1 ---");
  testStep("","Step 1: Start test OWD_023_1 ... PASS");
  if (step1_passed) { testStep("","Step 2: Check MAR recording time ... PASS"); } else { testStep("","Step 2: Check MAR recording time ... FAIL"); }
  testStep("","Step 3: Screenshot ... PASS");
  write("Finish OWD_023_1");
  StopTestTimer();
  Send_Value_To_COM(44);
}

testcase OWD_023_2(){
  Send_Value_To_COM(12302);
  SetTestStep("Bước 2 - OWD_023");
  StartTestTimer();

  testStep("Notification","Start test OWD_023_2");
  testStep("Step2", "MAR recording time check: BfrTime=-15s, AftTime=+15s -> expected duration 14~16s");
  write("Start test OWD_023_2");

  Setup_Function(2); write("Run Setup_Function()");
  
  if( count_MARRec_time >= 14 && count_MARRec_time <= 16){
    testStepPass("Pass","Test-case is OK");
    step1_passed = 1;
    write("count_MARRec_time = %.2f",count_MARRec_time);
  }
  else{
    write(">>> FAIL REASON: MAR recording time %.2f seconds is out of expected 14-16 range <<<", count_MARRec_time);
    Log_Error_Details();
    testStepFail("Fail","Test-case is NG");
    step1_passed = 0;
    write("count_MARRec_time = %.2f",count_MARRec_time);
  }
  
  CaptureGraphics("OWD", "BLTN_CAM_RecSta_MAR"); write("Run CaptureGraphics()");

  testWaitForTimeout(1000);

  @panel::Switch_CGWNM = 0;

  @panel::Switch_Clock = 0;

  count_MARRec_time = 0.0;

  KEY_OFF(); write("Run KEY_OFF()");

  testStep("TEST SUMMARY","--- OWD_023_2 ---");
  testStep("","Step 1: Start test OWD_023_2 ... PASS");
  if (step1_passed) { testStep("","Step 2: Check MAR recording time ... PASS"); } else { testStep("","Step 2: Check MAR recording time ... FAIL"); }
  testStep("","Step 3: Screenshot ... PASS");
  write("Finish OWD_023_2");
  StopTestTimer();
  Send_Value_To_COM(44);
}

testcase OWD_023_3(){
  Send_Value_To_COM(12303);
  SetTestStep("Bước 3 - OWD_023");
  StartTestTimer();

  testStep("Notification","Start test OWD_023_3");
  testStep("Step3", "MAR recording time check: BfrTime=-15s, AftTime=+20s -> expected duration 19~21s");
  write("Start test OWD_023_3");

  Setup_Function(3); write("Run Setup_Function()");
  
  if( count_MARRec_time >= 19 && count_MARRec_time <= 21){
    testStepPass("Pass","Test-case is OK");
    step1_passed = 1;
    write("count_MARRec_time = %.2f",count_MARRec_time);
  }
  else{
    write(">>> FAIL REASON: MAR recording time %.2f seconds is out of expected 19-21 range <<<", count_MARRec_time);
    Log_Error_Details();
    testStepFail("Fail","Test-case is NG");
    step1_passed = 0;
    write("count_MARRec_time = %.2f",count_MARRec_time);
  }
  
  CaptureGraphics("OWD", "BLTN_CAM_RecSta_MAR"); write("Run CaptureGraphics()");

  testWaitForTimeout(1000);

  @panel::Switch_CGWNM = 0;

  @panel::Switch_Clock = 0;

  count_MARRec_time = 0.0;

  KEY_OFF(); write("Run KEY_OFF()");

  testStep("","Step 3: Screenshot ... PASS");
  write("Finish OWD_023_3");
  StopTestTimer();
  Send_Value_To_COM(44);
}


void MainTest(){
  testReportFileName("TestReports\\OWD_023 - 2.5 generation_report");
  
  OWD_023_Init();
  OWD_023_1();
  OWD_023_2();
  OWD_023_3();
}
