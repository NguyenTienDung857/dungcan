/*@!Encoding:1252*/

/*
  Test Case: OWD_026
  Title: [TML Recording Test - Start/Stop/Repeat/Enter BLTN_CAM]
  Verification items:
    - Step 1: Start TML recording, check BLTN_CAM_RecSta_TML = 0x1 (ON) - Screenshot
    - Step 2,3,4: Log - LED photo capture (manual)
    - Step 5: Wait 10s, Stop TML, check BLTN_CAM_RecSta_TML = 0x0 (OFF) - Screenshot
    - Step 6,7: Log - LED photo capture (manual)
    - Step 8: Start/Stop TML x5 times, verify ON/OFF each cycle - Screenshot after 5 cycles
    - Step 9: Start TML, wait 5s, Stop TML, check OFF - Screenshot + check video
    - Step 10: Start TML, wait 10s, Enter BLTN_CAM, check TML OFF - Screenshot + check video

  Preconditions:
    - ACC and IGN and ccNC/ccIC switch OFF, AVN mode

  NOTE: Uses 2-5s delay for signal propagation after each state transition.
*/

variables
{
  long max_wait_time_10s = 10000;   // 10 seconds timeout

  // Message declarations for CAN
  message HU_BLTN_CAM_PE_00_200ms _HU_BLTN_CAM_PE_00_200ms;
  message HU_BLTN_CAM_E_01 _HU_BLTN_CAM_E_01;
  message HU_CLOCK_PE_02 _HU_CLOCK_PE_02;

  // Result tracking variables
  int step1_passed = 0;
  int step5_passed = 0;
  int step8_passed = 0;
  int step9_passed = 0;
  int step10_passed = 0;

  int flag_RecSet_error = 0;
}

// ============================================================================
// Panel Control Helper Functions
// ============================================================================

// Set SMK to IGN (0x2) via panel combo box
void Set_SMK_IGN()
{
  write("=== Setting SMK_Signal to IGN via panel ===");
  @panel::Switch_CGWNM = 1;
  testWaitForTimeout(2000);
  setSignal(SMK_TrmnlCtrlGrpStaBDC, 0x2);  // IGN
  testWaitForTimeout(2000);
  write("  SMK_TrmnlCtrlGrpStaBDC = 0x%X (IGN)", $SMK_TrmnlCtrlGrpStaBDC);
}

// Click USM Reset button on panel
void Click_USM_Reset()
{
  write("=== Clicking USM Reset button on panel ===");
  @panel::Button_USMReset = 1;
  testWaitForTimeout(2000);
  write("  USM Reset clicked");
}

// Click Rec Reset button on panel
void Click_Rec_Reset()
{
  write("=== Clicking Rec Reset button on panel ===");
  @panel::Button_RecReset = 1;
  testWaitForTimeout(2000);
  write("  Rec Reset clicked");
}

// Click TML Start button on panel Recording_Setting
void Click_TML_Start()
{
  write("=== Clicking TML Start button on panel ===");
  @panel::Button_Timelaps_Start = 0;
  testWaitForTimeout(500);
  @panel::Button_Timelaps_Start = 1;
  testWaitForTimeout(2000);
  write("  TML Start clicked");
}

// Click TML Stop button on panel Recording_Setting
void Click_TML_Stop()
{
  write("=== Clicking TML Stop button on panel ===");
  @panel::Button_Timelaps_Stop = 0;
  testWaitForTimeout(500);
  @panel::Button_Timelaps_Stop = 1;
  testWaitForTimeout(2000);
  write("  TML Stop clicked");
}

// Enter Built-in Cam mode (HU_BLTN_CAM_UI_Mode = 0x1)
void Enter_BLTN_CAM()
{
  int i;
  write(">>> Enter BLTN_CAM mode <<<");
  _HU_BLTN_CAM_PE_00_200ms.HU_BLTN_CAM_UI_Mode = 0x1;
  output(_HU_BLTN_CAM_PE_00_200ms);

  for (i = 0; i < 10; i++) {
    testWaitForTimeout(500);
    if (getSignal(BLTN_CAM_HU_UI_Mode) == 0x1) {
      write(">>> [OK] BLTN_CAM mode confirmed <<<");
      return;
    }
  }
  write(">>> [NG] Timeout: BLTN_CAM_HU_UI_Mode = 0x%X <<<",
        getSignal(BLTN_CAM_HU_UI_Mode));
}

// Exit to AVN HU UI mode (HU_BLTN_CAM_UI_Mode = 0x0)
void Exit_BLTN_CAM()
{
  int i;
  write(">>> Exit to AVN mode <<<");
  _HU_BLTN_CAM_PE_00_200ms.HU_BLTN_CAM_UI_Mode = 0x0;
  output(_HU_BLTN_CAM_PE_00_200ms);

  for (i = 0; i < 10; i++) {
    testWaitForTimeout(500);
    if (getSignal(BLTN_CAM_HU_UI_Mode) == 0x0) {
      write(">>> [OK] AVN mode confirmed <<<");
      return;
    }
  }
  write(">>> [NG] Timeout: BLTN_CAM_HU_UI_Mode = 0x%X <<<",
        getSignal(BLTN_CAM_HU_UI_Mode));
}

// ============================================================================
// Check Functions
// ============================================================================

// Wait for BLTN_CAM_RecSta_TML = 0x1 (ON/Recording) with timeout
int WaitFor_RecSta_TML_ON(long timeout_ms)
{
  long elapsed = 0;
  long check_interval = 1000;  // Check every 1 second
  byte rec_sta_tml = 0;
  long log_interval;

  write("=== Waiting for TML Recording ON (max %d seconds) ===", timeout_ms / 1000);
  log_interval = (timeout_ms / 6 / check_interval) * check_interval;
  if(log_interval < check_interval) log_interval = check_interval;

  while(elapsed < timeout_ms)
  {
    rec_sta_tml = $BLTN_CAM_RecSta_TML;

    if(elapsed == 0 || elapsed % log_interval == 0)
    {
      write("  [%d s / %d s] BLTN_CAM_RecSta_TML = 0x%X",
            elapsed / 1000, timeout_ms / 1000, rec_sta_tml);
    }

    if(rec_sta_tml == 0x1)
    {
      write(">>> DETECTED: TML Recording ON after %d seconds <<<", elapsed / 1000);
      write(">>> PASS: BLTN_CAM_RecSta_TML = 0x1 (ON) <<<");
      return 1;
    }

    testWaitForTimeout(check_interval);
    elapsed += check_interval;
  }

  write(">>> TIMEOUT: TML Recording NOT ON after %d seconds <<<", timeout_ms / 1000);
  write(">>> FAIL: BLTN_CAM_RecSta_TML is still 0x%X <<<", rec_sta_tml);
  return 0;
}

// Check BLTN_CAM_RecSta_TML = 0x0 (OFF) with timeout
int WaitFor_RecSta_TML_OFF(long timeout_ms)
{
  long elapsed = 0;
  long check_interval = 1000;
  byte rec_sta_tml = 0;
  long log_interval;

  write("=== Waiting for TML Recording OFF (max %d seconds) ===", timeout_ms / 1000);
  log_interval = (timeout_ms / 6 / check_interval) * check_interval;
  if(log_interval < check_interval) log_interval = check_interval;

  while(elapsed < timeout_ms)
  {
    rec_sta_tml = $BLTN_CAM_RecSta_TML;

    if(elapsed == 0 || elapsed % log_interval == 0)
    {
      write("  [%d s / %d s] BLTN_CAM_RecSta_TML = 0x%X",
            elapsed / 1000, timeout_ms / 1000, rec_sta_tml);
    }

    if(rec_sta_tml == 0x0)
    {
      write(">>> DETECTED: TML Recording OFF after %d seconds <<<", elapsed / 1000);
      write(">>> PASS: BLTN_CAM_RecSta_TML = 0x0 (OFF) <<<");
      return 1;
    }

    testWaitForTimeout(check_interval);
    elapsed += check_interval;
  }

  write(">>> TIMEOUT: TML Recording NOT OFF after %d seconds <<<", timeout_ms / 1000);
  write(">>> FAIL: BLTN_CAM_RecSta_TML is still 0x%X <<<", rec_sta_tml);
  return 0;
}

// Check BLTN_CAM_RecSta_TML current value = 0x0 (OFF)
int Check_RecSta_TML_OFF()
{
  byte rec_sta_tml = 0;

  rec_sta_tml = $BLTN_CAM_RecSta_TML;
  write("  BLTN_CAM_RecSta_TML = 0x%X", rec_sta_tml);

  if(rec_sta_tml == 0x0)
  {
    write(">>> PASS: BLTN_CAM_RecSta_TML = 0x0 (OFF) <<<");
    return 1;
  }
  else
  {
    write(">>> FAIL: BLTN_CAM_RecSta_TML is NOT OFF (value = 0x%X) <<<", rec_sta_tml);
    return 0;
  }
}

// Check BLTN_CAM_RecSta_TML current value = 0x1 (ON)
int Check_RecSta_TML_ON()
{
  byte rec_sta_tml = 0;

  rec_sta_tml = $BLTN_CAM_RecSta_TML;
  write("  BLTN_CAM_RecSta_TML = 0x%X", rec_sta_tml);

  if(rec_sta_tml == 0x1)
  {
    write(">>> PASS: BLTN_CAM_RecSta_TML = 0x1 (ON) <<<");
    return 1;
  }
  else
  {
    write(">>> FAIL: BLTN_CAM_RecSta_TML is NOT ON (value = 0x%X) <<<", rec_sta_tml);
    return 0;
  }
}

// ============================================================================
// Rec Reset Function
// ============================================================================
void Rec_Reset()
{
  @panel::Switch_CGWNM = 1;

  setSignal(SMK_TrmnlCtrlGrpStaBDC, 0x2);
  testWaitForTimeout(2000);

  while (getSignal(BLTN_CAM_SD_Format_Op_State) != 0x1)
  {
    @panel::Button_RecReset = 1;
    testWaitForSignalChange(BLTN_CAM_SD_Format_Op_State, 500);
  }

  setSignal(SMK_TrmnlCtrlGrpStaBDC, 0x0);
  testWaitForTimeout(2000);

  @panel::Switch_CGWNM = 0;
}

// ============================================================================
// Capture Screenshot Functions
// ============================================================================

// Capture screenshot with specified signal list
void CaptureGraphics(char signalList[])
{
  testWaitForTimeout(3000);
  testReportAddWindowCapture("OWD", signalList, "Screenshot");
  write(">>> Screenshot captured <<<");
}

// ============================================================================
// Main Test Case
// ============================================================================

testcase OWD_026_Init()
{
  write("========================================");
  write("=== START TEST OWD_026 ===");
  write("=== TML Recording Start/Stop Test   ===");
  write("========================================");
}

testcase OWD_026_1()
{
  int result = 0;

  //============================================================================
  // STEP 1: Set SMK IGN, USM Reset, Rec Reset, AVN mode,
  //         Click TML Start, Check BLTN_CAM_RecSta_TML = 0x1 (ON) - Screenshot
  //============================================================================
  write("");
  write("=================================================================");
  write("=== STEP 1: SMK IGN + USM Reset + Rec Reset + AVN mode      ===");
  write("===         TML Start + Check RecSta_TML = 0x1 (ON)         ===");
  write("=================================================================");
  testStep("Step1", "SMK IGN + USM Reset + Rec Reset + AVN + TML Start + TML ON");

  // 1.1 Set SMK to IGN via panel combo box
  write("[1.1] Setting SMK_Signal to IGN via panel...");
  Set_SMK_IGN();
  testWaitForTimeout(3000);

  // 1.2 Click USM Reset button
  write("[1.2] Clicking USM Reset button...");
  Click_USM_Reset();
  testWaitForTimeout(2000);

  // 1.3 Click Rec Reset button
  write("[1.3] Clicking Rec Reset button...");
  Click_Rec_Reset();
  testWaitForTimeout(2000);

  // 1.4 Ensure AVN mode (Exit BLTN_CAM)
  write("[1.4] Ensuring AVN mode...");
  Exit_BLTN_CAM();
  testWaitForTimeout(2000);
  write("  HU_BLTN_CAM_UI_Mode = 0x%X (AVN mode)", $BLTN_CAM_HU_UI_Mode);

  // 1.5 Click TML Start on panel Recording_Setting
  write("[1.5] Clicking TML Start on panel Recording_Setting...");
  Click_TML_Start();

  // 1.6 Check BLTN_CAM_RecSta_TML = 0x1 (ON)
  write("[1.6] Checking BLTN_CAM_RecSta_TML = 0x1 (ON)...");
  result = WaitFor_RecSta_TML_ON(max_wait_time_10s);

  // 1.7 Capture screenshot
  write("[1.7] Capturing screenshot...");
  CaptureGraphics("BLTN_CAM_RecSta_TML;AIN;BLTN_CAM_HU_UI_Mode;SMK_TrmnlCtrlGrpStaBDC");

  if(result == 1)
  {
    step1_passed = 1;
    testStepPass("Step1", "BLTN_CAM_RecSta_TML = 0x1 (ON) after TML Start - PASS");
  }
  else
  {
    step1_passed = 0;
    testStepFail("Step1", "BLTN_CAM_RecSta_TML did NOT turn ON after TML Start - FAIL");
  }
}

testcase OWD_026_2_3_4()
{
  //============================================================================
  // STEP 2, 3, 4: Log - LED Photo Capture (Manual)
  //============================================================================
  write("");
  write("=================================================================");
  write("=== STEP 2, 3, 4: LED Photo Capture (Manual) ===");
  write("=================================================================");
  testStep("Step2_3_4", "LED photo capture - check signal light");

  write("");
  write("*************************************************************");
  write("*** STEP 2, 3, 4: LOG INFORMATION ***");
  write("*** Please capture LED photo directly ***");
  write("*** Check signal light status on the device ***");
  write("*** Include this photo in the test report ***");
  write("*************************************************************");
  write("");

  testStepPass("Step2_3_4", "LED photo capture logged - Manual photo required");
}

testcase OWD_026_5()
{
  int result = 0;

  //============================================================================
  // STEP 5: Wait 10s, Click TML Stop, Check BLTN_CAM_RecSta_TML = 0x0 (OFF)
  //         - Screenshot
  //============================================================================
  write("");
  write("=================================================================");
  write("=== STEP 5: Wait 10s + TML Stop + Check RecSta_TML = 0x0    ===");
  write("=================================================================");
  testStep("Step5", "Wait 10s + TML Stop + RecSta_TML OFF verification");

  // 5.1 Wait 10 seconds
  write("[5.1] Waiting 10 seconds...");
  testWaitForTimeout(10000);
  write("  10 seconds elapsed.");

  // 5.2 Click TML Stop on panel
  write("[5.2] Clicking TML Stop on panel...");
  Click_TML_Stop();

  // 5.3 Check BLTN_CAM_RecSta_TML = 0x0 (OFF)
  write("[5.3] Checking BLTN_CAM_RecSta_TML = 0x0 (OFF)...");
  result = WaitFor_RecSta_TML_OFF(max_wait_time_10s);

  // 5.4 Capture screenshot
  write("[5.4] Capturing screenshot...");
  CaptureGraphics("BLTN_CAM_RecSta_TML;AIN;BLTN_CAM_HU_UI_Mode;SMK_TrmnlCtrlGrpStaBDC");

  if(result == 1)
  {
    step5_passed = 1;
    testStepPass("Step5", "BLTN_CAM_RecSta_TML = 0x0 (OFF) after TML Stop - PASS");
  }
  else
  {
    step5_passed = 0;
    testStepFail("Step5", "BLTN_CAM_RecSta_TML did NOT turn OFF after TML Stop - FAIL");
  }
}

testcase OWD_026_6_7()
{
  //============================================================================
  // STEP 6, 7: Log - LED Photo Capture (Manual)
  //============================================================================
  write("");
  write("=================================================================");
  write("=== STEP 6, 7: LED Photo Capture (Manual) ===");
  write("=================================================================");
  testStep("Step6_7", "LED photo capture - check signal light");

  write("");
  write("*************************************************************");
  write("*** STEP 6, 7: LOG INFORMATION ***");
  write("*** Please capture LED photo directly ***");
  write("*** Check signal light status on the device ***");
  write("*** Include this photo in the test report ***");
  write("*************************************************************");
  write("");

  testStepPass("Step6_7", "LED photo capture logged - Manual photo required");
}

testcase OWD_026_8()
{
  int result = 0;
  int i = 0;
  int cycle_all_pass = 1;

  //============================================================================
  // STEP 8: TML Start/Stop cycle x5 times
  //         Each cycle: Start -> check ON -> Stop -> check OFF
  //         Screenshot after 5 cycles
  //============================================================================
  write("");
  write("=================================================================");
  write("=== STEP 8: TML Start/Stop x5 Cycles                        ===");
  write("=================================================================");
  testStep("Step8", "TML Start/Stop repeat 5 cycles");

  cycle_all_pass = 1;

  for(i = 1; i <= 5; i++)
  {
    write("");
    write("--- Cycle %d / 5 ---", i);

    // Start TML
    write("[8.%d.1] Clicking TML Start...", i);
    Click_TML_Start();

    // Check TML ON
    write("[8.%d.2] Checking BLTN_CAM_RecSta_TML = 0x1 (ON)...", i);
    result = WaitFor_RecSta_TML_ON(max_wait_time_10s);
    if(result != 1)
    {
      write(">>> FAIL: Cycle %d - TML did NOT turn ON <<<", i);
      cycle_all_pass = 0;
    }
    else
    {
      write(">>> Cycle %d - TML ON confirmed <<<", i);
    }

    // Stop TML
    write("[8.%d.3] Clicking TML Stop...", i);
    Click_TML_Stop();

    // Check TML OFF
    write("[8.%d.4] Checking BLTN_CAM_RecSta_TML = 0x0 (OFF)...", i);
    result = WaitFor_RecSta_TML_OFF(max_wait_time_10s);
    if(result != 1)
    {
      write(">>> FAIL: Cycle %d - TML did NOT turn OFF <<<", i);
      cycle_all_pass = 0;
    }
    else
    {
      write(">>> Cycle %d - TML OFF confirmed <<<", i);
    }
  }

  // Capture screenshot after 5 cycles
  write("[8.6] Capturing screenshot after 5 cycles...");
  CaptureGraphics("BLTN_CAM_RecSta_TML;AIN;BLTN_CAM_HU_UI_Mode;SMK_TrmnlCtrlGrpStaBDC");

  if(cycle_all_pass == 1)
  {
    step8_passed = 1;
    testStepPass("Step8", "TML Start/Stop x5 cycles all PASS");
  }
  else
  {
    step8_passed = 0;
    testStepFail("Step8", "TML Start/Stop x5 cycles - some cycles FAILED");
  }
}

testcase OWD_026_9()
{
  int result = 0;

  //============================================================================
  // STEP 9: TML Start -> check ON -> wait 5s -> TML Stop -> check OFF
  //         Screenshot + log check video
  //============================================================================
  write("");
  write("=================================================================");
  write("=== STEP 9: TML Start + Wait 5s + TML Stop + Check Video    ===");
  write("=================================================================");
  testStep("Step9", "TML Start + wait 5s + TML Stop + check OFF + check video");

  // 9.1 Click TML Start
  write("[9.1] Clicking TML Start...");
  Click_TML_Start();

  // 9.2 Check BLTN_CAM_RecSta_TML = 0x1 (ON)
  write("[9.2] Checking BLTN_CAM_RecSta_TML = 0x1 (ON)...");
  result = WaitFor_RecSta_TML_ON(max_wait_time_10s);
  if(result != 1)
  {
    write(">>> FAIL: TML did NOT turn ON for Step 9 <<<");
  }

  // 9.3 Wait 5 seconds
  write("[9.3] Waiting 5 seconds...");
  testWaitForTimeout(5000);
  write("  5 seconds elapsed.");

  // 9.4 Click TML Stop
  write("[9.4] Clicking TML Stop...");
  Click_TML_Stop();

  // 9.5 Check BLTN_CAM_RecSta_TML = 0x0 (OFF)
  write("[9.5] Checking BLTN_CAM_RecSta_TML = 0x0 (OFF)...");
  result = WaitFor_RecSta_TML_OFF(max_wait_time_10s);

  // 9.6 Capture screenshot
  write("[9.6] Capturing screenshot...");
  CaptureGraphics("BLTN_CAM_RecSta_TML;AIN;BLTN_CAM_HU_UI_Mode;SMK_TrmnlCtrlGrpStaBDC");

  // 9.7 Log: Check video
  write("");
  write("*************************************************************");
  write("*** STEP 9: CHECK VIDEO ***");
  write("*** Please verify the TML recording video ***");
  write("*** TML was recording for ~5 seconds before stop ***");
  write("*************************************************************");
  write("");

  if(result == 1)
  {
    step9_passed = 1;
    testStepPass("Step9", "TML Start + wait 5s + TML Stop + OFF confirmed + check video - PASS");
  }
  else
  {
    step9_passed = 0;
    testStepFail("Step9", "TML did NOT turn OFF after Stop in Step 9 - FAIL");
  }
}

testcase OWD_026_10()
{
  int result = 0;

  //============================================================================
  // STEP 10: TML Start -> check ON -> wait 10s -> Enter BLTN_CAM
  //          -> check TML OFF -> Screenshot + log check video
  //============================================================================
  write("");
  write("=================================================================");
  write("=== STEP 10: TML Start + Wait 10s + Enter BLTN_CAM          ===");
  write("===          Check TML OFF + Screenshot + Check Video        ===");
  write("=================================================================");
  testStep("Step10", "TML Start + wait 10s + Enter BLTN_CAM + check TML OFF + check video");

  // 10.1 Click TML Start
  write("[10.1] Clicking TML Start...");
  Click_TML_Start();

  // 10.2 Check BLTN_CAM_RecSta_TML = 0x1 (ON)
  write("[10.2] Checking BLTN_CAM_RecSta_TML = 0x1 (ON)...");
  result = WaitFor_RecSta_TML_ON(max_wait_time_10s);
  if(result != 1)
  {
    write(">>> FAIL: TML did NOT turn ON for Step 10 <<<");
  }

  // 10.3 Wait 10 seconds
  write("[10.3] Waiting 10 seconds...");
  testWaitForTimeout(10000);
  write("  10 seconds elapsed.");

  // 10.4 Enter Built-in Cam mode
  write("[10.4] Entering Built-in Cam (BLTN_CAM) mode...");
  Enter_BLTN_CAM();
  testWaitForTimeout(3000);
  write("  HU_BLTN_CAM_UI_Mode = 0x%X", $BLTN_CAM_HU_UI_Mode);

  // 10.5 Check BLTN_CAM_RecSta_TML = 0x0 (OFF)
  write("[10.5] Checking BLTN_CAM_RecSta_TML = 0x0 (OFF) after entering BLTN_CAM...");
  result = WaitFor_RecSta_TML_OFF(max_wait_time_10s);

  // 10.6 Capture screenshot
  write("[10.6] Capturing screenshot...");
  CaptureGraphics("BLTN_CAM_RecSta_TML;AIN;BLTN_CAM_HU_UI_Mode;SMK_TrmnlCtrlGrpStaBDC");

  // 10.7 Log: Check video
  write("");
  write("*************************************************************");
  write("*** STEP 10: CHECK VIDEO ***");
  write("*** Please verify the TML recording video ***");
  write("*** TML was recording for ~10s then entered BLTN_CAM mode ***");
  write("*** Entering BLTN_CAM mode should stop TML recording ***");
  write("*************************************************************");
  write("");

  if(result == 1)
  {
    step10_passed = 1;
    testStepPass("Step10", "TML OFF after entering BLTN_CAM mode confirmed + check video - PASS");
  }
  else
  {
    step10_passed = 0;
    testStepFail("Step10", "TML did NOT turn OFF after entering BLTN_CAM mode - FAIL");
  }
}

testcase OWD_026_Summary()
{
  //============================================================================
  // Overall Test Verdict
  //============================================================================
  if(step1_passed == 1 && step5_passed == 1 && step8_passed == 1 && step9_passed == 1 && step10_passed == 1)
  {
    testStepPass("Overall_Verdict", "Test OWD_026: PASS");
    write("=== OVERALL VERDICT: PASS ===");
  }
  else
  {
    testStepFail("Overall_Verdict", "Test OWD_026: FAIL");
    write("=== OVERALL VERDICT: FAIL ===");
  }

  //============================================================================
  // TEST COMPLETE - Cleanup
  //============================================================================
  write("");
  write("========================================");
  write("=== TEST OWD_026 COMPLETE ===");
  write("========================================");

  // Cleanup: Exit BLTN_CAM, KEY OFF
  Exit_BLTN_CAM();
  testWaitForTimeout(2000);
  setSignal(SMK_TrmnlCtrlGrpStaBDC, 0x0);  // KEY OFF
  testWaitForTimeout(2000);
  @panel::Switch_CGWNM = 0;

  // Final status
  write("");
  write("=== FINAL STATUS ===");
  write("  SMK_TrmnlCtrlGrpStaBDC = 0x%X", $SMK_TrmnlCtrlGrpStaBDC);
  write("  BLTN_CAM_RecSta_TML = 0x%X", $BLTN_CAM_RecSta_TML);
  write("  BLTN_CAM_HU_UI_Mode = 0x%X", $BLTN_CAM_HU_UI_Mode);

  write("");
  write("=== TEST SUMMARY ===");
  if(step1_passed == 1)
    write("Step 1: SMK IGN + USM Reset + Rec Reset + TML Start + TML ON [Screenshot] - PASS");
  else
    write("Step 1: SMK IGN + USM Reset + Rec Reset + TML Start + TML ON [Screenshot] - FAIL");

  write("Step 2,3,4: LED photo capture [Manual - Check LED] - PASS");

  if(step5_passed == 1)
    write("Step 5: Wait 10s + TML Stop + TML OFF [Screenshot] - PASS");
  else
    write("Step 5: Wait 10s + TML Stop + TML OFF [Screenshot] - FAIL");

  write("Step 6,7: LED photo capture [Manual - Check LED] - PASS");

  if(step8_passed == 1)
    write("Step 8: TML Start/Stop x5 cycles [Screenshot] - PASS");
  else
    write("Step 8: TML Start/Stop x5 cycles [Screenshot] - FAIL");

  if(step9_passed == 1)
    write("Step 9: TML Start + 5s + TML Stop + OFF + check video [Screenshot] - PASS");
  else
    write("Step 9: TML Start + 5s + TML Stop + OFF + check video [Screenshot] - FAIL");

  if(step10_passed == 1)
    write("Step 10: TML Start + 10s + Enter BLTN_CAM + TML OFF + check video [Screenshot] - PASS");
  else
    write("Step 10: TML Start + 10s + Enter BLTN_CAM + TML OFF + check video [Screenshot] - FAIL");
}

void MainTest()
{
  testReportFileName("TestReports\\OWD_026 - 2.0 generation_report");

  //write("Run Rec_Reset()"); Rec_Reset();

  OWD_026_Init();
  OWD_026_1();
  OWD_026_2_3_4();
  OWD_026_5();
  OWD_026_6_7();
  OWD_026_8();
  OWD_026_9();
  OWD_026_10();
  OWD_026_Summary();
}
