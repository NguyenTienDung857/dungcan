/*@!Encoding:65001*/

/*
  Test Case: OWD_027
  Title: [MAR + TML Recording Test - Evt Switch in AVN + TML in BLTN_CAM/AVN + 20min auto-stop]
  Verification items:
    - Step 1: SMK IGN + USM Reset + Rec Reset + AVN mode + Evt Switch
              Check BLTN_CAM_RecSta_TML = 0x0 (OFF) and BLTN_CAM_RecSta_MAR = 0x1 (Recording, 10s) - Screenshot
    - Step 2: Enter Built-in Cam + Click TML Start
              Check BLTN_CAM_RecSta_TML = 0x0 (OFF) - Screenshot
    - Step 3, 4: Log - LED photo capture (manual)
    - Step 5: Exit to AVN home + Click TML Start
              Check BLTN_CAM_RecSta_TML = 0x1 (ON), wait 20 min
              Check BLTN_CAM_RecSta_TML = 0x0 (OFF) auto-stop - Screenshot
    - Step 6, 7, 8, 9: Log - LED and video check (manual)

  Preconditions:
    - ACC and IGN and ccNC/ccIC switch OFF, AVN mode

  NOTE: Uses 2-5s delay for signal propagation after each state transition.
        Step 5 includes a 20-minute wait for TML auto-stop verification.
*/

variables
{
  long max_wait_time_10s = 10000;   // 10 seconds timeout
  long tml_auto_stop_20min = 1200000; // 20 minutes = 1,200,000 ms

  // Message declarations for CAN FD
  message HU_BLTN_CAM_02_200ms _HU_BLTN_CAM_02_200ms;
  message HU_BLTN_CAM_01_00ms _HU_BLTN_CAM_01_00ms;
  message HU_CLOCK_01_1000ms _HU_CLOCK_01_1000ms;

  // Result tracking variables
  int step1_tml_passed = 0;
  int step1_mar_passed = 0;
  int step2_passed = 0;
  int step5_on_passed = 0;
  int step5_off_passed = 0;

  // Error counter for Turn_OFF_RecSet
  int flag_RecSet_error = 0;
}

// ============================================================================
// Panel Control Helper Functions
// ============================================================================

// Set SMK to IGN (0x2) via panel combo box
void Set_SMK_IGN()
{
  write("=== Setting SMK_Signal to IGN via panel ===");
  @panel::Switch_CGWNM = 1;
  testWaitForTimeout(2000);
  setSignal(SMK_TrmnlCtrlGrpStaBDC, 0x2);  // IGN
  testWaitForTimeout(2000);
  write("  SMK_TrmnlCtrlGrpStaBDC = 0x%X (IGN)", $SMK_TrmnlCtrlGrpStaBDC);
}

// Click USM Reset button on panel
void Click_USM_Reset()
{
  write("=== Clicking USM Reset button on panel ===");
  @panel::Button_USMReset = 1;
  testWaitForTimeout(2000);
  write("  USM Reset clicked");
}

// Click Rec Reset button on panel
void Click_Rec_Reset()
{
  write("=== Clicking Rec Reset button on panel ===");
  @panel::Button_RecReset = 1;
  testWaitForTimeout(2000);
  write("  Rec Reset clicked");
}

// Click Evt Switch button on panel (toggle off then on)
void Click_Evt_Switch()
{
  write("=== Clicking Event Switch button ===");
  @panel::Button_SwitchEvt = 1;
  //testWaitForTimeout(3000);
  testWaitForTimeout(2000);
  write("  Evt Switch clicked");
}

// Click TML Start button on panel Recording_Setting
void Click_TML_Start()
{
  write("=== Clicking TML Start button on panel ===");
  @panel::Button_Timelaps_Start = 0;
  testWaitForTimeout(500);
  @panel::Button_Timelaps_Start = 1;
  testWaitForTimeout(2000);
  write("  TML Start clicked");
}

// Click TML Stop button on panel Recording_Setting
void Click_TML_Stop()
{
  write("=== Clicking TML Stop button on panel ===");
  @panel::Button_Timelaps_Stop = 0;
  testWaitForTimeout(500);
  @panel::Button_Timelaps_Stop = 1;
  testWaitForTimeout(2000);
  write("  TML Stop clicked");
}

// Enter Built-in Cam mode (HU_BLTN_CAM_UI_Mode = 0x1)
void Enter_BLTN_CAM()
{
  write(">>> Enter BLTN_CAM mode <<<");
  _HU_BLTN_CAM_02_200ms.HU_BLTN_CAM_UI_Mode = 0x1;
  output(_HU_BLTN_CAM_02_200ms);
  testWaitForTimeout(3000);
}

// Exit to AVN HU UI mode (HU_BLTN_CAM_UI_Mode = 0x0)
void Exit_BLTN_CAM()
{
  write(">>> Exit BLTN_CAM mode - Return to AVN <<<");
  _HU_BLTN_CAM_02_200ms.HU_BLTN_CAM_UI_Mode = 0x0;
  output(_HU_BLTN_CAM_02_200ms);
  testWaitForTimeout(3000);
}

// ============================================================================
// Check Functions
// ============================================================================

// Check BLTN_CAM_RecSta_TML current value = 0x0 (OFF)
int Check_RecSta_TML_OFF()
{
  byte rec_sta_tml = 0;

  rec_sta_tml = $BLTN_CAM_RecSta_TML;
  write("  BLTN_CAM_RecSta_TML = 0x%X", rec_sta_tml);

  if(rec_sta_tml == 0x0)
  {
    write(">>> PASS: BLTN_CAM_RecSta_TML = 0x0 (OFF) <<<");
    return 1;
  }
  else
  {
    write(">>> FAIL: BLTN_CAM_RecSta_TML is NOT OFF (value = 0x%X) <<<", rec_sta_tml);
    return 0;
  }
}

// Wait for BLTN_CAM_RecSta_TML = 0x1 (ON) with timeout
int WaitFor_RecSta_TML_ON(long timeout_ms)
{
  long elapsed = 0;
  long check_interval = 1000;  // Check every 1 second
  byte rec_sta_tml = 0;
  long log_interval;

  write("=== Waiting for TML Recording ON (max %d seconds) ===", timeout_ms / 1000);
  log_interval = (timeout_ms / 6 / check_interval) * check_interval;
  if(log_interval < check_interval) log_interval = check_interval;

  while(elapsed < timeout_ms)
  {
    rec_sta_tml = $BLTN_CAM_RecSta_TML;

    if(elapsed == 0 || elapsed % log_interval == 0)
    {
      write("  [%d s / %d s] BLTN_CAM_RecSta_TML = 0x%X",
            elapsed / 1000, timeout_ms / 1000, rec_sta_tml);
    }

    if(rec_sta_tml == 0x1)
    {
      write(">>> DETECTED: TML Recording ON after %d seconds <<<", elapsed / 1000);
      write(">>> PASS: BLTN_CAM_RecSta_TML = 0x1 (ON) <<<");
      return 1;
    }

    testWaitForTimeout(check_interval);
    elapsed += check_interval;
  }

  write(">>> TIMEOUT: TML Recording NOT ON after %d seconds <<<", timeout_ms / 1000);
  write(">>> FAIL: BLTN_CAM_RecSta_TML is still 0x%X <<<", rec_sta_tml);
  return 0;
}

// Wait for BLTN_CAM_RecSta_TML = 0x0 (OFF) with timeout (long wait, e.g. 20 min)
int WaitFor_RecSta_TML_OFF(long timeout_ms)
{
  long elapsed = 0;
  long check_interval = 5000;  // Check every 5 seconds (suitable for long waits)
  byte rec_sta_tml = 0;

  write("=== Waiting for TML Recording OFF (max %d seconds) ===", timeout_ms / 1000);

  while(elapsed < timeout_ms)
  {
    rec_sta_tml = $BLTN_CAM_RecSta_TML;

    // Log every 30 seconds to avoid flooding
    if((elapsed % 30000) == 0)
    {
      write("  [%d s / %d s] BLTN_CAM_RecSta_TML = 0x%X",
            elapsed / 1000, timeout_ms / 1000, rec_sta_tml);
    }

    if(rec_sta_tml == 0x0)
    {
      write(">>> DETECTED: TML Recording OFF after %d seconds <<<", elapsed / 1000);
      write(">>> PASS: BLTN_CAM_RecSta_TML = 0x0 (OFF) <<<");
      return 1;
    }

    testWaitForTimeout(check_interval);
    elapsed += check_interval;
  }

  write(">>> TIMEOUT: TML Recording NOT OFF after %d seconds <<<", timeout_ms / 1000);
  write(">>> FAIL: BLTN_CAM_RecSta_TML is still 0x%X <<<", rec_sta_tml);
  return 0;
}

// Wait for BLTN_CAM_RecSta_MAR = 0x1 (Recording) with timeout
int WaitFor_RecSta_MAR_Recording(long timeout_ms)
{
  long elapsed = 0;
  long check_interval = 1000;  // Check every 1 second
  byte rec_sta_mar = 0;
  long log_interval;

  write("=== Waiting for MAR Recording (max %d seconds) ===", timeout_ms / 1000);
  write("Checking every %d second...", check_interval / 1000);
  log_interval = (timeout_ms / 6 / check_interval) * check_interval;
  if(log_interval < check_interval) log_interval = check_interval;

  while(elapsed < timeout_ms)
  {
    rec_sta_mar = $BLTN_CAM_RecSta_MAR;

    if(elapsed == 0 || elapsed % log_interval == 0)
    {
      write("  [%d s / %d s] BLTN_CAM_RecSta_MAR = 0x%X",
            elapsed / 1000, timeout_ms / 1000, rec_sta_mar);
    }

    if(rec_sta_mar == 0x1)
    {
      write(">>> DETECTED: MAR Recording started after %d seconds <<<", elapsed / 1000);
      write(">>> PASS: BLTN_CAM_RecSta_MAR = 0x1 (Recording) <<<");
      return 1;
    }

    testWaitForTimeout(check_interval);
    elapsed += check_interval;
  }

  write(">>> TIMEOUT: MAR Recording NOT detected after %d seconds <<<", timeout_ms / 1000);
  write(">>> FAIL: BLTN_CAM_RecSta_MAR is still 0x%X <<<", rec_sta_mar);
  return 0;
}

// ============================================================================
// Turn OFF All Recording Settings
// ============================================================================
void Turn_OFF_RecSet()
{
  if (getSignal(BLTN_CAM_RecSet_OWD) == 0x2 || getSignal(BLTN_CAM_RecSet_OWP) == 0x2 || getSignal(BLTN_CAM_RecSet_DEV) == 0x2 || getSignal(BLTN_CAM_RecSet_PEV) == 0x2)
  {
    @panel::Switch_CGWNM = 1;

    setSignal(SMK_TrmnlCtrlGrpStaBDC, 0x2);
    testWaitForTimeout(3000);

    do {
      Enter_BLTN_CAM();
      testWaitForTimeout(3000);

      if (getSignal(BLTN_CAM_RecSet_OWD) == 0x2){
        write("OWD Off"); @panel::LED_Ctrl_SetOWD = 1; testWaitForTimeout(1000);
      }
      else if (getSignal(BLTN_CAM_RecSet_OWP) == 0x2){
        write("OWP Off"); @panel::LED_Ctrl_SetOWP = 1; testWaitForTimeout(1000);
      }
      else if (getSignal(BLTN_CAM_RecSet_DEV) == 0x2){
        write("DEV Off"); @panel::LED_Ctrl_SetDEV = 1; testWaitForTimeout(1000);
      }
      else if (getSignal(BLTN_CAM_RecSet_PEV) == 0x2){
        write("PEV Off"); @panel::LED_Ctrl_SetPEV = 1; testWaitForTimeout(1000);
      }

      Exit_BLTN_CAM();

      flag_RecSet_error++;

    } while((getSignal(BLTN_CAM_RecSet_OWD) == 0x2 || getSignal(BLTN_CAM_RecSet_OWP) == 0x2 || getSignal(BLTN_CAM_RecSet_DEV) == 0x2 || getSignal(BLTN_CAM_RecSet_PEV) == 0x2) && (flag_RecSet_error <= 15));

    flag_RecSet_error = 0;

    testWaitForTimeout(3000);
    setSignal(SMK_TrmnlCtrlGrpStaBDC, 0x0);
  }
  else
  {
    write("Notifications: All recording settings are turned OFF.");
  }
}

// ============================================================================
// Rec Reset Function
// ============================================================================
void Rec_Reset()
{
  @panel::Switch_CGWNM = 1;

  setSignal(SMK_TrmnlCtrlGrpStaBDC, 0x2);
  testWaitForTimeout(2000);

  while (getSignal(BLTN_CAM_SD_Format_Op_State) != 0x1)
  {
    @panel::Button_RecReset = 1;
    testWaitForSignalChange(BLTN_CAM_SD_Format_Op_State, 500);
  }

  setSignal(SMK_TrmnlCtrlGrpStaBDC, 0x0);
  testWaitForTimeout(2000);

  @panel::Switch_CGWNM = 0;
}

// ============================================================================
// Capture Screenshot Functions
// ============================================================================

// Capture screenshot with specified signal list
void CaptureGraphics(char signalList[], char filename[])
{
  char filepath[512];
  snprintf(filepath, elcount(filepath), "D:\\project\\CAN FD\\[CANoe] CANFD\\Screenshots\\%s", filename);
  write(">>> Capturing screenshot: %s <<<", filepath);
  testWaitForTimeout(3000);
  testReportAddWindowCapture("Graphics 2", signalList, "Screenshot", filepath);
  write(">>> Screenshot captured <<<");
}

// ============================================================================
// Main Test Case
// ============================================================================

testcase OWD_027()
{
  int result = 0;

  write("========================================");
  write("=== START TEST OWD_027 ===");
  write("=== MAR + TML Recording Test        ===");
  write("=== Evt Switch AVN + TML BLTN_CAM   ===");
  write("=== + TML AVN 20min auto-stop       ===");
  write("========================================");

  //============================================================================
  // STEP 1: Set SMK IGN, USM Reset, Rec Reset, AVN mode,
  //         Click Evt Switch, Check TML = 0x0 (OFF) and MAR = 0x1 (Recording, 10s)
  //         Screenshot
  //============================================================================
  write("");
  write("=================================================================");
  write("=== STEP 1: SMK IGN + USM Reset + Rec Reset + AVN mode      ===");
  write("===         Evt Switch + Check TML OFF + MAR Recording (10s)===");
  write("=================================================================");
  testStep("Step1", "SMK IGN + USM Reset + Rec Reset + AVN + Evt Switch + TML OFF + MAR ON");

  // 1.1 Set SMK to IGN via panel combo box
  write("[1.1] Setting SMK_Signal to IGN via panel...");
  Set_SMK_IGN();
  testWaitForTimeout(3000);

  // 1.2 Click USM Reset button
  write("[1.2] Clicking USM Reset button...");
  Click_USM_Reset();
  testWaitForTimeout(2000);

  // 1.3 Click Rec Reset button
  write("[1.3] Clicking Rec Reset button...");
  Click_Rec_Reset();
  testWaitForTimeout(2000);

  // 1.4 Ensure AVN mode (Exit BLTN_CAM if needed)
  write("[1.4] Ensuring AVN mode...");
  Exit_BLTN_CAM();
  testWaitForTimeout(2000);
  write("  HU_BLTN_CAM_UI_Mode = 0x%X (AVN mode)", $BLTN_CAM_HU_UI_Mode);

  // 1.5 Click Evt Switch button on panel
  write("[1.5] Clicking Evt Switch button on panel...");
  Click_Evt_Switch();
  testWaitForTimeout(2000);

  // 1.6 Check BLTN_CAM_RecSta_TML = 0x0 (OFF)
  write("[1.6] Checking BLTN_CAM_RecSta_TML = 0x0 (OFF)...");
  result = Check_RecSta_TML_OFF();

  if(result == 1)
  {
    step1_tml_passed = 1;
    write(">>> Step 1 TML: PASS - BLTN_CAM_RecSta_TML = 0x0 (OFF) <<<");
  }
  else
  {
    step1_tml_passed = 0;
    write(">>> Step 1 TML: FAIL - BLTN_CAM_RecSta_TML is NOT OFF <<<");
  }

  // 1.7 Check BLTN_CAM_RecSta_MAR = 0x1 (Recording) within 10 seconds
  write("[1.7] Waiting for BLTN_CAM_RecSta_MAR = 0x1 (Recording) within 10 seconds...");
  result = WaitFor_RecSta_MAR_Recording(max_wait_time_10s);

  if(result == 1)
  {
    step1_mar_passed = 1;
    write(">>> Step 1 MAR: PASS - BLTN_CAM_RecSta_MAR = 0x1 (Recording) <<<");
  }
  else
  {
    step1_mar_passed = 0;
    write(">>> Step 1 MAR: FAIL - MAR Recording NOT detected <<<");
  }

  // 1.8 Capture screenshot
  write("[1.8] Capturing screenshot...");
  CaptureGraphics("BLTN_CAM_RecSta_TML;BLTN_CAM_RecSta_MAR;AIN;BLTN_CAM_HU_UI_Mode;SMK_TrmnlCtrlGrpStaBDC", "OWD_027_step1.jpg");

  if(step1_tml_passed == 1 && step1_mar_passed == 1)
  {
    testStepPass("Step1", "TML = 0x0 (OFF) and MAR = 0x1 (Recording) after Evt Switch in AVN - PASS");
  }
  else
  {
    testStepFail("Step1", "Step 1 verification failed - TML OFF or MAR Recording check failed");
  }

  //============================================================================
  // STEP 2: Enter Built-in Cam mode, Click TML Start,
  //         Check BLTN_CAM_RecSta_TML = 0x0 (OFF) - Screenshot
  //============================================================================
  write("");
  write("=================================================================");
  write("=== STEP 2: Enter BLTN_CAM + TML Start                      ===");
  write("===         Check BLTN_CAM_RecSta_TML = 0x0 (OFF)           ===");
  write("=================================================================");
  testStep("Step2", "Enter BLTN_CAM + TML Start + Check TML OFF");

  // 2.1 Enter Built-in Cam mode
  write("[2.1] Entering Built-in Cam (BLTN_CAM) mode...");
  Enter_BLTN_CAM();
  testWaitForTimeout(3000);
  write("  HU_BLTN_CAM_UI_Mode = 0x%X (BLTN_CAM)", $BLTN_CAM_HU_UI_Mode);

  // 2.2 Click TML Start button
  write("[2.2] Clicking TML Start button...");
  Click_TML_Start();
  testWaitForTimeout(3000);

  // 2.3 Check BLTN_CAM_RecSta_TML = 0x0 (OFF) - TML should NOT start in BLTN_CAM mode
  write("[2.3] Checking BLTN_CAM_RecSta_TML = 0x0 (OFF) - TML should NOT start in BLTN_CAM mode...");
  result = Check_RecSta_TML_OFF();

  // 2.4 Capture screenshot
  write("[2.4] Capturing screenshot...");
  CaptureGraphics("BLTN_CAM_RecSta_TML;BLTN_CAM_HU_UI_Mode;SMK_TrmnlCtrlGrpStaBDC", "OWD_027_step2.jpg");

  if(result == 1)
  {
    step2_passed = 1;
    testStepPass("Step2", "BLTN_CAM_RecSta_TML = 0x0 (OFF) in BLTN_CAM mode after TML Start - PASS");
  }
  else
  {
    step2_passed = 0;
    testStepFail("Step2", "BLTN_CAM_RecSta_TML is NOT OFF in BLTN_CAM mode after TML Start - FAIL");
  }

  //============================================================================
  // STEP 3 & 4: Log - LED Photo Capture (Manual)
  //============================================================================
  write("");
  write("=================================================================");
  write("=== STEP 3 & 4: LED Photo Capture (Manual)                  ===");
  write("=================================================================");
  testStep("Step3_4", "LED photo capture - check signal light");

  write("");
  write("*************************************************************");
  write("*** STEP 3 & 4: LOG INFORMATION ***");
  write("*** Please capture LED photo directly ***");
  write("*** Check signal light status on the device ***");
  write("*** Include this photo in the test report ***");
  write("*************************************************************");
  write("");

  testStepPass("Step3_4", "LED photo capture logged - Manual photo required");

  //============================================================================
  // STEP 5: Exit to AVN home, Click TML Start,
  //         Check BLTN_CAM_RecSta_TML = 0x1 (ON),
  //         Wait 20 minutes, then check BLTN_CAM_RecSta_TML = 0x0 (OFF)
  //         Screenshot
  //============================================================================
  write("");
  write("=================================================================");
  write("=== STEP 5: Exit to AVN + TML Start + Check TML ON          ===");
  write("===         Wait 20 min + Check TML auto-stop (OFF)         ===");
  write("=================================================================");
  testStep("Step5", "AVN + TML Start + TML ON + 20min wait + TML auto-stop OFF");

  // 5.1 Exit Built-in Cam mode, return to AVN home
  write("[5.1] Exiting to AVN home screen...");
  Exit_BLTN_CAM();
  testWaitForTimeout(3000);
  write("  HU_BLTN_CAM_UI_Mode = 0x%X (AVN mode)", $BLTN_CAM_HU_UI_Mode);

  // 5.2 Click TML Start button
  write("[5.2] Clicking TML Start button...");
  Click_TML_Start();

  // 5.3 Check BLTN_CAM_RecSta_TML = 0x1 (ON) within 10 seconds
  write("[5.3] Checking BLTN_CAM_RecSta_TML = 0x1 (ON)...");
  result = WaitFor_RecSta_TML_ON(max_wait_time_10s);

  if(result == 1)
  {
    step5_on_passed = 1;
    write(">>> Step 5: TML ON confirmed - PASS <<<");
  }
  else
  {
    step5_on_passed = 0;
    write(">>> Step 5: TML ON NOT detected - FAIL <<<");
  }

  // 5.4 Capture screenshot showing TML ON
  write("[5.4] Capturing screenshot (TML ON)...");
  CaptureGraphics("BLTN_CAM_RecSta_TML;BLTN_CAM_HU_UI_Mode;SMK_TrmnlCtrlGrpStaBDC", "OWD_027_step5_TML_ON.jpg");

  // 5.5 Wait 20 minutes for TML auto-stop
  write("[5.5] Waiting 20 minutes (%d ms) for TML auto-stop...", tml_auto_stop_20min);
  write("  Start waiting at current time. TML should auto-stop after 20 minutes.");

  result = WaitFor_RecSta_TML_OFF(tml_auto_stop_20min + 60000);  // 20 min + 1 min buffer

  if(result == 1)
  {
    step5_off_passed = 1;
    write(">>> Step 5: TML auto-stop confirmed - BLTN_CAM_RecSta_TML = 0x0 (OFF) <<<");
  }
  else
  {
    step5_off_passed = 0;
    write(">>> Step 5: TML auto-stop NOT detected after 20 min - FAIL <<<");
  }

  // 5.6 Capture screenshot after 20 min
  write("[5.6] Capturing screenshot (after 20 min wait)...");
  CaptureGraphics("BLTN_CAM_RecSta_TML;BLTN_CAM_HU_UI_Mode;SMK_TrmnlCtrlGrpStaBDC", "OWD_027_step5_TML_OFF_20min.jpg");

  if(step5_on_passed == 1 && step5_off_passed == 1)
  {
    testStepPass("Step5", "TML ON after Start + TML auto-stop OFF after 20 min - PASS");
  }
  else
  {
    testStepFail("Step5", "Step 5 verification failed - TML ON or auto-stop check failed");
  }

  //============================================================================
  // STEP 6: Log - LED Check (Manual)
  //============================================================================
  write("");
  write("=================================================================");
  write("=== STEP 6: LED Check (Manual)                               ===");
  write("=================================================================");
  testStep("Step6", "LED check - manual verification");

  write("");
  write("*************************************************************");
  write("*** STEP 6: LOG INFORMATION ***");
  write("*** Please check LED status on the device ***");
  write("*** Include LED photo in the test report ***");
  write("*************************************************************");
  write("");

  testStepPass("Step6", "LED check logged - Manual verification required");

  //============================================================================
  // STEP 7: Log - LED and Video Check (Manual)
  //============================================================================
  write("");
  write("=================================================================");
  write("=== STEP 7: LED and Video Check (Manual)                     ===");
  write("=================================================================");
  testStep("Step7", "LED and video check - manual verification");

  write("");
  write("*************************************************************");
  write("*** STEP 7: LOG INFORMATION ***");
  write("*** Please check LED status and recorded video ***");
  write("*** Verify video content matches expected behavior ***");
  write("*** Include LED photo and video info in test report ***");
  write("*************************************************************");
  write("");

  testStepPass("Step7", "LED and video check logged - Manual verification required");

  //============================================================================
  // STEP 8: Log - LED and Video Check (Manual)
  //============================================================================
  write("");
  write("=================================================================");
  write("=== STEP 8: LED and Video Check (Manual)                     ===");
  write("=================================================================");
  testStep("Step8", "LED and video check - manual verification");

  write("");
  write("*************************************************************");
  write("*** STEP 8: LOG INFORMATION ***");
  write("*** Please check LED status and recorded video ***");
  write("*** Verify video content matches expected behavior ***");
  write("*** Include LED photo and video info in test report ***");
  write("*************************************************************");
  write("");

  testStepPass("Step8", "LED and video check logged - Manual verification required");

  //============================================================================
  // STEP 9: Log - LED and Video Check (Manual)
  //============================================================================
  write("");
  write("=================================================================");
  write("=== STEP 9: LED and Video Check (Manual)                     ===");
  write("=================================================================");
  testStep("Step9", "LED and video check - manual verification");

  write("");
  write("*************************************************************");
  write("*** STEP 9: LOG INFORMATION ***");
  write("*** Please check LED status and recorded video ***");
  write("*** Verify video content matches expected behavior ***");
  write("*** Include LED photo and video info in test report ***");
  write("*************************************************************");
  write("");

  testStepPass("Step9", "LED and video check logged - Manual verification required");

  //============================================================================
  // Overall Test Verdict
  //============================================================================
  if(step1_tml_passed == 1 && step1_mar_passed == 1 && step2_passed == 1 && step5_on_passed == 1 && step5_off_passed == 1)
  {
    testStepPass("Overall_Verdict", "Test OWD_027: PASS");
    write("=== OVERALL VERDICT: PASS ===");
  }
  else
  {
    testStepFail("Overall_Verdict", "Test OWD_027: FAIL");
    write("=== OVERALL VERDICT: FAIL ===");
  }

  //============================================================================
  // TEST COMPLETE - Cleanup
  //============================================================================
  write("");
  write("========================================");
  write("=== TEST OWD_027 COMPLETE ===");
  write("========================================");

  // Cleanup: Exit BLTN_CAM if needed, KEY OFF
  Exit_BLTN_CAM();
  testWaitForTimeout(2000);
  setSignal(SMK_TrmnlCtrlGrpStaBDC, 0x0);  // KEY OFF
  testWaitForTimeout(2000);
  @panel::Switch_CGWNM = 0;

  // Final status
  write("");
  write("=== FINAL STATUS ===");
  write("  SMK_TrmnlCtrlGrpStaBDC = 0x%X", $SMK_TrmnlCtrlGrpStaBDC);
  write("  BLTN_CAM_RecSta_TML = 0x%X", $BLTN_CAM_RecSta_TML);
  write("  BLTN_CAM_RecSta_MAR = 0x%X", $BLTN_CAM_RecSta_MAR);
  write("  BLTN_CAM_HU_UI_Mode = 0x%X", $BLTN_CAM_HU_UI_Mode);

  write("");
  write("=== TEST SUMMARY ===");

  if(step1_tml_passed == 1)
    write("Step 1 (TML): BLTN_CAM_RecSta_TML = 0x0 (OFF) after Evt Switch [Screenshot] - PASS");
  else
    write("Step 1 (TML): BLTN_CAM_RecSta_TML = 0x0 (OFF) after Evt Switch [Screenshot] - FAIL");

  if(step1_mar_passed == 1)
    write("Step 1 (MAR): BLTN_CAM_RecSta_MAR = 0x1 (Recording, 10s) after Evt Switch [Screenshot] - PASS");
  else
    write("Step 1 (MAR): BLTN_CAM_RecSta_MAR = 0x1 (Recording, 10s) after Evt Switch [Screenshot] - FAIL");

  if(step2_passed == 1)
    write("Step 2: TML Start in BLTN_CAM -> TML = 0x0 (OFF) [Screenshot] - PASS");
  else
    write("Step 2: TML Start in BLTN_CAM -> TML = 0x0 (OFF) [Screenshot] - FAIL");

  write("Step 3-4: LED photo capture [Manual - Check LED] - PASS");

  if(step5_on_passed == 1)
    write("Step 5 (TML ON): TML Start in AVN -> TML = 0x1 (ON) [Screenshot] - PASS");
  else
    write("Step 5 (TML ON): TML Start in AVN -> TML = 0x1 (ON) [Screenshot] - FAIL");

  if(step5_off_passed == 1)
    write("Step 5 (TML OFF): After 20 min -> TML = 0x0 (OFF) auto-stop [Screenshot] - PASS");
  else
    write("Step 5 (TML OFF): After 20 min -> TML = 0x0 (OFF) auto-stop [Screenshot] - FAIL");

  write("Step 6: LED check [Manual] - PASS");
  write("Step 7: LED and video check [Manual] - PASS");
  write("Step 8: LED and video check [Manual] - PASS");
  write("Step 9: LED and video check [Manual] - PASS");
}

void MainTest()
{
  testReportFileName("TestReports\\OWD_027 - 2.5 generation_report");

  write("Run Turn_OFF_RecSet()"); Turn_OFF_RecSet();

  write("Run Rec_Reset()"); Rec_Reset();

  OWD_027();
}
