/*@!Encoding:65001*/

/*
  Test Case: OWD_028
  Title: [TML + MAR + DEV Combined Recording Test with OWD ON/OFF]
  Verification items:
    - Step 1:  SMK IGN + USM Reset + Rec Reset + AVN + TML Start -> RecSta_TML = 0x1 (ON), wait 5s, Screenshot
    - Step 2:  Evt Switch -> RecSta_MAR = 0x1 (Recording), wait 12s, Screenshot
    - Step 3:  Evt Switch -> RecSta_MAR = 0x1 (Recording), wait 10s, Screenshot
    - Step 4:  Manual event trigger -> RecSta_DEV = 0x1 (ON) within 10s, wait 10s, Screenshot
    - Step 5:  Manual event trigger -> RecSta_DEV = 0x1 (ON) within 10s, wait 10s, Screenshot
    - Step 6:  TML Stop + BLTN_CAM + OWD OFF + AVN + TML Start + Manual driving event
               -> RecSta_DEV = 0x1 within 20s -> immediately TML Stop, Screenshot
    - Step 7:  TML Stop + BLTN_CAM + OWD OFF + AVN + TML Start + Evt Switch
               -> RecSta_MAR = 0x1 -> immediately TML Stop, wait 10s, Screenshot
    - Step 8:  Enter BLTN_CAM + OWD ON + AVN -> check AIN > 4 within 10s, Screenshot
    - Step 9:  TML Start -> RecSta_TML = 0x1 (ON), Screenshot
    - Step 10: Manual event trigger -> RecSta_DEV = 0x1 within 20s, wait 10s, Screenshot
    - Step 11: Manual event trigger -> RecSta_DEV = 0x1 within 20s
               -> immediately Evt Switch, wait 10s, TML Stop, Screenshot

  Preconditions:
    - ACC and IGN and ccNC/ccIC switch OFF, AVN mode

  NOTE: Uses 2-5s delay for signal propagation after each state transition.
*/

variables
{
  long max_wait_time_10s = 10000;   // 10 seconds timeout
  long max_wait_time_20s = 20000;   // 20 seconds timeout

  // Message declarations for CAN FD
  message HU_BLTN_CAM_02_200ms _HU_BLTN_CAM_02_200ms;
  message HU_BLTN_CAM_01_00ms _HU_BLTN_CAM_01_00ms;
  message HU_CLOCK_01_1000ms _HU_CLOCK_01_1000ms;

  // Result tracking variables
  int step1_passed = 0;
  int step2_passed = 0;
  int step3_passed = 0;
  int step4_passed = 0;
  int step5_passed = 0;
  int step6_passed = 0;
  int step7_passed = 0;
  int step8_passed = 0;
  int step9_passed = 0;
  int step10_passed = 0;
  int step11_passed = 0;

  // Error counter for Turn_OFF_RecSet
  int flag_RecSet_error = 0;
}

// ============================================================================
// Panel Control Helper Functions
// ============================================================================

// Set SMK to IGN (0x2) via panel combo box
void Set_SMK_IGN()
{
  write("=== Setting SMK_Signal to IGN via panel ===");
  @panel::Switch_CGWNM = 1;
  testWaitForTimeout(2000);
  setSignal(SMK_TrmnlCtrlGrpStaBDC, 0x2);  // IGN
  testWaitForTimeout(2000);
  write("  SMK_TrmnlCtrlGrpStaBDC = 0x%X (IGN)", $SMK_TrmnlCtrlGrpStaBDC);
}

// Click USM Reset button on panel
void Click_USM_Reset()
{
  write("=== Clicking USM Reset button on panel ===");
  @panel::Button_USMReset = 1;
  testWaitForTimeout(2000);
  write("  USM Reset clicked");
}

// Click Rec Reset button on panel
void Click_Rec_Reset()
{
  write("=== Clicking Rec Reset button on panel ===");
  @panel::Button_RecReset = 1;
  testWaitForTimeout(2000);
  write("  Rec Reset clicked");
}

// Click Evt Switch button on panel (toggle off then on)
void Click_Evt_Switch()
{
  write("=== Clicking Event Switch button ===");
  @panel::Button_SwitchEvt = 1;
  //testWaitForTimeout(3000);
  testWaitForTimeout(2000);
  write("  Evt Switch clicked");
}

// Click TML Start button on panel Recording_Setting
void Click_TML_Start()
{
  write("=== Clicking TML Start button on panel ===");
  @panel::Button_Timelaps_Start = 0;
  testWaitForTimeout(500);
  @panel::Button_Timelaps_Start = 1;
  testWaitForTimeout(2000);
  write("  TML Start clicked");
}

// Click TML Stop button on panel Recording_Setting
void Click_TML_Stop()
{
  write("=== Clicking TML Stop button on panel ===");
  @panel::Button_Timelaps_Stop = 0;
  testWaitForTimeout(500);
  @panel::Button_Timelaps_Stop = 1;
  testWaitForTimeout(2000);
  write("  TML Stop clicked");
}

// Click OWD toggle on panel (LED_Ctrl_SetOWD)
void Click_OWD_Toggle()
{
  write("=== Clicking OWD toggle on panel (LED_Ctrl_SetOWD) ===");
  @panel::LED_Ctrl_SetOWD = 1;
  testWaitForTimeout(2000);
  write("  OWD toggle clicked, BLTN_CAM_RecSet_OWD = 0x%X", $BLTN_CAM_RecSet_OWD);
}

// Enter Built-in Cam mode (HU_BLTN_CAM_UI_Mode = 0x1)
void Enter_BLTN_CAM()
{
  write(">>> Enter BLTN_CAM mode <<<");
  _HU_BLTN_CAM_02_200ms.HU_BLTN_CAM_UI_Mode = 0x1;
  output(_HU_BLTN_CAM_02_200ms);
  testWaitForTimeout(3000);
}

// Exit to AVN HU UI mode (HU_BLTN_CAM_UI_Mode = 0x0)
void Exit_BLTN_CAM()
{
  write(">>> Exit BLTN_CAM mode - Return to AVN <<<");
  _HU_BLTN_CAM_02_200ms.HU_BLTN_CAM_UI_Mode = 0x0;
  output(_HU_BLTN_CAM_02_200ms);
  testWaitForTimeout(3000);
}

// ============================================================================
// Check Functions
// ============================================================================

// Wait for BLTN_CAM_RecSta_TML = 0x1 (ON) with timeout
int WaitFor_RecSta_TML_ON(long timeout_ms)
{
  long elapsed = 0;
  long check_interval = 1000;
  byte rec_sta_tml = 0;
  long log_interval;

  write("=== Waiting for TML Recording ON (max %d seconds) ===", timeout_ms / 1000);
  log_interval = (timeout_ms / 6 / check_interval) * check_interval;
  if(log_interval < check_interval) log_interval = check_interval;

  while(elapsed < timeout_ms)
  {
    rec_sta_tml = $BLTN_CAM_RecSta_TML;
    if(elapsed == 0 || elapsed % log_interval == 0)
    {
      write("  [%d s / %d s] BLTN_CAM_RecSta_TML = 0x%X",
            elapsed / 1000, timeout_ms / 1000, rec_sta_tml);
    }

    if(rec_sta_tml == 0x1)
    {
      write(">>> DETECTED: TML Recording ON after %d seconds <<<", elapsed / 1000);
      write(">>> PASS: BLTN_CAM_RecSta_TML = 0x1 (ON) <<<");
      return 1;
    }

    testWaitForTimeout(check_interval);
    elapsed += check_interval;
  }

  write(">>> TIMEOUT: TML Recording NOT ON after %d seconds <<<", timeout_ms / 1000);
  write(">>> FAIL: BLTN_CAM_RecSta_TML is still 0x%X <<<", rec_sta_tml);
  return 0;
}

// Wait for BLTN_CAM_RecSta_MAR = 0x1 (Recording) with timeout
int WaitFor_RecSta_MAR_Recording(long timeout_ms)
{
  long elapsed = 0;
  long check_interval = 1000;
  byte rec_sta_mar = 0;
  long log_interval;

  write("=== Waiting for MAR Recording (max %d seconds) ===", timeout_ms / 1000);
  log_interval = (timeout_ms / 6 / check_interval) * check_interval;
  if(log_interval < check_interval) log_interval = check_interval;

  while(elapsed < timeout_ms)
  {
    rec_sta_mar = $BLTN_CAM_RecSta_MAR;
    if(elapsed == 0 || elapsed % log_interval == 0)
    {
      write("  [%d s / %d s] BLTN_CAM_RecSta_MAR = 0x%X",
            elapsed / 1000, timeout_ms / 1000, rec_sta_mar);
    }

    if(rec_sta_mar == 0x1)
    {
      write(">>> DETECTED: MAR Recording started after %d seconds <<<", elapsed / 1000);
      write(">>> PASS: BLTN_CAM_RecSta_MAR = 0x1 (Recording) <<<");
      return 1;
    }

    testWaitForTimeout(check_interval);
    elapsed += check_interval;
  }

  write(">>> TIMEOUT: MAR Recording NOT detected after %d seconds <<<", timeout_ms / 1000);
  write(">>> FAIL: BLTN_CAM_RecSta_MAR is still 0x%X <<<", rec_sta_mar);
  return 0;
}

// Wait for BLTN_CAM_RecSta_DEV = 0x1 (ON) with timeout
int WaitFor_RecSta_DEV_ON(long timeout_ms)
{
  long elapsed = 0;
  long check_interval = 1000;
  byte rec_sta_dev = 0;
  long log_interval;

  write("=== Waiting for DEV Recording ON (max %d seconds) ===", timeout_ms / 1000);
  log_interval = (timeout_ms / 6 / check_interval) * check_interval;
  if(log_interval < check_interval) log_interval = check_interval;

  while(elapsed < timeout_ms)
  {
    rec_sta_dev = $BLTN_CAM_RecSta_DEV;
    if(elapsed == 0 || elapsed % log_interval == 0)
    {
      write("  [%d s / %d s] BLTN_CAM_RecSta_DEV = 0x%X",
            elapsed / 1000, timeout_ms / 1000, rec_sta_dev);
    }

    if(rec_sta_dev == 0x1)
    {
      write(">>> DETECTED: DEV Recording ON after %d seconds <<<", elapsed / 1000);
      write(">>> PASS: BLTN_CAM_RecSta_DEV = 0x1 (ON) <<<");
      return 1;
    }

    testWaitForTimeout(check_interval);
    elapsed += check_interval;
  }

  write(">>> TIMEOUT: DEV Recording NOT ON after %d seconds <<<", timeout_ms / 1000);
  write(">>> FAIL: BLTN_CAM_RecSta_DEV is still 0x%X <<<", rec_sta_dev);
  return 0;
}

// Check BLTN_CAM_RecSet_OWD = 0x1 (OFF)
int Check_RecSet_OWD_OFF()
{
  byte rec_set_owd = 0;
  rec_set_owd = $BLTN_CAM_RecSet_OWD;
  write("  BLTN_CAM_RecSet_OWD = 0x%X", rec_set_owd);

  if(rec_set_owd == 0x1)
  {
    write(">>> PASS: BLTN_CAM_RecSet_OWD = 0x1 (OFF) <<<");
    return 1;
  }
  else
  {
    write(">>> FAIL: BLTN_CAM_RecSet_OWD is NOT OFF (value = 0x%X) <<<", rec_set_owd);
    return 0;
  }
}

// Check BLTN_CAM_RecSet_OWD = 0x2 (ON)
int Check_RecSet_OWD_ON()
{
  byte rec_set_owd = 0;
  rec_set_owd = $BLTN_CAM_RecSet_OWD;
  write("  BLTN_CAM_RecSet_OWD = 0x%X", rec_set_owd);

  if(rec_set_owd == 0x2)
  {
    write(">>> PASS: BLTN_CAM_RecSet_OWD = 0x2 (ON) <<<");
    return 1;
  }
  else
  {
    write(">>> FAIL: BLTN_CAM_RecSet_OWD is NOT ON (value = 0x%X) <<<", rec_set_owd);
    return 0;
  }
}

// Read AIN voltage from CANoe VN1600 hardware
float Get_AIN_Voltage()
{
  float ain_value = 0.0;
  
  // Read from VN1600_1 AIN channel
  ain_value = @sysvar::IO::VN1600_1::AIN;
  
  write("  AIN Voltage: %.2f V", ain_value);
  return ain_value;
}

// Check AIN > 4 within timeout
int WaitFor_AIN_Greater_Than_4(long timeout_ms)
{
  long elapsed = 0;
  long check_interval = 1000;
  float ain_value = 0.0;
  long log_interval;

  write("=== Waiting for AIN > 4 (max %d seconds) ===", timeout_ms / 1000);
  log_interval = (timeout_ms / 6 / check_interval) * check_interval;
  if(log_interval < check_interval) log_interval = check_interval;

  while(elapsed < timeout_ms)
  {
    ain_value = Get_AIN_Voltage();
    if(elapsed == 0 || elapsed % log_interval == 0)
    {
      write("  [%d s / %d s] AIN = %.2f",
            elapsed / 1000, timeout_ms / 1000, ain_value);
    }

    if(ain_value > 4.0)
    {
      write(">>> DETECTED: AIN = %.2f (> 4) after %d seconds <<<", ain_value, elapsed / 1000);
      return 1;
    }

    testWaitForTimeout(check_interval);
    elapsed += check_interval;
  }

  write(">>> TIMEOUT: AIN NOT > 4 after %d seconds (last value = %.2f) <<<", timeout_ms / 1000, ain_value);
  return 0;
}

// ============================================================================
// Turn OFF All Recording Settings
// ============================================================================
void Turn_OFF_RecSet()
{
  if (getSignal(BLTN_CAM_RecSet_OWD) == 0x2 || getSignal(BLTN_CAM_RecSet_OWP) == 0x2 || getSignal(BLTN_CAM_RecSet_DEV) == 0x2 || getSignal(BLTN_CAM_RecSet_PEV) == 0x2)
  {
    @panel::Switch_CGWNM = 1;

    setSignal(SMK_TrmnlCtrlGrpStaBDC, 0x2);
    testWaitForTimeout(3000);

    do {
      Enter_BLTN_CAM();
      testWaitForTimeout(3000);

      if (getSignal(BLTN_CAM_RecSet_OWD) == 0x2){
        write("OWD Off"); @panel::LED_Ctrl_SetOWD = 1; testWaitForTimeout(1000);
      }
      else if (getSignal(BLTN_CAM_RecSet_OWP) == 0x2){
        write("OWP Off"); @panel::LED_Ctrl_SetOWP = 1; testWaitForTimeout(1000);
      }
      else if (getSignal(BLTN_CAM_RecSet_DEV) == 0x2){
        write("DEV Off"); @panel::LED_Ctrl_SetDEV = 1; testWaitForTimeout(1000);
      }
      else if (getSignal(BLTN_CAM_RecSet_PEV) == 0x2){
        write("PEV Off"); @panel::LED_Ctrl_SetPEV = 1; testWaitForTimeout(1000);
      }

      Exit_BLTN_CAM();

      flag_RecSet_error++;

    } while((getSignal(BLTN_CAM_RecSet_OWD) == 0x2 || getSignal(BLTN_CAM_RecSet_OWP) == 0x2 || getSignal(BLTN_CAM_RecSet_DEV) == 0x2 || getSignal(BLTN_CAM_RecSet_PEV) == 0x2) && (flag_RecSet_error <= 15));

    flag_RecSet_error = 0;

    testWaitForTimeout(3000);
    setSignal(SMK_TrmnlCtrlGrpStaBDC, 0x0);
  }
  else
  {
    write("Notifications: All recording settings are turned OFF.");
  }
}

// ============================================================================
// Rec Reset Function
// ============================================================================
void Rec_Reset()
{
  @panel::Switch_CGWNM = 1;

  setSignal(SMK_TrmnlCtrlGrpStaBDC, 0x2);
  testWaitForTimeout(2000);

  while (getSignal(BLTN_CAM_SD_Format_Op_State) != 0x1)
  {
    @panel::Button_RecReset = 1;
    testWaitForSignalChange(BLTN_CAM_SD_Format_Op_State, 500);
  }

  setSignal(SMK_TrmnlCtrlGrpStaBDC, 0x0);
  testWaitForTimeout(2000);

  @panel::Switch_CGWNM = 0;
}

// ============================================================================
// Capture Screenshot Functions
// ============================================================================

// Capture screenshot with specified signal list
void CaptureGraphics(char signalList[], char filename[])
{
  char filepath[512];
  snprintf(filepath, elcount(filepath), "D:\\project\\CAN FD\\[CANoe] CANFD\\Screenshots\\%s", filename);
  write(">>> Capturing screenshot: %s <<<", filepath);
  testWaitForTimeout(3000);
  testReportAddWindowCapture("Graphics 2", signalList, "Screenshot", filepath);
  write(">>> Screenshot captured <<<");
}

// ============================================================================
// Helper: Turn OFF OWD only (Enter BLTN_CAM, toggle OWD off, return to AVN)
// Returns 1 if BLTN_CAM_RecSet_OWD = 0x1 (OFF) confirmed
// ============================================================================
int Turn_OFF_OWD_Only()
{
  int result = 0;

  write("=== Entering BLTN_CAM to turn OFF OWD ===");
  Enter_BLTN_CAM();
  testWaitForTimeout(2000);

  // If OWD is currently ON (0x2), click to toggle OFF
  if($BLTN_CAM_RecSet_OWD == 0x2)
  {
    write("  OWD is ON (0x2), clicking to turn OFF...");
    Click_OWD_Toggle();
    testWaitForTimeout(2000);
  }
  else if($BLTN_CAM_RecSet_OWD == 0x1)
  {
    write("  OWD is already OFF (0x1), no action needed.");
  }
  else
  {
    write("  OWD is in unknown state (0x%X), attempting toggle...", $BLTN_CAM_RecSet_OWD);
    Click_OWD_Toggle();
    testWaitForTimeout(2000);
  }

  // Check BLTN_CAM_RecSet_OWD = 0x1 (OFF)
  result = Check_RecSet_OWD_OFF();

  // Return to AVN mode
  write("=== Returning to AVN mode ===");
  Exit_BLTN_CAM();
  testWaitForTimeout(2000);

  return result;
}

// ============================================================================
// Helper: Turn ON OWD only (Enter BLTN_CAM, toggle OWD on, return to AVN)
// Returns 1 if BLTN_CAM_RecSet_OWD = 0x2 (ON) confirmed
// ============================================================================
int Turn_ON_OWD_Only()
{
  int result = 0;

  write("=== Entering BLTN_CAM to turn ON OWD ===");
  Enter_BLTN_CAM();
  testWaitForTimeout(2000);

  // If OWD is currently OFF (0x1), click to toggle ON
  if($BLTN_CAM_RecSet_OWD == 0x1)
  {
    write("  OWD is OFF (0x1), clicking to turn ON...");
    Click_OWD_Toggle();
    testWaitForTimeout(2000);
  }
  else if($BLTN_CAM_RecSet_OWD == 0x2)
  {
    write("  OWD is already ON (0x2), no action needed.");
  }
  else
  {
    write("  OWD is in unknown state (0x%X), attempting toggle...", $BLTN_CAM_RecSet_OWD);
    Click_OWD_Toggle();
    testWaitForTimeout(2000);
  }

  // Check BLTN_CAM_RecSet_OWD = 0x2 (ON)
  result = Check_RecSet_OWD_ON();

  // Return to AVN mode
  write("=== Returning to AVN mode ===");
  Exit_BLTN_CAM();
  testWaitForTimeout(2000);

  return result;
}

// ============================================================================
// Main Test Case
// ============================================================================

testcase OWD_028()
{
  int result = 0;

  write("========================================");
  write("=== START TEST OWD_028 ===");
  write("=== TML + MAR + DEV Combined Test   ===");
  write("=== with OWD ON/OFF                 ===");
  write("========================================");

  //============================================================================
  // STEP 1: Set SMK IGN, USM Reset, Rec Reset, AVN mode,
  //         Click TML Start, Check BLTN_CAM_RecSta_TML = 0x1 (ON)
  //         Wait 5s, Screenshot (include AIN)
  //============================================================================
  write("");
  write("=================================================================");
  write("=== STEP 1: SMK IGN + USM Reset + Rec Reset + AVN mode      ===");
  write("===         TML Start + Check RecSta_TML = 0x1 (ON)         ===");
  write("===         Wait 5s + Screenshot (AIN)                      ===");
  write("=================================================================");
  testStep("Step1", "SMK IGN + USM Reset + Rec Reset + AVN + TML Start + TML ON");

  // 1.1 Set SMK to IGN via panel combo box
  write("[1.1] Setting SMK_Signal to IGN via panel...");
  Set_SMK_IGN();
  testWaitForTimeout(3000);

  // 1.2 Click USM Reset button
  write("[1.2] Clicking USM Reset button...");
  Click_USM_Reset();
  testWaitForTimeout(2000);

  // 1.3 Click Rec Reset button
  write("[1.3] Clicking Rec Reset button...");
  Click_Rec_Reset();
  testWaitForTimeout(2000);

  // 1.4 Ensure AVN mode
  write("[1.4] Ensuring AVN mode...");
  Exit_BLTN_CAM();
  testWaitForTimeout(2000);
  write("  HU_BLTN_CAM_UI_Mode = 0x%X (AVN mode)", $BLTN_CAM_HU_UI_Mode);

  // 1.5 Click TML Start
  write("[1.5] Clicking TML Start on panel...");
  Click_TML_Start();

  // 1.6 Check BLTN_CAM_RecSta_TML = 0x1 (ON)
  write("[1.6] Checking BLTN_CAM_RecSta_TML = 0x1 (ON)...");
  result = WaitFor_RecSta_TML_ON(max_wait_time_10s);

  // 1.7 Wait 5 seconds
  write("[1.7] Waiting 5 seconds...");
  testWaitForTimeout(5000);

  // 1.8 Capture screenshot
  write("[1.8] Capturing screenshot...");
  CaptureGraphics("BLTN_CAM_RecSta_TML;AIN;BLTN_CAM_HU_UI_Mode;SMK_TrmnlCtrlGrpStaBDC", "OWD_028_step1.jpg");

  if(result == 1)
  {
    step1_passed = 1;
    testStepPass("Step1", "BLTN_CAM_RecSta_TML = 0x1 (ON) after TML Start - PASS");
  }
  else
  {
    step1_passed = 0;
    testStepFail("Step1", "BLTN_CAM_RecSta_TML did NOT turn ON after TML Start - FAIL");
  }

  //============================================================================
  // STEP 2: Click Evt Switch
  //         Check BLTN_CAM_RecSta_MAR = 0x1 (Recording)
  //         Wait 12s, Screenshot (include AIN)
  //============================================================================
  write("");
  write("=================================================================");
  write("=== STEP 2: Evt Switch + Check RecSta_MAR = 0x1 (Recording) ===");
  write("===         Wait 12s + Screenshot (AIN)                     ===");
  write("=================================================================");
  testStep("Step2", "Evt Switch + MAR Recording + Wait 12s");

  // 2.1 Click Evt Switch button
  write("[2.1] Clicking Evt Switch button...");
  Click_Evt_Switch();

  // 2.2 Check BLTN_CAM_RecSta_MAR = 0x1 (Recording)
  write("[2.2] Checking BLTN_CAM_RecSta_MAR = 0x1 (Recording)...");
  result = WaitFor_RecSta_MAR_Recording(max_wait_time_10s);

  // 2.3 Wait 12 seconds
  write("[2.3] Waiting 12 seconds...");
  testWaitForTimeout(12000);

  // 2.4 Capture screenshot
  write("[2.4] Capturing screenshot...");
  CaptureGraphics("BLTN_CAM_RecSta_MAR;BLTN_CAM_RecSta_TML;AIN;BLTN_CAM_HU_UI_Mode", "OWD_028_step2.jpg");

  if(result == 1)
  {
    step2_passed = 1;
    testStepPass("Step2", "BLTN_CAM_RecSta_MAR = 0x1 (Recording) after Evt Switch - PASS");
  }
  else
  {
    step2_passed = 0;
    testStepFail("Step2", "BLTN_CAM_RecSta_MAR Recording NOT detected after Evt Switch - FAIL");
  }

  //============================================================================
  // STEP 3: Click Evt Switch
  //         Check BLTN_CAM_RecSta_MAR = 0x1 (Recording)
  //         Wait 10s, Screenshot (include AIN)
  //============================================================================
  write("");
  write("=================================================================");
  write("=== STEP 3: Evt Switch + Check RecSta_MAR = 0x1 (Recording) ===");
  write("===         Wait 10s + Screenshot (AIN)                     ===");
  write("=================================================================");
  testStep("Step3", "Evt Switch + MAR Recording + Wait 10s");

  // 3.1 Click Evt Switch button
  write("[3.1] Clicking Evt Switch button...");
  Click_Evt_Switch();

  // 3.2 Check BLTN_CAM_RecSta_MAR = 0x1 (Recording)
  write("[3.2] Checking BLTN_CAM_RecSta_MAR = 0x1 (Recording)...");
  result = WaitFor_RecSta_MAR_Recording(max_wait_time_10s);

  // 3.3 Wait 10 seconds
  write("[3.3] Waiting 10 seconds...");
  testWaitForTimeout(10000);

  // 3.4 Capture screenshot
  write("[3.4] Capturing screenshot...");
  CaptureGraphics("BLTN_CAM_RecSta_MAR;BLTN_CAM_RecSta_TML;AIN;BLTN_CAM_HU_UI_Mode", "OWD_028_step3.jpg");

  if(result == 1)
  {
    step3_passed = 1;
    testStepPass("Step3", "BLTN_CAM_RecSta_MAR = 0x1 (Recording) after 2nd Evt Switch - PASS");
  }
  else
  {
    step3_passed = 0;
    testStepFail("Step3", "BLTN_CAM_RecSta_MAR Recording NOT detected after 2nd Evt Switch - FAIL");
  }

  //============================================================================
  // STEP 4: Log - Ask user to trigger event
  //         Check BLTN_CAM_RecSta_DEV = 0x1 (ON) within 10s
  //         Wait 10s, Screenshot (include AIN)
  //============================================================================
  write("");
  write("=================================================================");
  write("=== STEP 4: Manual Event Trigger                            ===");
  write("===         Check RecSta_DEV = 0x1 (ON) within 10s          ===");
  write("===         Wait 10s + Screenshot (AIN)                     ===");
  write("=================================================================");
  testStep("Step4", "Manual event trigger + DEV ON + Wait 10s");

  write("");
  write("*************************************************************");
  write("*** STEP 4: PLEASE TRIGGER AN EVENT NOW! ***");
  write("*** (e.g. apply impact/shock to the camera) ***");
  write("*** Waiting up to 10 seconds for DEV recording to start ***");
  write("*************************************************************");
  write("");

  // 4.1 Check BLTN_CAM_RecSta_DEV = 0x1 (ON) within 10s
  write("[4.1] Waiting for BLTN_CAM_RecSta_DEV = 0x1 (ON) within 10 seconds...");
  result = WaitFor_RecSta_DEV_ON(max_wait_time_10s);

  // 4.2 Wait 10 seconds
  write("[4.2] Waiting 10 seconds...");
  testWaitForTimeout(10000);

  // 4.3 Capture screenshot
  write("[4.3] Capturing screenshot...");
  CaptureGraphics("BLTN_CAM_RecSta_DEV;BLTN_CAM_RecSta_TML;AIN;BLTN_CAM_HU_UI_Mode", "OWD_028_step4.jpg");

  if(result == 1)
  {
    step4_passed = 1;
    testStepPass("Step4", "BLTN_CAM_RecSta_DEV = 0x1 (ON) after manual event trigger - PASS");
  }
  else
  {
    step4_passed = 0;
    testStepFail("Step4", "BLTN_CAM_RecSta_DEV did NOT turn ON within 10s - FAIL");
  }

  //============================================================================
  // STEP 5: Log - Ask user to trigger event
  //         Check BLTN_CAM_RecSta_DEV = 0x1 (ON) within 10s
  //         Wait 10s, Screenshot (include AIN)
  //============================================================================
  write("");
  write("=================================================================");
  write("=== STEP 5: Manual Event Trigger (2nd time)                 ===");
  write("===         Check RecSta_DEV = 0x1 (ON) within 10s          ===");
  write("===         Wait 10s + Screenshot (AIN)                     ===");
  write("=================================================================");
  testStep("Step5", "Manual event trigger 2 + DEV ON + Wait 10s");

  write("");
  write("*************************************************************");
  write("*** STEP 5: PLEASE TRIGGER AN EVENT NOW! ***");
  write("*** (e.g. apply impact/shock to the camera) ***");
  write("*** Waiting up to 10 seconds for DEV recording to start ***");
  write("*************************************************************");
  write("");

  // 5.1 Check BLTN_CAM_RecSta_DEV = 0x1 (ON) within 10s
  write("[5.1] Waiting for BLTN_CAM_RecSta_DEV = 0x1 (ON) within 10 seconds...");
  result = WaitFor_RecSta_DEV_ON(max_wait_time_10s);

  // 5.2 Wait 10 seconds
  write("[5.2] Waiting 10 seconds...");
  testWaitForTimeout(10000);

  // 5.3 Capture screenshot
  write("[5.3] Capturing screenshot...");
  CaptureGraphics("BLTN_CAM_RecSta_DEV;BLTN_CAM_RecSta_TML;AIN;BLTN_CAM_HU_UI_Mode", "OWD_028_step5.jpg");

  if(result == 1)
  {
    step5_passed = 1;
    testStepPass("Step5", "BLTN_CAM_RecSta_DEV = 0x1 (ON) after 2nd manual event trigger - PASS");
  }
  else
  {
    step5_passed = 0;
    testStepFail("Step5", "BLTN_CAM_RecSta_DEV did NOT turn ON within 10s (2nd attempt) - FAIL");
  }

  //============================================================================
  // STEP 6: TML Stop + Enter BLTN_CAM + Turn OFF OWD
  //         If RecSet_OWD = 0x1 (OFF) -> Return to AVN + TML Start
  //         Log - Ask user to trigger driving event
  //         If RecSta_DEV = 0x1 (ON) within 20s -> Immediately TML Stop
  //         Screenshot (include AIN)
  //============================================================================
  write("");
  write("=================================================================");
  write("=== STEP 6: TML Stop + BLTN_CAM + OWD OFF + AVN             ===");
  write("===         TML Start + Manual driving event trigger         ===");
  write("===         DEV ON within 20s -> Immediately TML Stop        ===");
  write("=================================================================");
  testStep("Step6", "TML Stop + OWD OFF + TML Start + Driving event + DEV ON + TML Stop");

  // 6.1 Click TML Stop
  write("[6.1] Clicking TML Stop...");
  Click_TML_Stop();
  testWaitForTimeout(2000);

  // 6.2 Enter BLTN_CAM and turn OFF OWD
  write("[6.2] Entering BLTN_CAM to turn OFF OWD...");
  result = Turn_OFF_OWD_Only();

  if(result == 1)
  {
    write("[6.2] OWD turned OFF confirmed (RecSet_OWD = 0x1)");
  }
  else
  {
    write("[6.2] WARNING: OWD OFF not confirmed, continuing anyway...");
  }

  // 6.3 Click TML Start (now in AVN mode after Turn_OFF_OWD_Only returned)
  write("[6.3] Clicking TML Start...");
  Click_TML_Start();
  testWaitForTimeout(2000);

  // 6.4 Log - Ask user to trigger driving event
  write("");
  write("*************************************************************");
  write("*** STEP 6: PLEASE TRIGGER A DRIVING EVENT NOW! ***");
  write("*** (e.g. drive the vehicle / apply impact to camera) ***");
  write("*** Waiting up to 20 seconds for DEV recording to start ***");
  write("*** When DEV = ON detected, TML will be stopped immediately ***");
  write("*************************************************************");
  write("");

  // 6.5 Wait for BLTN_CAM_RecSta_DEV = 0x1 (ON) within 20s
  write("[6.5] Waiting for BLTN_CAM_RecSta_DEV = 0x1 (ON) within 20 seconds...");
  result = WaitFor_RecSta_DEV_ON(max_wait_time_20s);

  if(result == 1)
  {
    // 6.6 Immediately click TML Stop
    write("[6.6] DEV ON detected! Immediately clicking TML Stop...");
    Click_TML_Stop();
  }
  else
  {
    write("[6.6] DEV Recording NOT detected within 20s. Clicking TML Stop anyway...");
    Click_TML_Stop();
  }

  // 6.7 Capture screenshot
  write("[6.7] Capturing screenshot...");
  CaptureGraphics("BLTN_CAM_RecSta_DEV;BLTN_CAM_RecSta_TML;BLTN_CAM_RecSet_OWD;AIN;BLTN_CAM_HU_UI_Mode", "OWD_028_step6.jpg");

  if(result == 1)
  {
    step6_passed = 1;
    testStepPass("Step6", "DEV ON detected -> TML Stop immediately - PASS");
  }
  else
  {
    step6_passed = 0;
    testStepFail("Step6", "DEV Recording NOT detected within 20s - FAIL");
  }

  //============================================================================
  // STEP 7: TML Stop + Enter BLTN_CAM + Turn OFF OWD
  //         If RecSet_OWD = 0x1 (OFF) -> Return to AVN + TML Start
  //         Click Evt Switch, if RecSta_MAR = 0x1 (Recording)
  //         -> Immediately TML Stop, Wait 10s, Screenshot (include AIN)
  //============================================================================
  write("");
  write("=================================================================");
  write("=== STEP 7: TML Stop + BLTN_CAM + OWD OFF + AVN             ===");
  write("===         TML Start + Evt Switch + MAR Recording           ===");
  write("===         -> Immediately TML Stop + Wait 10s + Screenshot  ===");
  write("=================================================================");
  testStep("Step7", "TML Stop + OWD OFF + TML Start + Evt Switch + MAR ON + TML Stop");

  // 7.1 Click TML Stop (safety - in case still running)
  write("[7.1] Clicking TML Stop...");
  Click_TML_Stop();
  testWaitForTimeout(2000);

  // 7.2 Enter BLTN_CAM and turn OFF OWD
  write("[7.2] Entering BLTN_CAM to turn OFF OWD...");
  result = Turn_OFF_OWD_Only();

  if(result == 1)
  {
    write("[7.2] OWD turned OFF confirmed (RecSet_OWD = 0x1)");
  }
  else
  {
    write("[7.2] WARNING: OWD OFF not confirmed, continuing anyway...");
  }

  // 7.3 Click TML Start (now in AVN mode)
  write("[7.3] Clicking TML Start...");
  Click_TML_Start();
  testWaitForTimeout(2000);

  // 7.4 Click Evt Switch
  write("[7.4] Clicking Evt Switch...");
  Click_Evt_Switch();

  // 7.5 Check BLTN_CAM_RecSta_MAR = 0x1 (Recording) within 10s
  write("[7.5] Waiting for BLTN_CAM_RecSta_MAR = 0x1 (Recording)...");
  result = WaitFor_RecSta_MAR_Recording(max_wait_time_10s);

  if(result == 1)
  {
    // 7.6 Immediately click TML Stop
    write("[7.6] MAR Recording detected! Immediately clicking TML Stop...");
    Click_TML_Stop();
  }
  else
  {
    write("[7.6] MAR Recording NOT detected. Clicking TML Stop anyway...");
    Click_TML_Stop();
  }

  // 7.7 Wait 10 seconds
  write("[7.7] Waiting 10 seconds...");
  testWaitForTimeout(10000);

  // 7.8 Capture screenshot
  write("[7.8] Capturing screenshot...");
  CaptureGraphics("BLTN_CAM_RecSta_MAR;BLTN_CAM_RecSta_TML;BLTN_CAM_RecSet_OWD;AIN;BLTN_CAM_HU_UI_Mode", "OWD_028_step7.jpg");

  if(result == 1)
  {
    step7_passed = 1;
    testStepPass("Step7", "MAR Recording detected -> TML Stop immediately - PASS");
  }
  else
  {
    step7_passed = 0;
    testStepFail("Step7", "MAR Recording NOT detected after Evt Switch - FAIL");
  }

  //============================================================================
  // STEP 8: Enter BLTN_CAM + Turn ON OWD
  //         If RecSet_OWD = 0x2 (ON) -> Return to AVN
  //         Within 10s check AIN > 4, Screenshot (include AIN)
  //============================================================================
  write("");
  write("=================================================================");
  write("=== STEP 8: Enter BLTN_CAM + OWD ON + AVN                   ===");
  write("===         Check AIN > 4 within 10s + Screenshot (AIN)     ===");
  write("=================================================================");
  testStep("Step8", "BLTN_CAM + OWD ON + AVN + Check AIN > 4");

  // 8.1 Enter BLTN_CAM and turn ON OWD
  write("[8.1] Entering BLTN_CAM to turn ON OWD...");
  result = Turn_ON_OWD_Only();

  if(result == 1)
  {
    write("[8.1] OWD turned ON confirmed (RecSet_OWD = 0x2)");
  }
  else
  {
    write("[8.1] WARNING: OWD ON not confirmed, continuing anyway...");
  }

  // 8.2 Wait and check AIN > 4 within 10s
  write("[8.2] Checking AIN > 4 within 10 seconds...");
  result = WaitFor_AIN_Greater_Than_4(max_wait_time_10s);

  // 8.3 Capture screenshot
  write("[8.3] Capturing screenshot...");
  CaptureGraphics("BLTN_CAM_RecSet_OWD;AIN;BLTN_CAM_HU_UI_Mode;SMK_TrmnlCtrlGrpStaBDC", "OWD_028_step8.jpg");

  if(result == 1)
  {
    step8_passed = 1;
    testStepPass("Step8", "AIN > 4 detected after OWD ON - PASS");
  }
  else
  {
    step8_passed = 0;
    testStepFail("Step8", "AIN NOT > 4 within 10s after OWD ON - FAIL");
  }

  //============================================================================
  // STEP 9: Click TML Start
  //         Check BLTN_CAM_RecSta_TML = 0x1 (ON)
  //         Screenshot (include AIN)
  //============================================================================
  write("");
  write("=================================================================");
  write("=== STEP 9: TML Start + Check RecSta_TML = 0x1 (ON)         ===");
  write("===         Screenshot (AIN)                                 ===");
  write("=================================================================");
  testStep("Step9", "TML Start + TML ON + Screenshot");

  // 9.1 Click TML Start
  write("[9.1] Clicking TML Start...");
  Click_TML_Start();

  // 9.2 Check BLTN_CAM_RecSta_TML = 0x1 (ON)
  write("[9.2] Checking BLTN_CAM_RecSta_TML = 0x1 (ON)...");
  result = WaitFor_RecSta_TML_ON(max_wait_time_10s);

  // 9.3 Capture screenshot
  write("[9.3] Capturing screenshot...");
  CaptureGraphics("BLTN_CAM_RecSta_TML;AIN;BLTN_CAM_HU_UI_Mode;SMK_TrmnlCtrlGrpStaBDC", "OWD_028_step9.jpg");

  if(result == 1)
  {
    step9_passed = 1;
    testStepPass("Step9", "BLTN_CAM_RecSta_TML = 0x1 (ON) after TML Start - PASS");
  }
  else
  {
    step9_passed = 0;
    testStepFail("Step9", "BLTN_CAM_RecSta_TML did NOT turn ON after TML Start - FAIL");
  }

  //============================================================================
  // STEP 10: Log - Ask user to trigger event
  //          Check BLTN_CAM_RecSta_DEV = 0x1 (ON) within 20s
  //          Wait 10s, Screenshot (include AIN)
  //============================================================================
  write("");
  write("=================================================================");
  write("=== STEP 10: Manual Event Trigger                           ===");
  write("===          Check RecSta_DEV = 0x1 (ON) within 20s         ===");
  write("===          Wait 10s + Screenshot (AIN)                    ===");
  write("=================================================================");
  testStep("Step10", "Manual event trigger + DEV ON within 20s + Wait 10s");

  write("");
  write("*************************************************************");
  write("*** STEP 10: PLEASE TRIGGER AN EVENT NOW! ***");
  write("*** (e.g. apply impact/shock to the camera) ***");
  write("*** Waiting up to 20 seconds for DEV recording to start ***");
  write("*************************************************************");
  write("");

  // 10.1 Check BLTN_CAM_RecSta_DEV = 0x1 (ON) within 20s
  write("[10.1] Waiting for BLTN_CAM_RecSta_DEV = 0x1 (ON) within 20 seconds...");
  result = WaitFor_RecSta_DEV_ON(max_wait_time_20s);

  // 10.2 Wait 10 seconds
  write("[10.2] Waiting 10 seconds...");
  testWaitForTimeout(10000);

  // 10.3 Capture screenshot
  write("[10.3] Capturing screenshot...");
  CaptureGraphics("BLTN_CAM_RecSta_DEV;BLTN_CAM_RecSta_TML;AIN;BLTN_CAM_HU_UI_Mode", "OWD_028_step10.jpg");

  if(result == 1)
  {
    step10_passed = 1;
    testStepPass("Step10", "BLTN_CAM_RecSta_DEV = 0x1 (ON) after manual event trigger - PASS");
  }
  else
  {
    step10_passed = 0;
    testStepFail("Step10", "BLTN_CAM_RecSta_DEV did NOT turn ON within 20s - FAIL");
  }

  //============================================================================
  // STEP 11: Log - Ask user to trigger event
  //          Check BLTN_CAM_RecSta_DEV = 0x1 (ON) within 20s
  //          -> Immediately Click Evt Switch
  //          Wait 10s -> Click TML Stop
  //          Screenshot (include AIN)
  //============================================================================
  write("");
  write("=================================================================");
  write("=== STEP 11: Manual Event Trigger                           ===");
  write("===          DEV ON within 20s -> Immediately Evt Switch     ===");
  write("===          Wait 10s -> TML Stop + Screenshot (AIN)        ===");
  write("=================================================================");
  testStep("Step11", "Manual event trigger + DEV ON + Evt Switch + TML Stop");

  write("");
  write("*************************************************************");
  write("*** STEP 11: PLEASE TRIGGER AN EVENT NOW! ***");
  write("*** (e.g. apply impact/shock to the camera) ***");
  write("*** Waiting up to 20 seconds for DEV recording to start ***");
  write("*** When DEV = ON detected, Evt Switch will be triggered ***");
  write("*** Then wait 10s and TML Stop will be clicked ***");
  write("*************************************************************");
  write("");

  // 11.1 Check BLTN_CAM_RecSta_DEV = 0x1 (ON) within 20s
  write("[11.1] Waiting for BLTN_CAM_RecSta_DEV = 0x1 (ON) within 20 seconds...");
  result = WaitFor_RecSta_DEV_ON(max_wait_time_20s);

  if(result == 1)
  {
    // 11.2 Immediately click Evt Switch
    write("[11.2] DEV ON detected! Immediately clicking Evt Switch...");
    Click_Evt_Switch();
  }
  else
  {
    write("[11.2] DEV Recording NOT detected within 20s. Clicking Evt Switch anyway...");
    Click_Evt_Switch();
  }

  // 11.3 Wait 10 seconds
  write("[11.3] Waiting 10 seconds...");
  testWaitForTimeout(10000);

  // 11.4 Click TML Stop
  write("[11.4] Clicking TML Stop...");
  Click_TML_Stop();

  // 11.5 Capture screenshot
  write("[11.5] Capturing screenshot...");
  CaptureGraphics("BLTN_CAM_RecSta_DEV;BLTN_CAM_RecSta_MAR;BLTN_CAM_RecSta_TML;AIN;BLTN_CAM_HU_UI_Mode", "OWD_028_step11.jpg");

  if(result == 1)
  {
    step11_passed = 1;
    testStepPass("Step11", "DEV ON -> Evt Switch -> Wait 10s -> TML Stop - PASS");
  }
  else
  {
    step11_passed = 0;
    testStepFail("Step11", "DEV Recording NOT detected within 20s - FAIL");
  }

  //============================================================================
  // Overall Test Verdict
  //============================================================================
  if(step1_passed == 1 && step2_passed == 1 && step3_passed == 1 && step4_passed == 1 && step5_passed == 1 && step6_passed == 1 && step7_passed == 1 && step8_passed == 1 && step9_passed == 1 && step10_passed == 1 && step11_passed == 1)
  {
    testStepPass("Overall_Verdict", "Test OWD_028: PASS");
    write("=== OVERALL VERDICT: PASS ===");
  }
  else
  {
    testStepFail("Overall_Verdict", "Test OWD_028: FAIL");
    write("=== OVERALL VERDICT: FAIL ===");
  }

  //============================================================================
  // TEST COMPLETE - Cleanup
  //============================================================================
  write("");
  write("========================================");
  write("=== TEST OWD_028 COMPLETE ===");
  write("========================================");

  // Cleanup: Exit BLTN_CAM if needed, KEY OFF
  Exit_BLTN_CAM();
  testWaitForTimeout(2000);
  setSignal(SMK_TrmnlCtrlGrpStaBDC, 0x0);  // KEY OFF
  testWaitForTimeout(2000);
  @panel::Switch_CGWNM = 0;

  // Final status
  write("");
  write("=== FINAL STATUS ===");
  write("  SMK_TrmnlCtrlGrpStaBDC = 0x%X", $SMK_TrmnlCtrlGrpStaBDC);
  write("  BLTN_CAM_RecSta_TML = 0x%X", $BLTN_CAM_RecSta_TML);
  write("  BLTN_CAM_RecSta_MAR = 0x%X", $BLTN_CAM_RecSta_MAR);
  write("  BLTN_CAM_RecSta_DEV = 0x%X", $BLTN_CAM_RecSta_DEV);
  write("  BLTN_CAM_RecSet_OWD = 0x%X", $BLTN_CAM_RecSet_OWD);
  write("  BLTN_CAM_HU_UI_Mode = 0x%X", $BLTN_CAM_HU_UI_Mode);

  write("");
  write("=== TEST SUMMARY ===");

  if(step1_passed == 1)
    write("Step 1:  SMK IGN + USM/Rec Reset + TML Start + TML ON [Screenshot+AIN] - PASS");
  else
    write("Step 1:  SMK IGN + USM/Rec Reset + TML Start + TML ON [Screenshot+AIN] - FAIL");

  if(step2_passed == 1)
    write("Step 2:  Evt Switch + MAR Recording + 12s wait [Screenshot+AIN] - PASS");
  else
    write("Step 2:  Evt Switch + MAR Recording + 12s wait [Screenshot+AIN] - FAIL");

  if(step3_passed == 1)
    write("Step 3:  Evt Switch + MAR Recording + 10s wait [Screenshot+AIN] - PASS");
  else
    write("Step 3:  Evt Switch + MAR Recording + 10s wait [Screenshot+AIN] - FAIL");

  if(step4_passed == 1)
    write("Step 4:  Manual event + DEV ON within 10s + 10s wait [Screenshot+AIN] - PASS");
  else
    write("Step 4:  Manual event + DEV ON within 10s + 10s wait [Screenshot+AIN] - FAIL");

  if(step5_passed == 1)
    write("Step 5:  Manual event + DEV ON within 10s + 10s wait [Screenshot+AIN] - PASS");
  else
    write("Step 5:  Manual event + DEV ON within 10s + 10s wait [Screenshot+AIN] - FAIL");

  if(step6_passed == 1)
    write("Step 6:  TML Stop + OWD OFF + TML Start + Driving event + DEV ON -> TML Stop [Screenshot+AIN] - PASS");
  else
    write("Step 6:  TML Stop + OWD OFF + TML Start + Driving event + DEV ON -> TML Stop [Screenshot+AIN] - FAIL");

  if(step7_passed == 1)
    write("Step 7:  TML Stop + OWD OFF + TML Start + Evt Switch + MAR ON -> TML Stop [Screenshot+AIN] - PASS");
  else
    write("Step 7:  TML Stop + OWD OFF + TML Start + Evt Switch + MAR ON -> TML Stop [Screenshot+AIN] - FAIL");

  if(step8_passed == 1)
    write("Step 8:  BLTN_CAM + OWD ON + AVN + AIN > 4 [Screenshot+AIN] - PASS");
  else
    write("Step 8:  BLTN_CAM + OWD ON + AVN + AIN > 4 [Screenshot+AIN] - FAIL");

  if(step9_passed == 1)
    write("Step 9:  TML Start + TML ON [Screenshot+AIN] - PASS");
  else
    write("Step 9:  TML Start + TML ON [Screenshot+AIN] - FAIL");

  if(step10_passed == 1)
    write("Step 10: Manual event + DEV ON within 20s + 10s wait [Screenshot+AIN] - PASS");
  else
    write("Step 10: Manual event + DEV ON within 20s + 10s wait [Screenshot+AIN] - FAIL");

  if(step11_passed == 1)
    write("Step 11: Manual event + DEV ON -> Evt Switch + 10s + TML Stop [Screenshot+AIN] - PASS");
  else
    write("Step 11: Manual event + DEV ON -> Evt Switch + 10s + TML Stop [Screenshot+AIN] - FAIL");
}

void MainTest()
{
  testReportFileName("TestReports\\OWD_028 - 2.5 generation_report");

  write("Run Turn_OFF_RecSet()"); Turn_OFF_RecSet();

  write("Run Rec_Reset()"); Rec_Reset();

  OWD_028();
}
