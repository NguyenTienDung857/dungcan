/*@!Encoding:65001*/

/*
  Test Case: OWD_029
  Title: [TML Start/Stop Repeat + MAR + TML Combined Recording Test]
  Verification items:
    - Step 1: SMK IGN + USM Reset + Rec Reset + AVN mode
              TML Start/Stop x10 cycles (each: Start -> check ON -> immediately Stop -> check OFF)
              Screenshot after 10 cycles (final state: TML OFF)
    - Step 2: Evt Switch -> Check BLTN_CAM_RecSta_MAR = 0x1 (Recording) within 10s
              Wait 10s -> Screenshot (include BLTN_CAM_RecSta_TML and AIN)
    - Step 3: TML Start -> Check BLTN_CAM_RecSta_TML = 0x1 (ON) within 10s
              Wait 5s -> Screenshot (include AIN)
              TML Stop -> Check BLTN_CAM_RecSta_TML = 0x0 (OFF)
    - Step 4: Evt Switch -> Check BLTN_CAM_RecSta_MAR = 0x1 (Recording) AND RecSta_TML = OFF within 10s
              Wait 10s -> Screenshot (include BLTN_CAM_RecSta_TML and AIN)
    - Step 5: TML Start -> Check BLTN_CAM_RecSta_TML = 0x1 (ON) within 10s
              Wait 5s -> Screenshot (include AIN)
              TML Stop -> Check BLTN_CAM_RecSta_TML = 0x0 (OFF)

  Preconditions:
    - ACC and IGN and ccNC/ccIC switch OFF, AVN mode

  NOTE: Uses 2-5s delay for signal propagation after each state transition.
*/

variables
{
  long max_wait_time_10s = 10000;   // 10 seconds timeout

  // Message declarations for CAN FD
  message HU_BLTN_CAM_02_200ms _HU_BLTN_CAM_02_200ms;
  message HU_BLTN_CAM_01_00ms _HU_BLTN_CAM_01_00ms;
  message HU_CLOCK_01_1000ms _HU_CLOCK_01_1000ms;

  // Result tracking variables
  int step1_passed = 0;
  int step2_passed = 0;
  int step3_passed = 0;
  int step4_passed = 0;
  int step5_passed = 0;

  // Error counter for Turn_OFF_RecSet
  int flag_RecSet_error = 0;
}

// ============================================================================
// Panel Control Helper Functions
// ============================================================================

// Set SMK to IGN (0x2) via panel combo box
void Set_SMK_IGN()
{
  write("=== Setting SMK_Signal to IGN via panel ===");
  @panel::Switch_CGWNM = 1;
  testWaitForTimeout(2000);
  setSignal(SMK_TrmnlCtrlGrpStaBDC, 0x2);  // IGN
  testWaitForTimeout(2000);
  write("  SMK_TrmnlCtrlGrpStaBDC = 0x%X (IGN)", $SMK_TrmnlCtrlGrpStaBDC);
}

// Click USM Reset button on panel
void Click_USM_Reset()
{
  write("=== Clicking USM Reset button on panel ===");
  @panel::Button_USMReset = 1;
  testWaitForTimeout(2000);
  write("  USM Reset clicked");
}

// Click Rec Reset button on panel
void Click_Rec_Reset()
{
  write("=== Clicking Rec Reset button on panel ===");
  @panel::Button_RecReset = 1;
  testWaitForTimeout(2000);
  write("  Rec Reset clicked");
}

// Click Evt Switch button on panel (toggle off then on)
void Click_Evt_Switch()
{
  write("=== Clicking Event Switch button ===");
  @panel::Button_SwitchEvt = 1;
  //testWaitForTimeout(3000);
  testWaitForTimeout(2000);
  write("  Evt Switch clicked");
}

// Click TML Start button on panel Recording_Setting
void Click_TML_Start()
{
  write("=== Clicking TML Start button on panel ===");
  @panel::Button_Timelaps_Start = 0;
  testWaitForTimeout(500);
  @panel::Button_Timelaps_Start = 1;
  testWaitForTimeout(2000);
  write("  TML Start clicked");
}

// Click TML Stop button on panel Recording_Setting
void Click_TML_Stop()
{
  write("=== Clicking TML Stop button on panel ===");
  @panel::Button_Timelaps_Stop = 0;
  testWaitForTimeout(500);
  @panel::Button_Timelaps_Stop = 1;
  testWaitForTimeout(2000);
  write("  TML Stop clicked");
}

// Enter Built-in Cam mode (HU_BLTN_CAM_UI_Mode = 0x1)
void Enter_BLTN_CAM()
{
  write(">>> Enter BLTN_CAM mode <<<");
  _HU_BLTN_CAM_02_200ms.HU_BLTN_CAM_UI_Mode = 0x1;
  output(_HU_BLTN_CAM_02_200ms);
  testWaitForTimeout(3000);
}

// Exit to AVN HU UI mode (HU_BLTN_CAM_UI_Mode = 0x0)
void Exit_BLTN_CAM()
{
  write(">>> Exit BLTN_CAM mode - Return to AVN <<<");
  _HU_BLTN_CAM_02_200ms.HU_BLTN_CAM_UI_Mode = 0x0;
  output(_HU_BLTN_CAM_02_200ms);
  testWaitForTimeout(3000);
}

// ============================================================================
// Check Functions
// ============================================================================

// Wait for BLTN_CAM_RecSta_TML = 0x1 (ON) with timeout
int WaitFor_RecSta_TML_ON(long timeout_ms)
{
  long elapsed = 0;
  long check_interval = 1000;
  byte rec_sta_tml = 0;
  long log_interval;

  write("=== Waiting for TML Recording ON (max %d seconds) ===", timeout_ms / 1000);
  log_interval = (timeout_ms / 6 / check_interval) * check_interval;
  if(log_interval < check_interval) log_interval = check_interval;

  while(elapsed < timeout_ms)
  {
    rec_sta_tml = $BLTN_CAM_RecSta_TML;
    if(elapsed == 0 || elapsed % log_interval == 0)
    {
      write("  [%d s / %d s] BLTN_CAM_RecSta_TML = 0x%X",
            elapsed / 1000, timeout_ms / 1000, rec_sta_tml);
    }

    if(rec_sta_tml == 0x1)
    {
      write(">>> DETECTED: TML Recording ON after %d seconds <<<", elapsed / 1000);
      write(">>> PASS: BLTN_CAM_RecSta_TML = 0x1 (ON) <<<");
      return 1;
    }

    testWaitForTimeout(check_interval);
    elapsed += check_interval;
  }

  write(">>> TIMEOUT: TML Recording NOT ON after %d seconds <<<", timeout_ms / 1000);
  write(">>> FAIL: BLTN_CAM_RecSta_TML is still 0x%X <<<", rec_sta_tml);
  return 0;
}

// Wait for BLTN_CAM_RecSta_TML = 0x0 (OFF) with timeout
int WaitFor_RecSta_TML_OFF(long timeout_ms)
{
  long elapsed = 0;
  long check_interval = 1000;
  byte rec_sta_tml = 0;
  long log_interval;

  write("=== Waiting for TML Recording OFF (max %d seconds) ===", timeout_ms / 1000);
  log_interval = (timeout_ms / 6 / check_interval) * check_interval;
  if(log_interval < check_interval) log_interval = check_interval;

  while(elapsed < timeout_ms)
  {
    rec_sta_tml = $BLTN_CAM_RecSta_TML;
    if(elapsed == 0 || elapsed % log_interval == 0)
    {
      write("  [%d s / %d s] BLTN_CAM_RecSta_TML = 0x%X",
            elapsed / 1000, timeout_ms / 1000, rec_sta_tml);
    }

    if(rec_sta_tml == 0x0)
    {
      write(">>> DETECTED: TML Recording OFF after %d seconds <<<", elapsed / 1000);
      write(">>> PASS: BLTN_CAM_RecSta_TML = 0x0 (OFF) <<<");
      return 1;
    }

    testWaitForTimeout(check_interval);
    elapsed += check_interval;
  }

  write(">>> TIMEOUT: TML Recording NOT OFF after %d seconds <<<", timeout_ms / 1000);
  write(">>> FAIL: BLTN_CAM_RecSta_TML is still 0x%X <<<", rec_sta_tml);
  return 0;
}

// Wait for BLTN_CAM_RecSta_MAR = 0x1 (Recording) with timeout
int WaitFor_RecSta_MAR_Recording(long timeout_ms)
{
  long elapsed = 0;
  long check_interval = 1000;
  byte rec_sta_mar = 0;
  long log_interval;

  write("=== Waiting for MAR Recording (max %d seconds) ===", timeout_ms / 1000);
  log_interval = (timeout_ms / 6 / check_interval) * check_interval;
  if(log_interval < check_interval) log_interval = check_interval;

  while(elapsed < timeout_ms)
  {
    rec_sta_mar = $BLTN_CAM_RecSta_MAR;
    if(elapsed == 0 || elapsed % log_interval == 0)
    {
      write("  [%d s / %d s] BLTN_CAM_RecSta_MAR = 0x%X",
            elapsed / 1000, timeout_ms / 1000, rec_sta_mar);
    }

    if(rec_sta_mar == 0x1)
    {
      write(">>> DETECTED: MAR Recording started after %d seconds <<<", elapsed / 1000);
      write(">>> PASS: BLTN_CAM_RecSta_MAR = 0x1 (Recording) <<<");
      return 1;
    }

    testWaitForTimeout(check_interval);
    elapsed += check_interval;
  }

  write(">>> TIMEOUT: MAR Recording NOT detected after %d seconds <<<", timeout_ms / 1000);
  write(">>> FAIL: BLTN_CAM_RecSta_MAR is still 0x%X <<<", rec_sta_mar);
  return 0;
}

// Read AIN voltage from CANoe VN1600 hardware
float Get_AIN_Voltage()
{
  float ain_value = 0.0;

  // Read from VN1600_1 AIN channel
  ain_value = @sysvar::IO::VN1600_1::AIN;

  write("  AIN Voltage: %.2f V", ain_value);
  return ain_value;
}

// ============================================================================
// Turn OFF All Recording Settings
// ============================================================================
void Turn_OFF_RecSet()
{
  if (getSignal(BLTN_CAM_RecSet_OWD) == 0x2 || getSignal(BLTN_CAM_RecSet_OWP) == 0x2 || getSignal(BLTN_CAM_RecSet_DEV) == 0x2 || getSignal(BLTN_CAM_RecSet_PEV) == 0x2)
  {
    @panel::Switch_CGWNM = 1;

    setSignal(SMK_TrmnlCtrlGrpStaBDC, 0x2);
    testWaitForTimeout(3000);

    do {
      Enter_BLTN_CAM();
      testWaitForTimeout(3000);

      if (getSignal(BLTN_CAM_RecSet_OWD) == 0x2){
        write("OWD Off"); @panel::LED_Ctrl_SetOWD = 1; testWaitForTimeout(1000);
      }
      else if (getSignal(BLTN_CAM_RecSet_OWP) == 0x2){
        write("OWP Off"); @panel::LED_Ctrl_SetOWP = 1; testWaitForTimeout(1000);
      }
      else if (getSignal(BLTN_CAM_RecSet_DEV) == 0x2){
        write("DEV Off"); @panel::LED_Ctrl_SetDEV = 1; testWaitForTimeout(1000);
      }
      else if (getSignal(BLTN_CAM_RecSet_PEV) == 0x2){
        write("PEV Off"); @panel::LED_Ctrl_SetPEV = 1; testWaitForTimeout(1000);
      }

      Exit_BLTN_CAM();

      flag_RecSet_error++;

    } while((getSignal(BLTN_CAM_RecSet_OWD) == 0x2 || getSignal(BLTN_CAM_RecSet_OWP) == 0x2 || getSignal(BLTN_CAM_RecSet_DEV) == 0x2 || getSignal(BLTN_CAM_RecSet_PEV) == 0x2) && (flag_RecSet_error <= 15));

    flag_RecSet_error = 0;

    testWaitForTimeout(3000);
    setSignal(SMK_TrmnlCtrlGrpStaBDC, 0x0);
  }
  else
  {
    write("Notifications: All recording settings are turned OFF.");
  }
}

// ============================================================================
// Rec Reset Function
// ============================================================================
void Rec_Reset()
{
  @panel::Switch_CGWNM = 1;

  setSignal(SMK_TrmnlCtrlGrpStaBDC, 0x2);
  testWaitForTimeout(2000);

  while (getSignal(BLTN_CAM_SD_Format_Op_State) != 0x1)
  {
    @panel::Button_RecReset = 1;
    testWaitForSignalChange(BLTN_CAM_SD_Format_Op_State, 500);
  }

  setSignal(SMK_TrmnlCtrlGrpStaBDC, 0x0);
  testWaitForTimeout(2000);

  @panel::Switch_CGWNM = 0;
}

// ============================================================================
// Capture Screenshot Functions
// ============================================================================

// Capture screenshot with specified signal list
void CaptureGraphics(char signalList[], char filename[])
{
  char filepath[512];
  snprintf(filepath, elcount(filepath), "D:\\project\\CAN FD\\[CANoe] CANFD\\Screenshots\\%s", filename);
  write(">>> Capturing screenshot: %s <<<", filepath);
  testWaitForTimeout(3000);
  testReportAddWindowCapture("Graphics 2", signalList, "Screenshot", filepath);
  write(">>> Screenshot captured <<<");
}

// ============================================================================
// Main Test Case
// ============================================================================

testcase OWD_029()
{
  int result = 0;
  int i = 0;
  int cycle_all_pass = 1;

  write("========================================");
  write("=== START TEST OWD_029 ===");
  write("=== TML Start/Stop Repeat +         ===");
  write("=== MAR + TML Combined Test         ===");
  write("========================================");

  //============================================================================
  // STEP 1: Set SMK IGN, USM Reset, Rec Reset, AVN mode,
  //         TML Start/Stop x10 cycles
  //         Each cycle: Start -> check ON within 10s -> immediately Stop -> check OFF
  //         Screenshot after 10 cycles (final state: TML OFF)
  //============================================================================
  write("");
  write("=================================================================");
  write("=== STEP 1: SMK IGN + USM Reset + Rec Reset + AVN mode      ===");
  write("===         TML Start/Stop x10 cycles                       ===");
  write("===         Screenshot after 10 cycles (final: TML OFF)     ===");
  write("=================================================================");
  testStep("Step1", "SMK IGN + USM Reset + Rec Reset + AVN + TML Start/Stop x10");

  // 1.1 Set SMK to IGN via panel combo box
  write("[1.1] Setting SMK_Signal to IGN via panel...");
  Set_SMK_IGN();
  testWaitForTimeout(3000);

  // 1.2 Click USM Reset button
  write("[1.2] Clicking USM Reset button...");
  Click_USM_Reset();
  testWaitForTimeout(2000);

  // 1.3 Click Rec Reset button
  write("[1.3] Clicking Rec Reset button...");
  Click_Rec_Reset();
  testWaitForTimeout(2000);

  // 1.4 Ensure AVN mode (Exit BLTN_CAM)
  write("[1.4] Ensuring AVN mode...");
  Exit_BLTN_CAM();
  testWaitForTimeout(2000);
  write("  HU_BLTN_CAM_UI_Mode = 0x%X (AVN mode)", $BLTN_CAM_HU_UI_Mode);

  // 1.5 TML Start/Stop x10 cycles
  cycle_all_pass = 1;

  for(i = 1; i <= 10; i++)
  {
    write("");
    write("--- TML Cycle %d / 10 ---", i);

    // Start TML
    write("[1.5.%d.1] Clicking TML Start...", i);
    Click_TML_Start();

    // Check TML ON within 10s
    write("[1.5.%d.2] Checking BLTN_CAM_RecSta_TML = 0x1 (ON)...", i);
    result = WaitFor_RecSta_TML_ON(max_wait_time_10s);
    if(result != 1)
    {
      write(">>> FAIL: Cycle %d - TML did NOT turn ON <<<", i);
      cycle_all_pass = 0;
    }
    else
    {
      write(">>> Cycle %d - TML ON confirmed, immediately stopping... <<<", i);
    }

    // Immediately Stop TML
    write("[1.5.%d.3] Clicking TML Stop...", i);
    Click_TML_Stop();

    // Check TML OFF within 10s
    write("[1.5.%d.4] Checking BLTN_CAM_RecSta_TML = 0x0 (OFF)...", i);
    result = WaitFor_RecSta_TML_OFF(max_wait_time_10s);
    if(result != 1)
    {
      write(">>> FAIL: Cycle %d - TML did NOT turn OFF <<<", i);
      cycle_all_pass = 0;
    }
    else
    {
      write(">>> Cycle %d - TML OFF confirmed <<<", i);
    }
  }

  // 1.6 Capture screenshot after 10 cycles (final state: TML Stop/OFF)
  write("[1.6] Capturing screenshot after 10 TML Start/Stop cycles...");
  CaptureGraphics("BLTN_CAM_RecSta_TML;AIN;BLTN_CAM_HU_UI_Mode;SMK_TrmnlCtrlGrpStaBDC", "OWD_029_step1_10cycles.jpg");

  if(cycle_all_pass == 1)
  {
    step1_passed = 1;
    testStepPass("Step1", "TML Start/Stop x10 cycles all PASS");
  }
  else
  {
    step1_passed = 0;
    testStepFail("Step1", "TML Start/Stop x10 cycles - some cycles FAILED");
  }

  //============================================================================
  // STEP 2: Click Evt Switch
  //         Check BLTN_CAM_RecSta_MAR = 0x1 (Recording) within 10s
  //         Wait 10s, Screenshot (include BLTN_CAM_RecSta_TML and AIN)
  //============================================================================
  write("");
  write("=================================================================");
  write("=== STEP 2: Evt Switch + Check RecSta_MAR = 0x1 (Recording) ===");
  write("===         Wait 10s + Screenshot (TML + AIN)               ===");
  write("=================================================================");
  testStep("Step2", "Evt Switch + MAR Recording + Wait 10s + Screenshot");

  // 2.1 Click Evt Switch button
  write("[2.1] Clicking Evt Switch button...");
  Click_Evt_Switch();

  // 2.2 Check BLTN_CAM_RecSta_MAR = 0x1 (Recording) within 10s
  write("[2.2] Checking BLTN_CAM_RecSta_MAR = 0x1 (Recording)...");
  result = WaitFor_RecSta_MAR_Recording(max_wait_time_10s);

  if(result == 1)
  {
    write("[2.3] MAR Recording confirmed. Waiting 10 seconds...");
    testWaitForTimeout(10000);
    write("  10 seconds elapsed.");
  }
  else
  {
    write("[2.3] MAR Recording NOT confirmed. Waiting 10 seconds anyway...");
    testWaitForTimeout(10000);
  }

  // 2.4 Capture screenshot (include BLTN_CAM_RecSta_TML and AIN)
  write("[2.4] Capturing screenshot...");
  write("  Current AIN Voltage:");
  Get_AIN_Voltage();
  write("  BLTN_CAM_RecSta_TML = 0x%X", $BLTN_CAM_RecSta_TML);
  write("  BLTN_CAM_RecSta_MAR = 0x%X", $BLTN_CAM_RecSta_MAR);
  CaptureGraphics("BLTN_CAM_RecSta_MAR;BLTN_CAM_RecSta_TML;AIN;BLTN_CAM_HU_UI_Mode", "OWD_029_step2.jpg");

  if(result == 1)
  {
    step2_passed = 1;
    testStepPass("Step2", "BLTN_CAM_RecSta_MAR = 0x1 (Recording) after Evt Switch - PASS");
  }
  else
  {
    step2_passed = 0;
    testStepFail("Step2", "BLTN_CAM_RecSta_MAR Recording NOT detected after Evt Switch - FAIL");
  }

  //============================================================================
  // STEP 3: Click TML Start
  //         Check BLTN_CAM_RecSta_TML = 0x1 (ON) within 10s
  //         Wait 5s, Screenshot (include AIN)
  //         Click TML Stop, wait for BLTN_CAM_RecSta_TML = 0x0 (OFF)
  //============================================================================
  write("");
  write("=================================================================");
  write("=== STEP 3: TML Start + Check RecSta_TML = 0x1 (ON)         ===");
  write("===         Wait 5s + Screenshot (AIN)                      ===");
  write("===         TML Stop + Check RecSta_TML = 0x0 (OFF)         ===");
  write("=================================================================");
  testStep("Step3", "TML Start + ON + wait 5s + Screenshot + TML Stop + OFF");

  // 3.1 Click TML Start
  write("[3.1] Clicking TML Start...");
  Click_TML_Start();

  // 3.2 Check BLTN_CAM_RecSta_TML = 0x1 (ON) within 10s
  write("[3.2] Checking BLTN_CAM_RecSta_TML = 0x1 (ON)...");
  result = WaitFor_RecSta_TML_ON(max_wait_time_10s);

  if(result == 1)
  {
    write("[3.3] TML ON confirmed. Waiting 5 seconds...");
    testWaitForTimeout(5000);
    write("  5 seconds elapsed.");
  }
  else
  {
    write("[3.3] TML ON NOT confirmed. Waiting 5 seconds anyway...");
    testWaitForTimeout(5000);
  }

  // 3.4 Capture screenshot (include AIN)
  write("[3.4] Capturing screenshot...");
  write("  Current AIN Voltage:");
  Get_AIN_Voltage();
  write("  BLTN_CAM_RecSta_TML = 0x%X", $BLTN_CAM_RecSta_TML);
  write("  BLTN_CAM_RecSta_MAR = 0x%X", $BLTN_CAM_RecSta_MAR);
  CaptureGraphics("BLTN_CAM_RecSta_TML;BLTN_CAM_RecSta_MAR;AIN;BLTN_CAM_HU_UI_Mode", "OWD_029_step3_tml_on.jpg");

  // 3.5 Click TML Stop
  write("[3.5] Clicking TML Stop...");
  Click_TML_Stop();

  // 3.6 Wait for BLTN_CAM_RecSta_TML = 0x0 (OFF)
  write("[3.6] Checking BLTN_CAM_RecSta_TML = 0x0 (OFF)...");
  result = WaitFor_RecSta_TML_OFF(max_wait_time_10s);

  if(result == 1)
  {
    step3_passed = 1;
    testStepPass("Step3", "TML Start ON + Screenshot + TML Stop OFF confirmed - PASS");
  }
  else
  {
    step3_passed = 0;
    testStepFail("Step3", "TML did NOT turn OFF after Stop - FAIL");
  }

  //============================================================================
  // STEP 4: Click Evt Switch
  //         Check BLTN_CAM_RecSta_MAR = 0x1 (Recording) AND RecSta_TML = OFF
  //         within 10s, Wait 10s, Screenshot (include BLTN_CAM_RecSta_TML and AIN)
  //============================================================================
  write("");
  write("=================================================================");
  write("=== STEP 4: Evt Switch + Check RecSta_MAR = 0x1 (Recording) ===");
  write("===         AND RecSta_TML = 0x0 (OFF)                      ===");
  write("===         Wait 10s + Screenshot (TML + AIN)               ===");
  write("=================================================================");
  testStep("Step4", "Evt Switch + MAR Recording + TML OFF + Wait 10s + Screenshot");

  // 4.1 Click Evt Switch button
  write("[4.1] Clicking Evt Switch button...");
  Click_Evt_Switch();

  // 4.2 Check BLTN_CAM_RecSta_MAR = 0x1 (Recording) within 10s
  write("[4.2] Checking BLTN_CAM_RecSta_MAR = 0x1 (Recording)...");
  result = WaitFor_RecSta_MAR_Recording(max_wait_time_10s);

  // 4.3 Also check BLTN_CAM_RecSta_TML = 0x0 (OFF)
  write("[4.3] Checking BLTN_CAM_RecSta_TML = 0x0 (OFF)...");
  {
    byte tml_val = 0;
    tml_val = $BLTN_CAM_RecSta_TML;
    write("  BLTN_CAM_RecSta_TML = 0x%X", tml_val);

    if(tml_val == 0x0)
    {
      write(">>> PASS: BLTN_CAM_RecSta_TML = 0x0 (OFF) <<<");
    }
    else
    {
      write(">>> FAIL: BLTN_CAM_RecSta_TML is NOT OFF (value = 0x%X) <<<", tml_val);
      result = 0;
    }
  }

  if(result == 1)
  {
    write("[4.4] MAR Recording + TML OFF confirmed. Waiting 10 seconds...");
    testWaitForTimeout(10000);
    write("  10 seconds elapsed.");
  }
  else
  {
    write("[4.4] Condition NOT fully confirmed. Waiting 10 seconds anyway...");
    testWaitForTimeout(10000);
  }

  // 4.5 Capture screenshot (include BLTN_CAM_RecSta_TML and AIN)
  write("[4.5] Capturing screenshot...");
  write("  Current AIN Voltage:");
  Get_AIN_Voltage();
  write("  BLTN_CAM_RecSta_TML = 0x%X", $BLTN_CAM_RecSta_TML);
  write("  BLTN_CAM_RecSta_MAR = 0x%X", $BLTN_CAM_RecSta_MAR);
  CaptureGraphics("BLTN_CAM_RecSta_MAR;BLTN_CAM_RecSta_TML;AIN;BLTN_CAM_HU_UI_Mode", "OWD_029_step4.jpg");

  if(result == 1)
  {
    step4_passed = 1;
    testStepPass("Step4", "MAR = 0x1 (Recording) AND TML = 0x0 (OFF) after Evt Switch - PASS");
  }
  else
  {
    step4_passed = 0;
    testStepFail("Step4", "MAR Recording or TML OFF condition NOT met after Evt Switch - FAIL");
  }

  //============================================================================
  // STEP 5: Click TML Start
  //         Check BLTN_CAM_RecSta_TML = 0x1 (ON) within 10s
  //         Wait 5s, Screenshot (include AIN)
  //         Click TML Stop, wait for BLTN_CAM_RecSta_TML = 0x0 (OFF)
  //============================================================================
  write("");
  write("=================================================================");
  write("=== STEP 5: TML Start + Check RecSta_TML = 0x1 (ON)         ===");
  write("===         Wait 5s + Screenshot (AIN)                      ===");
  write("===         TML Stop + Check RecSta_TML = 0x0 (OFF)         ===");
  write("=================================================================");
  testStep("Step5", "TML Start + ON + wait 5s + Screenshot + TML Stop + OFF");

  // 5.1 Click TML Start
  write("[5.1] Clicking TML Start...");
  Click_TML_Start();

  // 5.2 Check BLTN_CAM_RecSta_TML = 0x1 (ON) within 10s
  write("[5.2] Checking BLTN_CAM_RecSta_TML = 0x1 (ON)...");
  result = WaitFor_RecSta_TML_ON(max_wait_time_10s);

  if(result == 1)
  {
    write("[5.3] TML ON confirmed. Waiting 5 seconds...");
    testWaitForTimeout(5000);
    write("  5 seconds elapsed.");
  }
  else
  {
    write("[5.3] TML ON NOT confirmed. Waiting 5 seconds anyway...");
    testWaitForTimeout(5000);
  }

  // 5.4 Capture screenshot (include AIN)
  write("[5.4] Capturing screenshot...");
  write("  Current AIN Voltage:");
  Get_AIN_Voltage();
  write("  BLTN_CAM_RecSta_TML = 0x%X", $BLTN_CAM_RecSta_TML);
  write("  BLTN_CAM_RecSta_MAR = 0x%X", $BLTN_CAM_RecSta_MAR);
  CaptureGraphics("BLTN_CAM_RecSta_TML;BLTN_CAM_RecSta_MAR;AIN;BLTN_CAM_HU_UI_Mode", "OWD_029_step5_tml_on.jpg");

  // 5.5 Click TML Stop
  write("[5.5] Clicking TML Stop...");
  Click_TML_Stop();

  // 5.6 Wait for BLTN_CAM_RecSta_TML = 0x0 (OFF)
  write("[5.6] Checking BLTN_CAM_RecSta_TML = 0x0 (OFF)...");
  result = WaitFor_RecSta_TML_OFF(max_wait_time_10s);

  if(result == 1)
  {
    step5_passed = 1;
    testStepPass("Step5", "TML Start ON + Screenshot + TML Stop OFF confirmed - PASS");
  }
  else
  {
    step5_passed = 0;
    testStepFail("Step5", "TML did NOT turn OFF after Stop - FAIL");
  }

  //============================================================================
  // Overall Test Verdict
  //============================================================================
  if(step1_passed == 1 && step2_passed == 1 && step3_passed == 1 && step4_passed == 1 && step5_passed == 1)
  {
    testStepPass("Overall_Verdict", "Test OWD_029: PASS");
    write("=== OVERALL VERDICT: PASS ===");
  }
  else
  {
    testStepFail("Overall_Verdict", "Test OWD_029: FAIL");
    write("=== OVERALL VERDICT: FAIL ===");
  }

  //============================================================================
  // TEST COMPLETE - Cleanup
  //============================================================================
  write("");
  write("========================================");
  write("=== TEST OWD_029 COMPLETE ===");
  write("========================================");

  // Cleanup: KEY OFF
  write("=== Cleanup: KEY OFF ===");
  setSignal(SMK_TrmnlCtrlGrpStaBDC, 0x0);  // KEY OFF
  testWaitForTimeout(2000);
  @panel::Switch_CGWNM = 0;

  // Final status
  write("");
  write("=== FINAL STATUS ===");
  write("  SMK_TrmnlCtrlGrpStaBDC = 0x%X", $SMK_TrmnlCtrlGrpStaBDC);
  write("  BLTN_CAM_RecSta_TML = 0x%X", $BLTN_CAM_RecSta_TML);
  write("  BLTN_CAM_RecSta_MAR = 0x%X", $BLTN_CAM_RecSta_MAR);
  write("  BLTN_CAM_HU_UI_Mode = 0x%X", $BLTN_CAM_HU_UI_Mode);

  write("");
  write("=== TEST SUMMARY ===");
  if(step1_passed == 1)
    write("Step 1: SMK IGN + USM Reset + Rec Reset + TML Start/Stop x10 [Screenshot] - PASS");
  else
    write("Step 1: SMK IGN + USM Reset + Rec Reset + TML Start/Stop x10 [Screenshot] - FAIL");

  if(step2_passed == 1)
    write("Step 2: Evt Switch + MAR Recording + Wait 10s [Screenshot TML+AIN] - PASS");
  else
    write("Step 2: Evt Switch + MAR Recording + Wait 10s [Screenshot TML+AIN] - FAIL");

  if(step3_passed == 1)
    write("Step 3: TML Start ON + Wait 5s [Screenshot AIN] + TML Stop OFF - PASS");
  else
    write("Step 3: TML Start ON + Wait 5s [Screenshot AIN] + TML Stop OFF - FAIL");

  if(step4_passed == 1)
    write("Step 4: Evt Switch + MAR Recording + TML OFF + Wait 10s [Screenshot TML+AIN] - PASS");
  else
    write("Step 4: Evt Switch + MAR Recording + TML OFF + Wait 10s [Screenshot TML+AIN] - FAIL");

  if(step5_passed == 1)
    write("Step 5: TML Start ON + Wait 5s [Screenshot AIN] + TML Stop OFF - PASS");
  else
    write("Step 5: TML Start ON + Wait 5s [Screenshot AIN] + TML Stop OFF - FAIL");
}

void MainTest()
{
  testReportFileName("TestReports\\OWD_029 - 2.5 generation_report");

  write("Run Turn_OFF_RecSet()"); Turn_OFF_RecSet();

  write("Run Rec_Reset()"); Rec_Reset();

  OWD_029();
}
