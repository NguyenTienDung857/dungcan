/*@!Encoding:1252*/

/*
  Test Case: OWD_030
  Title: [TML + MAR Recording Test - TML Start in AVN + Evt Switch + IGN OFF/ON TML Stop]
  Verification items:
    - Step 1: SMK IGN + USM Reset + Rec Reset + AVN mode + TML Start
              Check BLTN_CAM_RecSta_TML = 0x1 (ON), wait 5s, Screenshot (include AIN)
    - Step 2: Click Evt Switch
              Check BLTN_CAM_RecSta_MAR = 0x1 (Recording), wait 15s, Screenshot (include AIN)
    - Step 3, 4: Log - check video (manual)
    - Step 5: Wait 1 minute, SMK OFF, wait 2s, SMK IGN again
              Check BLTN_CAM_RecSta_TML = 0x0 (OFF), Screenshot
    - Step 6: Log - check video (manual)

  Preconditions:
    - ACC and IGN and ccNC/ccIC switch OFF, AVN mode

  NOTE: Uses 2-5s delay for signal propagation after each state transition.
*/

variables
{
  long max_wait_time_10s = 10000;   // 10 seconds timeout

  // Message declarations for CAN
  message HU_BLTN_CAM_PE_00_200ms _HU_BLTN_CAM_PE_00_200ms;
  message HU_BLTN_CAM_E_01 _HU_BLTN_CAM_E_01;
  message HU_CLOCK_PE_02 _HU_CLOCK_PE_02;

  // Result tracking variables
  int step1_passed = 0;
  int step2_passed = 0;
  int step5_passed = 0;

  int flag_RecSet_error = 0;
}

// ============================================================================
// Panel Control Helper Functions
// ============================================================================

// Set SMK to IGN (0x2) via panel combo box
void Set_SMK_IGN()
{
  write("=== Setting SMK_Signal to IGN via panel ===");
  @panel::Switch_CGWNM = 1;
  testWaitForTimeout(2000);
  setSignal(SMK_TrmnlCtrlGrpStaBDC, 0x2);  // IGN
  testWaitForTimeout(2000);
  write("  SMK_TrmnlCtrlGrpStaBDC = 0x%X (IGN)", $SMK_TrmnlCtrlGrpStaBDC);
}

// Set SMK to OFF (0x0) via panel combo box
void Set_SMK_OFF()
{
  write("=== Setting SMK_Signal to OFF via panel ===");
  setSignal(SMK_TrmnlCtrlGrpStaBDC, 0x0);  // OFF
  testWaitForTimeout(2000);
  @panel::Switch_CGWNM = 0;
  testWaitForTimeout(2000);
  write("  SMK_TrmnlCtrlGrpStaBDC = 0x%X (OFF)", $SMK_TrmnlCtrlGrpStaBDC);
}

// Click USM Reset button on panel
void Click_USM_Reset()
{
  write("=== Clicking USM Reset button on panel ===");
  @panel::Button_USMReset = 1;
  testWaitForTimeout(2000);
  write("  USM Reset clicked");
}

// Click Rec Reset button on panel
void Click_Rec_Reset()
{
  write("=== Clicking Rec Reset button on panel ===");
  @panel::Button_RecReset = 1;
  testWaitForTimeout(2000);
  write("  Rec Reset clicked");
}

// Click Evt Switch button on panel (toggle off then on)
void Click_Evt_Switch()
{
  write("=== Clicking Event Switch button ===");
  @panel::Button_SwitchEvt = 0;
  testWaitForTimeout(500);
  @panel::Button_SwitchEvt = 1;
  //testWaitForTimeout(3000);
  testWaitForTimeout(2000);
  write("  Evt Switch clicked");
}

// Click TML Start button on panel Recording_Setting
void Click_TML_Start()
{
  write("=== Clicking TML Start button on panel ===");
  @panel::Button_Timelaps_Start = 0;
  testWaitForTimeout(500);
  @panel::Button_Timelaps_Start = 1;
  testWaitForTimeout(2000);
  write("  TML Start clicked");
}

// Enter Built-in Cam mode (HU_BLTN_CAM_UI_Mode = 0x1)
void Enter_BLTN_CAM()
{
  int i;
  write(">>> Enter BLTN_CAM mode <<<");
  _HU_BLTN_CAM_PE_00_200ms.HU_BLTN_CAM_UI_Mode = 0x1;
  output(_HU_BLTN_CAM_PE_00_200ms);

  for (i = 0; i < 10; i++) {
    testWaitForTimeout(500);
    if (getSignal(BLTN_CAM_HU_UI_Mode) == 0x1) {
      write(">>> [OK] BLTN_CAM mode confirmed <<<");
      return;
    }
  }
  write(">>> [NG] Timeout: BLTN_CAM_HU_UI_Mode = 0x%X <<<",
        getSignal(BLTN_CAM_HU_UI_Mode));
}

// Exit to AVN HU UI mode (HU_BLTN_CAM_UI_Mode = 0x0)
void Exit_BLTN_CAM()
{
  int i;
  write(">>> Exit to AVN mode <<<");
  _HU_BLTN_CAM_PE_00_200ms.HU_BLTN_CAM_UI_Mode = 0x0;
  output(_HU_BLTN_CAM_PE_00_200ms);

  for (i = 0; i < 10; i++) {
    testWaitForTimeout(500);
    if (getSignal(BLTN_CAM_HU_UI_Mode) == 0x0) {
      write(">>> [OK] AVN mode confirmed <<<");
      return;
    }
  }
  write(">>> [NG] Timeout: BLTN_CAM_HU_UI_Mode = 0x%X <<<",
        getSignal(BLTN_CAM_HU_UI_Mode));
}

// ============================================================================
// Check Functions
// ============================================================================

// Wait for BLTN_CAM_RecSta_TML = 0x1 (ON) with timeout
int WaitFor_RecSta_TML_ON(long timeout_ms)
{
  long elapsed = 0;
  long check_interval = 1000;
  long log_interval;
  byte rec_sta_tml = 0;

  // Calculate log interval: ~6 logs total (timeout/6), min = check_interval
  log_interval = (timeout_ms / 6 / check_interval) * check_interval;
  if(log_interval < check_interval) log_interval = check_interval;

  write("=== Waiting for TML Recording ON (max %d seconds) ===", timeout_ms / 1000);

  while(elapsed < timeout_ms)
  {
    rec_sta_tml = $BLTN_CAM_RecSta_TML;
    if(elapsed == 0 || elapsed % log_interval == 0)
    {
      write("  [%d s / %d s] BLTN_CAM_RecSta_TML = 0x%X",
            elapsed / 1000, timeout_ms / 1000, rec_sta_tml);
    }

    if(rec_sta_tml == 0x1)
    {
      write(">>> DETECTED: TML Recording ON after %d seconds <<<", elapsed / 1000);
      write(">>> PASS: BLTN_CAM_RecSta_TML = 0x1 (ON) <<<");
      return 1;
    }

    testWaitForTimeout(check_interval);
    elapsed += check_interval;
  }

  write(">>> TIMEOUT: TML Recording NOT ON after %d seconds <<<", timeout_ms / 1000);
  write(">>> FAIL: BLTN_CAM_RecSta_TML is still 0x%X <<<", rec_sta_tml);
  return 0;
}

// Check BLTN_CAM_RecSta_TML current value = 0x0 (OFF)
int Check_RecSta_TML_OFF()
{
  byte rec_sta_tml = 0;

  rec_sta_tml = $BLTN_CAM_RecSta_TML;
  write("  BLTN_CAM_RecSta_TML = 0x%X", rec_sta_tml);

  if(rec_sta_tml == 0x0)
  {
    write(">>> PASS: BLTN_CAM_RecSta_TML = 0x0 (OFF) <<<");
    return 1;
  }
  else
  {
    write(">>> FAIL: BLTN_CAM_RecSta_TML is NOT OFF (value = 0x%X) <<<", rec_sta_tml);
    return 0;
  }
}

// Wait for BLTN_CAM_RecSta_MAR = 0x1 (Recording) with timeout
int WaitFor_RecSta_MAR_Recording(long timeout_ms)
{
  long elapsed = 0;
  long check_interval = 1000;
  long log_interval;
  byte rec_sta_mar = 0;

  // Calculate log interval: ~6 logs total (timeout/6), min = check_interval
  log_interval = (timeout_ms / 6 / check_interval) * check_interval;
  if(log_interval < check_interval) log_interval = check_interval;

  write("=== Waiting for MAR Recording (max %d seconds) ===", timeout_ms / 1000);

  while(elapsed < timeout_ms)
  {
    rec_sta_mar = $BLTN_CAM_RecSta_MAR;
    if(elapsed == 0 || elapsed % log_interval == 0)
    {
      write("  [%d s / %d s] BLTN_CAM_RecSta_MAR = 0x%X",
            elapsed / 1000, timeout_ms / 1000, rec_sta_mar);
    }

    if(rec_sta_mar == 0x1)
    {
      write(">>> DETECTED: MAR Recording started after %d seconds <<<", elapsed / 1000);
      write(">>> PASS: BLTN_CAM_RecSta_MAR = 0x1 (Recording) <<<");
      return 1;
    }

    testWaitForTimeout(check_interval);
    elapsed += check_interval;
  }

  write(">>> TIMEOUT: MAR Recording NOT detected after %d seconds <<<", timeout_ms / 1000);
  write(">>> FAIL: BLTN_CAM_RecSta_MAR is still 0x%X <<<", rec_sta_mar);
  return 0;
}

// Read AIN voltage from CANoe VN1600 hardware
float Get_AIN_Voltage()
{
  float ain_value = 0.0;

  // Read from VN1600_1 AIN channel
  ain_value = @sysvar::IO::VN1600_1::AIN;

  write("  AIN Voltage: %.2f V", ain_value);
  return ain_value;
}

// ============================================================================
// Rec Reset Function
// ============================================================================
void Rec_Reset()
{
  @panel::Switch_CGWNM = 1;

  setSignal(SMK_TrmnlCtrlGrpStaBDC, 0x2);
  testWaitForTimeout(2000);

  while (getSignal(BLTN_CAM_SD_Format_Op_State) != 0x1)
  {
    @panel::Button_RecReset = 1;
    testWaitForSignalChange(BLTN_CAM_SD_Format_Op_State, 500);
  }

  setSignal(SMK_TrmnlCtrlGrpStaBDC, 0x0);
  testWaitForTimeout(2000);

  @panel::Switch_CGWNM = 0;
}

// ============================================================================
// Capture Screenshot Functions
// ============================================================================

// Capture screenshot with specified signal list
void CaptureGraphics(char signalList[])
{
  testWaitForTimeout(3000);
  testReportAddWindowCapture("OWD", signalList, "Screenshot");
  write(">>> Screenshot captured <<<");
}

// ============================================================================
// Main Test Case
// ============================================================================

testcase OWD_030_Init()
{
  write("========================================");
  write("=== START TEST OWD_030 ===");
  write("=== TML + MAR Recording Test        ===");
  write("=== TML AVN + Evt Switch +          ===");
  write("=== IGN OFF/ON TML Stop             ===");
  write("========================================");
}

testcase OWD_030_1()
{
  int result = 0;

  //============================================================================
  // STEP 1: Set SMK IGN, USM Reset, Rec Reset, AVN mode,
  //         Click TML Start, Check BLTN_CAM_RecSta_TML = 0x1 (ON)
  //         Wait 5s, Screenshot (include AIN)
  //============================================================================
  write("");
  write("=================================================================");
  write("=== STEP 1: SMK IGN + USM Reset + Rec Reset + AVN mode      ===");
  write("===         TML Start + Check RecSta_TML = 0x1 (ON)         ===");
  write("===         Wait 5s + Screenshot (include AIN)               ===");
  write("=================================================================");
  testStep("Step1", "SMK IGN + USM Reset + Rec Reset + AVN + TML Start + TML ON + Screenshot");

  // 1.1 Set SMK to IGN via panel combo box
  write("[1.1] Setting SMK_Signal to IGN via panel...");
  Set_SMK_IGN();
  testWaitForTimeout(3000);

  // 1.2 Click USM Reset button
  write("[1.2] Clicking USM Reset button...");
  Click_USM_Reset();
  testWaitForTimeout(2000);

  // 1.3 Click Rec Reset button
  write("[1.3] Clicking Rec Reset button...");
  Click_Rec_Reset();
  testWaitForTimeout(2000);

  // 1.4 Ensure AVN mode (Exit BLTN_CAM if needed)
  write("[1.4] Ensuring AVN mode...");
  Exit_BLTN_CAM();
  testWaitForTimeout(2000);
  write("  HU_BLTN_CAM_UI_Mode = 0x%X (AVN mode)", $BLTN_CAM_HU_UI_Mode);

  // 1.5 Click TML Start on panel
  write("[1.5] Clicking TML Start on panel...");
  Click_TML_Start();

  // 1.6 Check BLTN_CAM_RecSta_TML = 0x1 (ON)
  write("[1.6] Checking BLTN_CAM_RecSta_TML = 0x1 (ON)...");
  result = WaitFor_RecSta_TML_ON(max_wait_time_10s);

  if(result == 1)
  {
    step1_passed = 1;
    write(">>> Step 1: PASS - BLTN_CAM_RecSta_TML = 0x1 (ON) <<<");
  }
  else
  {
    step1_passed = 0;
    write(">>> Step 1: FAIL - BLTN_CAM_RecSta_TML did NOT turn ON <<<");
  }

  // 1.7 Wait 5 seconds
  write("[1.7] Waiting 5 seconds...");
  testWaitForTimeout(5000);
  write("  5 seconds elapsed.");

  // 1.8 Read AIN voltage
  write("[1.8] Reading AIN voltage...");
  Get_AIN_Voltage();

  // 1.9 Capture screenshot (include AIN)
  write("[1.9] Capturing screenshot...");
  write("  BLTN_CAM_RecSta_TML = 0x%X", $BLTN_CAM_RecSta_TML);
  write("  BLTN_CAM_RecSta_MAR = 0x%X", $BLTN_CAM_RecSta_MAR);
  CaptureGraphics("BLTN_CAM_RecSta_TML;BLTN_CAM_RecSta_MAR;AIN;BLTN_CAM_HU_UI_Mode;SMK_TrmnlCtrlGrpStaBDC");

  if(step1_passed == 1)
  {
    testStepPass("Step1", "BLTN_CAM_RecSta_TML = 0x1 (ON) after TML Start in AVN - PASS");
  }
  else
  {
    testStepFail("Step1", "BLTN_CAM_RecSta_TML did NOT turn ON after TML Start - FAIL");
  }
}

testcase OWD_030_2()
{
  int result = 0;

  //============================================================================
  // STEP 2: Click Evt Switch
  //         Check BLTN_CAM_RecSta_MAR = 0x1 (Recording)
  //         Wait 15s, Screenshot (include AIN)
  //============================================================================
  write("");
  write("=================================================================");
  write("=== STEP 2: Evt Switch + Check RecSta_MAR = 0x1 (Recording) ===");
  write("===         Wait 15s + Screenshot (include AIN)              ===");
  write("=================================================================");
  testStep("Step2", "Evt Switch + MAR Recording + Wait 15s + Screenshot");

  // 2.1 Click Evt Switch button on panel
  write("[2.1] Clicking Evt Switch button on panel...");
  Click_Evt_Switch();

  // 2.2 Check BLTN_CAM_RecSta_MAR = 0x1 (Recording) within 10s
  write("[2.2] Checking BLTN_CAM_RecSta_MAR = 0x1 (Recording)...");
  result = WaitFor_RecSta_MAR_Recording(max_wait_time_10s);

  if(result == 1)
  {
    step2_passed = 1;
    write(">>> Step 2: PASS - BLTN_CAM_RecSta_MAR = 0x1 (Recording) <<<");
  }
  else
  {
    step2_passed = 0;
    write(">>> Step 2: FAIL - BLTN_CAM_RecSta_MAR Recording NOT detected <<<");
  }

  // 2.3 Wait 15 seconds
  write("[2.3] Waiting 15 seconds...");
  testWaitForTimeout(15000);
  write("  15 seconds elapsed.");

  // 2.4 Read AIN voltage
  write("[2.4] Reading AIN voltage...");
  Get_AIN_Voltage();

  // 2.5 Capture screenshot (include AIN)
  write("[2.5] Capturing screenshot...");
  write("  BLTN_CAM_RecSta_TML = 0x%X", $BLTN_CAM_RecSta_TML);
  write("  BLTN_CAM_RecSta_MAR = 0x%X", $BLTN_CAM_RecSta_MAR);
  CaptureGraphics("BLTN_CAM_RecSta_MAR;BLTN_CAM_RecSta_TML;AIN;BLTN_CAM_HU_UI_Mode;SMK_TrmnlCtrlGrpStaBDC");

  if(step2_passed == 1)
  {
    testStepPass("Step2", "BLTN_CAM_RecSta_MAR = 0x1 (Recording) after Evt Switch - PASS");
  }
  else
  {
    testStepFail("Step2", "BLTN_CAM_RecSta_MAR Recording NOT detected after Evt Switch - FAIL");
  }
}

testcase OWD_030_3_4()
{
  //============================================================================
  // STEP 3 & 4: Log - Check Video (Manual)
  //============================================================================
  write("");
  write("=================================================================");
  write("=== STEP 3 & 4: Check Video (Manual)                        ===");
  write("=================================================================");
  testStep("Step3_4", "Check video - manual verification");

  write("");
  write("*************************************************************");
  write("*** STEP 3 & 4: LOG INFORMATION ***");
  write("*** Please check the recorded video on the device ***");
  write("*** Verify video content is correct ***");
  write("*** Include video verification result in the test report ***");
  write("*************************************************************");
  write("");

  testStepPass("Step3_4", "Check video logged - Manual video verification required");
}

testcase OWD_030_5()
{
  int result = 0;

  //============================================================================
  // STEP 5: Wait 1 minute, SMK OFF, wait 2s, SMK IGN again
  //         Check BLTN_CAM_RecSta_TML = 0x0 (OFF), Screenshot
  //============================================================================
  write("");
  write("=================================================================");
  write("=== STEP 5: Wait 1 min + SMK OFF + Wait 2s + SMK IGN        ===");
  write("===         Check RecSta_TML = 0x0 (OFF) + Screenshot       ===");
  write("=================================================================");
  testStep("Step5", "Wait 1min + SMK OFF + Wait 2s + SMK IGN + TML OFF check + Screenshot");

  // 5.1 Wait 1 minute (60 seconds)
  write("[5.1] Waiting 1 minute (60 seconds)...");
  testWaitForTimeout(60000);
  write("  1 minute elapsed.");

  // 5.2 Log current status before SMK OFF
  write("[5.2] Current status before SMK OFF:");
  write("  BLTN_CAM_RecSta_TML = 0x%X", $BLTN_CAM_RecSta_TML);
  write("  BLTN_CAM_RecSta_MAR = 0x%X", $BLTN_CAM_RecSta_MAR);
  Get_AIN_Voltage();

  // 5.3 Set SMK to OFF via panel combo box
  write("[5.3] Setting SMK_Signal to OFF via panel...");
  Set_SMK_OFF();

  // 5.4 Wait 2 seconds (as specified)
  write("[5.4] Waiting 2 seconds after SMK OFF...");
  testWaitForTimeout(2000);
  write("  2 seconds elapsed after SMK OFF.");

  // 5.5 Set SMK to IGN again via panel combo box
  write("[5.5] Setting SMK_Signal to IGN via panel again...");
  Set_SMK_IGN();
  testWaitForTimeout(3000);

  // 5.6 Check BLTN_CAM_RecSta_TML = 0x0 (OFF)
  write("[5.6] Checking BLTN_CAM_RecSta_TML = 0x0 (OFF)...");
  testWaitForTimeout(3000);  // Extra delay for signal stabilization after IGN ON
  result = Check_RecSta_TML_OFF();

  if(result == 1)
  {
    step5_passed = 1;
    write(">>> Step 5: PASS - BLTN_CAM_RecSta_TML = 0x0 (OFF) after IGN OFF/ON <<<");
  }
  else
  {
    step5_passed = 0;
    write(">>> Step 5: FAIL - BLTN_CAM_RecSta_TML is NOT OFF after IGN OFF/ON <<<");
  }

  // 5.7 Read AIN voltage
  write("[5.7] Reading AIN voltage...");
  Get_AIN_Voltage();

  // 5.8 Capture screenshot
  write("[5.8] Capturing screenshot...");
  write("  BLTN_CAM_RecSta_TML = 0x%X", $BLTN_CAM_RecSta_TML);
  write("  BLTN_CAM_RecSta_MAR = 0x%X", $BLTN_CAM_RecSta_MAR);
  write("  SMK_TrmnlCtrlGrpStaBDC = 0x%X", $SMK_TrmnlCtrlGrpStaBDC);
  CaptureGraphics("BLTN_CAM_RecSta_TML;BLTN_CAM_RecSta_MAR;AIN;BLTN_CAM_HU_UI_Mode;SMK_TrmnlCtrlGrpStaBDC");

  if(step5_passed == 1)
  {
    testStepPass("Step5", "BLTN_CAM_RecSta_TML = 0x0 (OFF) after IGN OFF/ON cycle - PASS");
  }
  else
  {
    testStepFail("Step5", "BLTN_CAM_RecSta_TML is NOT OFF after IGN OFF/ON cycle - FAIL");
  }
}

testcase OWD_030_6()
{
  //============================================================================
  // STEP 6: Log - Check Video (Manual)
  //============================================================================
  write("");
  write("=================================================================");
  write("=== STEP 6: Check Video (Manual)                            ===");
  write("=================================================================");
  testStep("Step6", "Check video - manual verification");

  write("");
  write("*************************************************************");
  write("*** STEP 6: LOG INFORMATION ***");
  write("*** Please check the recorded video on the device ***");
  write("*** Verify video content is correct after IGN OFF/ON ***");
  write("*** Include video verification result in the test report ***");
  write("*************************************************************");
  write("");

  testStepPass("Step6", "Check video logged - Manual video verification required");
}

testcase OWD_030_Summary()
{
  //============================================================================
  // Overall Test Verdict
  //============================================================================
  if(step1_passed == 1 && step2_passed == 1 && step5_passed == 1)
  {
    testStepPass("Overall_Verdict", "Test OWD_030: PASS");
    write("=== OVERALL VERDICT: PASS ===");
  }
  else
  {
    testStepFail("Overall_Verdict", "Test OWD_030: FAIL");
    write("=== OVERALL VERDICT: FAIL ===");
  }

  //============================================================================
  // TEST COMPLETE - Cleanup
  //============================================================================
  write("");
  write("========================================");
  write("=== TEST OWD_030 COMPLETE ===");
  write("========================================");

  // Cleanup: KEY OFF
  write("=== Cleanup: KEY OFF ===");
  setSignal(SMK_TrmnlCtrlGrpStaBDC, 0x0);  // KEY OFF
  testWaitForTimeout(2000);
  @panel::Switch_CGWNM = 0;

  // Final status
  write("");
  write("=== FINAL STATUS ===");
  write("  SMK_TrmnlCtrlGrpStaBDC = 0x%X", $SMK_TrmnlCtrlGrpStaBDC);
  write("  BLTN_CAM_RecSta_TML = 0x%X", $BLTN_CAM_RecSta_TML);
  write("  BLTN_CAM_RecSta_MAR = 0x%X", $BLTN_CAM_RecSta_MAR);
  write("  BLTN_CAM_HU_UI_Mode = 0x%X", $BLTN_CAM_HU_UI_Mode);

  write("");
  write("=== TEST SUMMARY ===");
  if(step1_passed == 1)
    write("Step 1: SMK IGN + USM Reset + Rec Reset + TML Start + TML ON + Wait 5s [Screenshot AIN] - PASS");
  else
    write("Step 1: SMK IGN + USM Reset + Rec Reset + TML Start + TML ON + Wait 5s [Screenshot AIN] - FAIL");

  if(step2_passed == 1)
    write("Step 2: Evt Switch + MAR Recording + Wait 15s [Screenshot AIN] - PASS");
  else
    write("Step 2: Evt Switch + MAR Recording + Wait 15s [Screenshot AIN] - FAIL");

  write("Step 3 & 4: Check video [Manual - Include in Report] - PASS");

  if(step5_passed == 1)
    write("Step 5: Wait 1min + SMK OFF + Wait 2s + SMK IGN + TML OFF [Screenshot] - PASS");
  else
    write("Step 5: Wait 1min + SMK OFF + Wait 2s + SMK IGN + TML OFF [Screenshot] - FAIL");

  write("Step 6: Check video [Manual - Include in Report] - PASS");
}

void MainTest()
{
  testReportFileName("TestReports\\OWD_030 - 2.0 generation_report");

  //write("Run Rec_Reset()"); Rec_Reset();

  OWD_030_Init();
  OWD_030_1();
  OWD_030_2();
  OWD_030_3_4();
  OWD_030_5();
  OWD_030_6();
  OWD_030_Summary();
}
