/*@!Encoding:65001*/
includes { #include "../DeclarationFunction_Gen2.5.h" }

/*
  Test Case: OWD_030
  Title: [TML + MAR Recording Test - TML Start in AVN + Evt Switch + IGN OFF/ON TML Stop]
  Verification items:
    - Step 1: SMK IGN + USM Reset + Rec Reset + AVN mode + TML Start
              Check BLTN_CAM_RecSta_TML = 0x1 (ON), wait 5s, Screenshot (include AIN)
    - Step 2: Click Evt Switch
              Check BLTN_CAM_RecSta_MAR = 0x1 (Recording), wait 15s, Screenshot (include AIN)
    - Step 3, 4: Log - check video (manual)
    - Step 5: Wait 1 minute, SMK OFF, wait 2s, SMK IGN again
              Check BLTN_CAM_RecSta_TML = 0x0 (OFF), Screenshot
    - Step 6: Log - check video (manual)

  Preconditions:
    - ACC and IGN and ccNC/ccIC switch OFF, AVN mode

  NOTE: Uses 2-5s delay for signal propagation after each state transition.
*/

variables
{
  long max_wait_time_10s = 10000;   // 10 seconds timeout

  // Message declarations for CAN FD
  message HU_BLTN_CAM_PE_00_200ms _HU_BLTN_CAM_PE_00_200ms;
  message HU_BLTN_CAM_E_01 _HU_BLTN_CAM_E_01;
  message HU_CLOCK_PE_02 _HU_CLOCK_PE_02;

  // Result tracking variables
  int step1_passed = 0;
  int step2_passed = 0;
  int step5_passed = 0;

}

// ============================================================================
// Main Test Case
// ============================================================================

testcase OWD_030_Init()
{
  Send_Value_To_COM(13000);
  write("========================================");
  write("=== START TEST OWD_030 ===");
  write("=== TML + MAR Recording Test        ===");
  write("=== TML AVN + Evt Switch +          ===");
  write("=== IGN OFF/ON TML Stop             ===");
  write("========================================");
  Send_Value_To_COM(44);
}

testcase OWD_030_1()
{
  int result = 0;

  //============================================================================
  // STEP 1: Set SMK IGN, USM Reset, Rec Reset, AVN mode,
  //         Click TML Start, Check BLTN_CAM_RecSta_TML = 0x1 (ON)
  //         Wait 5s, Screenshot (include AIN)
  //============================================================================
  Send_Value_To_COM(13001);
  SetTestStep("Buoc 1 - OWD_030");
  StartTestTimer();

  write("");
  write("=================================================================");
  write("=== STEP 1: SMK IGN + USM Reset + Rec Reset + AVN mode      ===");
  write("===         TML Start + Check RecSta_TML = 0x1 (ON)         ===");
  write("===         Wait 5s + Screenshot (include AIN)               ===");
  write("=================================================================");
  testStep("Step1", "SMK IGN + USM Reset + Rec Reset + AVN + TML Start + TML ON + Screenshot");

  // 1.1 Set SMK to IGN via panel combo box
  write("[1.1] Setting SMK_Signal to IGN via panel...");
  Set_SMK_IGN();
  testWaitForTimeout(3000);

  // 1.2 Click USM Reset button
  write("[1.2] Clicking USM Reset button...");
  Click_USM_Reset();
  testWaitForTimeout(2000);

  // 1.3 Click Rec Reset button
  write("[1.3] Clicking Rec Reset button...");
  Click_Rec_Reset();
  testWaitForTimeout(2000);

  // 1.4 Ensure AVN mode (Exit BLTN_CAM if needed)
  write("[1.4] Ensuring AVN mode...");
  Exit_BLTN_CAM();
  testWaitForTimeout(2000);
  write("  HU_BLTN_CAM_UI_Mode = 0x%X (AVN mode)", $BLTN_CAM_HU_UI_Mode);

  // 1.5 Click TML Start on panel
  write("[1.5] Clicking TML Start on panel...");
  Click_TML_Start();

  // 1.6 Check BLTN_CAM_RecSta_TML = 0x1 (ON)
  write("[1.6] Checking BLTN_CAM_RecSta_TML = 0x1 (ON)...");
  result = WaitFor_RecSta_TML_Recording(max_wait_time_10s);

  if(result == 1)
  {
    step1_passed = 1;
    write(">>> Step 1: PASS - BLTN_CAM_RecSta_TML = 0x1 (ON) <<<");
  }
  else
  {
    step1_passed = 0;
    write(">>> Step 1: FAIL - BLTN_CAM_RecSta_TML did NOT turn ON <<<");
  }

  // 1.7 Wait 5 seconds
  write("[1.7] Waiting 5 seconds...");
  testWaitForTimeout(5000);
  write("  5 seconds elapsed.");

  // 1.8 Read AIN voltage
  write("[1.8] Reading AIN voltage...");
  Get_AIN_Voltage();

  // 1.9 Capture screenshot (include AIN)
  write("[1.9] Capturing screenshot...");
  write("  BLTN_CAM_RecSta_TML = 0x%X", $BLTN_CAM_RecSta_TML);
  write("  BLTN_CAM_RecSta_MAR = 0x%X", $BLTN_CAM_RecSta_MAR);
  CaptureGraphics("OWD", "BLTN_CAM_RecSta_TML;BLTN_CAM_RecSta_MAR;AIN;BLTN_CAM_HU_UI_Mode;SMK_TrmnlCtrlGrpStaBDC");

  if(step1_passed == 1)
  {
    testStepPass("Step1", "BLTN_CAM_RecSta_TML = 0x1 (ON) after TML Start in AVN - PASS");
  }
  else
  {
    write(">>> FAIL REASON: BLTN_CAM_RecSta_TML did NOT turn ON after TML Start <<<");
    Log_Error_Details();
    testStepFail("Step1", "BLTN_CAM_RecSta_TML did NOT turn ON after TML Start - FAIL");
  }
  StopTestTimer();
  Send_Value_To_COM(44);
}

testcase OWD_030_2()
{
  int result = 0;

  //============================================================================
  // STEP 2: Click Evt Switch
  //         Check BLTN_CAM_RecSta_MAR = 0x1 (Recording)
  //         Wait 15s, Screenshot (include AIN)
  //============================================================================
  Send_Value_To_COM(13002);
  SetTestStep("Buoc 2 - OWD_030");
  StartTestTimer();

  write("");
  write("=================================================================");
  write("=== STEP 2: Evt Switch + Check RecSta_MAR = 0x1 (Recording) ===");
  write("===         Wait 15s + Screenshot (include AIN)              ===");
  write("=================================================================");
  testStep("Step2", "Evt Switch + MAR Recording + Wait 15s + Screenshot");

  // 2.1 Click Evt Switch button on panel
  write("[2.1] Clicking Evt Switch button on panel...");
  Click_Evt_Switch();

  // 2.2 Check BLTN_CAM_RecSta_MAR = 0x1 (Recording) within 10s
  write("[2.2] Checking BLTN_CAM_RecSta_MAR = 0x1 (Recording)...");
  result = WaitFor_RecSta_MAR_Recording(max_wait_time_10s);

  if(result == 1)
  {
    step2_passed = 1;
    write(">>> Step 2: PASS - BLTN_CAM_RecSta_MAR = 0x1 (Recording) <<<");
  }
  else
  {
    step2_passed = 0;
    write(">>> Step 2: FAIL - BLTN_CAM_RecSta_MAR Recording NOT detected <<<");
  }

  // 2.3 Wait 15 seconds
  write("[2.3] Waiting 15 seconds...");
  testWaitForTimeout(15000);
  write("  15 seconds elapsed.");

  // 2.4 Read AIN voltage
  write("[2.4] Reading AIN voltage...");
  Get_AIN_Voltage();

  // 2.5 Capture screenshot (include AIN)
  write("[2.5] Capturing screenshot...");
  write("  BLTN_CAM_RecSta_TML = 0x%X", $BLTN_CAM_RecSta_TML);
  write("  BLTN_CAM_RecSta_MAR = 0x%X", $BLTN_CAM_RecSta_MAR);
  CaptureGraphics("OWD", "BLTN_CAM_RecSta_MAR;BLTN_CAM_RecSta_TML;AIN;BLTN_CAM_HU_UI_Mode;SMK_TrmnlCtrlGrpStaBDC");

  if(step2_passed == 1)
  {
    testStepPass("Step2", "BLTN_CAM_RecSta_MAR = 0x1 (Recording) after Evt Switch - PASS");
  }
  else
  {
    write(">>> FAIL REASON: BLTN_CAM_RecSta_MAR Recording NOT detected after Evt Switch <<<");
    Log_Error_Details();
    testStepFail("Step2", "BLTN_CAM_RecSta_MAR Recording NOT detected after Evt Switch - FAIL");
  }
  StopTestTimer();
  Send_Value_To_COM(44);
}

testcase OWD_030_3_4()
{
  //============================================================================
  // STEP 3 & 4: Log - Check Video (Manual)
  //============================================================================
  Send_Value_To_COM(13003);
  write("");
  write("=================================================================");
  write("=== STEP 3 & 4: Check Video (Manual)                        ===");
  write("=================================================================");
  testStep("Step3_4", "Check video - manual verification");

  write("");
  write("*************************************************************");
  write("*** STEP 3 & 4: LOG INFORMATION ***");
  write("*** Please check the recorded video on the device ***");
  write("*** Verify video content is correct ***");
  write("*** Include video verification result in the test report ***");
  write("*************************************************************");
  write("");

  testStepPass("Step3_4", "Check video logged - Manual video verification required");
  Send_Value_To_COM(44);
}

testcase OWD_030_5()
{


  int result = 0;
  Click_TML_Stop();
  testWaitForTimeout(6000);
  Click_TML_Start();
  //============================================================================
  // STEP 5: Wait 1 minute, SMK OFF, wait 2s, SMK IGN again
  //         Check BLTN_CAM_RecSta_TML = 0x0 (OFF), Screenshot
  //============================================================================
  Send_Value_To_COM(13005);
  SetTestStep("Buoc 5 - OWD_030");
  StartTestTimer();

  write("");
  write("=================================================================");
  write("=== STEP 5: Wait 1 min + SMK OFF + Wait 2s + SMK IGN        ===");
  write("===         Check RecSta_TML = 0x0 (OFF) + Screenshot       ===");
  write("=================================================================");
  testStep("Step5", "Wait 1min + SMK OFF + Wait 2s + SMK IGN + TML OFF check + Screenshot");

  // 5.1 Wait 1 minute (60 seconds)
  write("[5.1] Waiting 1 minute (60 seconds)...");
  testWaitForTimeout(60000);
  write("  1 minute elapsed.");

  // 5.2 Log current status before SMK OFF
  write("[5.2] Current status before SMK OFF:");
  write("  BLTN_CAM_RecSta_TML = 0x%X", $BLTN_CAM_RecSta_TML);
  write("  BLTN_CAM_RecSta_MAR = 0x%X", $BLTN_CAM_RecSta_MAR);
  Get_AIN_Voltage();

  // 5.3 Set SMK to OFF via panel combo box
  write("[5.3] Setting SMK_Signal to OFF via panel...");
  Set_SMK_OFF();

  // 5.4 Wait 2 seconds (as specified)
  write("[5.4] Waiting 2 seconds after SMK OFF...");
  testWaitForTimeout(2000);
  write("  2 seconds elapsed after SMK OFF.");

  // 5.5 Set SMK to IGN again via panel combo box
  write("[5.5] Setting SMK_Signal to IGN via panel again...");
  Set_SMK_IGN();
  testWaitForTimeout(3000);

  // 5.6 Check BLTN_CAM_RecSta_TML = 0x0 (OFF)
  write("[5.6] Checking BLTN_CAM_RecSta_TML = 0x0 (OFF)...");
  testWaitForTimeout(3000);  // Extra delay for signal stabilization after IGN ON
  result = Check_RecSta_TML_OFF();

  if(result == 1)
  {
    step5_passed = 1;
    write(">>> Step 5: PASS - BLTN_CAM_RecSta_TML = 0x0 (OFF) after IGN OFF/ON <<<");
  }
  else
  {
    step5_passed = 0;
    write(">>> Step 5: FAIL - BLTN_CAM_RecSta_TML is NOT OFF after IGN OFF/ON <<<");
  }

  // 5.7 Read AIN voltage
  write("[5.7] Reading AIN voltage...");
  Get_AIN_Voltage();

  // 5.8 Capture screenshot
  write("[5.8] Capturing screenshot...");
  write("  BLTN_CAM_RecSta_TML = 0x%X", $BLTN_CAM_RecSta_TML);
  write("  BLTN_CAM_RecSta_MAR = 0x%X", $BLTN_CAM_RecSta_MAR);
  write("  SMK_TrmnlCtrlGrpStaBDC = 0x%X", $SMK_TrmnlCtrlGrpStaBDC);
  CaptureGraphics("OWD", "BLTN_CAM_RecSta_TML;BLTN_CAM_RecSta_MAR;AIN;BLTN_CAM_HU_UI_Mode;SMK_TrmnlCtrlGrpStaBDC");

  if(step5_passed == 1)
  {
    testStepPass("Step5", "BLTN_CAM_RecSta_TML = 0x0 (OFF) after IGN OFF/ON cycle - PASS");
  }
  else
  {
    write(">>> FAIL REASON: BLTN_CAM_RecSta_TML is NOT OFF after IGN OFF/ON cycle <<<");
    Log_Error_Details();
    testStepFail("Step5", "BLTN_CAM_RecSta_TML is NOT OFF after IGN OFF/ON cycle - FAIL");
  }
  StopTestTimer();
  Send_Value_To_COM(44);
}

testcase OWD_030_6()
{
  //============================================================================
  // STEP 6: Log - Check Video (Manual)
  //============================================================================
  Send_Value_To_COM(13006);
  SetTestStep("Buoc 6 - OWD_030");
  StartTestTimer();

  write("");
  write("=================================================================");
  write("=== STEP 6: Check Video (Manual)                            ===");
  write("=================================================================");
  testStep("Step6", "Check video - manual verification");

  write("");
  write("*************************************************************");
  write("*** STEP 6: LOG INFORMATION ***");
  write("*** Please check the recorded video on the device ***");
  write("*** Verify video content is correct after IGN OFF/ON ***");
  write("*** Include video verification result in the test report ***");
  write("*************************************************************");
  write("");

  testStepPass("Step6", "Check video logged - Manual video verification required");

  write("[Capture] Wait 5 seconds before screenshot");
  testWaitForTimeout(5000);
  CaptureGraphics("OWD", "BLTN_CAM_RecSet_OWD;BLTN_CAM_RecSta_OWD;BLTN_CAM_RecSet_DEV;BLTN_CAM_RecSta_DEV;BLTN_CAM_RecSta_MAR");
  StopTestTimer();
  Send_Value_To_COM(44);
}


void MainTest()
{
  testReportFileName("TestReports\\OWD_030 - 2.5 generation_report");

  //write("Run Rec_Reset()"); Rec_Reset();

  OWD_030_Init();
  OWD_030_1();
  OWD_030_2();
  OWD_030_3_4();
  OWD_030_5();
  OWD_030_6();
}
