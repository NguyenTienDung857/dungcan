/*@!Encoding:65001*/

includes
{
  #include "DeclarationFunction_OWP_Gen2.h"
}

/*
  Test Case: OWP_001 - 2.0 (OWP_001)
  Title: [OWP Initial Value Check after Factory->Customer mode & PEV Sensitivity/PrkTime Verification]

  Preconditions:
    - ACC and IGN and ccNC/ccIC switch OFF, AVN mode
    - ICUPowerAutoCutModSta = 0x0 (Factory mode)

  Step 1: KEY ON (IGN), USM Reset, Rec Reset, change Factory->Customer mode,
          log event notifications, capture screenshot of related signals
  Step 2: Log notification - manual reset required
  Step 3: Check BLTN_CAM_SenSet_PEV = 0x3 (Lv.3), capture screenshot
  Step 4: Check BLTN_CAM_Set_PrkTime = 0xC (20Hr), range 0x1~0x14 (1Hr~20Hr) is OK
  Step 5: KEY OFF, check BLTN_CAM_RecSta_OWD = 0x0 (OFF)
  Step 6: Log notification - LED blinking verification (manual)
  Step 7: Log notification - LED blinking verification (manual)

  NOTE: Uses 2-5s delay for signal propagation after each state transition.
*/

variables
{
  // Global Variable Declaration
  int flag_RecSet_error = 0;
  long max_wait_time = 180000; // 180 seconds = 3 minutes max wait

  // Result tracking
  int step1_passed = 0;
  int step2_passed = 0;
  int step3_passed = 0;
  int step4_passed = 0;
  int step5_passed = 0;
  int step6_passed = 0;
  int step7_passed = 0;

  // Message Declaration for CAN
  message HU_BLTN_CAM_PE_00_200ms _HU_BLTN_CAM_PE_00_200ms;
  message HU_BLTN_CAM_E_00 _HU_BLTN_CAM_E_00;
  message HU_BLTN_CAM_E_01 _HU_BLTN_CAM_E_01;
  message HU_CLOCK_PE_02 _HU_CLOCK_PE_02;
}

// ============================================================================
// Utility Functions (file-specific)
// ============================================================================

// Log all event notification signals
void Log_Event_Notifications()
{
  write("");
  write("=== Event Notification Signal Values ===");
  write("  BLTN_CAM_RecSet_OWD   = 0x%X", $BLTN_CAM_RecSet_OWD);
  write("  BLTN_CAM_RecSet_OWP   = 0x%X", $BLTN_CAM_RecSet_OWP);
  write("  BLTN_CAM_RecSet_DEV   = 0x%X", $BLTN_CAM_RecSet_DEV);
  write("  BLTN_CAM_RecSet_PEV   = 0x%X", $BLTN_CAM_RecSet_PEV);
  write("  BLTN_CAM_RecSta_OWD   = 0x%X", $BLTN_CAM_RecSta_OWD);
  write("  BLTN_CAM_RecSta_OWP   = 0x%X", $BLTN_CAM_RecSta_OWP);
  write("  BLTN_CAM_SenSet_PEV   = 0x%X", $BLTN_CAM_SenSet_PEV);
  write("  BLTN_CAM_SenSet_DEV   = 0x%X", $BLTN_CAM_SenSet_DEV);
  write("  BLTN_CAM_Set_PrkTime  = 0x%X", $BLTN_CAM_Set_PrkTime);
  write("  BLTN_CAM_State        = 0x%X", $BLTN_CAM_State);
  write("  ICU_PowerAutoCutModSta = 0x%X", $ICU_PowerAutoCutModSta);
  write("  SMK_TrmnlCtrlGrpStaBDC = 0x%X", $SMK_TrmnlCtrlGrpStaBDC);
  write("========================================");
  write("");
}


// ============================================================================
// Test Cases
// ============================================================================

testcase OWP_001_Init()
{
  write("========================================");
  write("=== START TEST OWP_001 - 2.0 ===");
  write("========================================");
  testStep("Notification", "Start test OWP_001 - 2.0");
}

testcase OWP_001_Step1()
{
  //============================================================================
  // STEP 1: KEY ON (IGN), USM Reset, Rec Reset,
  //         Factory mode -> Customer mode, log event notifications, capture screenshot
  //============================================================================
  write("");
  write("=== STEP 1: KEY ON (IGN), USM Reset, Rec Reset, Factory->Customer mode ===");
  testStep("Step1", "KEY ON, USM Reset, Rec Reset, Factory->Customer mode");

  // 1.1: Set SMK to IGN
  write("");
  write("Step 1.1: Setting SMK_Signal to IGN...");
  Set_SMK_IGN();

  // 1.2: Click USM Reset
  write("");
  write("Step 1.2: Clicking USM Reset...");
  Click_USM_Reset();

  // 1.3: Click Rec Reset
  write("");
  write("Step 1.3: Clicking Rec Reset...");
  Click_Rec_Reset();

  // 1.4: Set to Factory mode (0x0)
  write("");
  write("Step 1.4: Setting to Factory mode (0x0)...");
  if(Set_PowerAutoCut_Mode(0x0, 30000) == 0)
  {
    write(">>> FAILED to set Factory mode <<<");
    testStepFail("Step1.4", "Failed to set Factory mode");
  }
  else
  {
    testStepPass("Step1.4", "Factory mode set successfully");
  }
  testWaitForTimeout(3000);

  // 1.5: Set to Customer mode (0x2)
  write("");
  write("Step 1.5: Setting to Customer mode (0x2)...");
  if(Set_PowerAutoCut_Mode(0x2, 30000) == 0)
  {
    write(">>> FAILED to set Customer mode <<<");
    testStepFail("Step1.5", "Failed to set Customer mode");
  }
  else
  {
    testStepPass("Step1.5", "Customer mode set successfully");
  }
  testWaitForTimeout(3000);

  // 1.6: Verify Customer mode
  write("");
  write("Step 1.6: Verifying Customer mode...");
  if(Verify_PowerAutoCut_Mode(0x2) == 0)
  {
    testStepFail("Step1.6", "PowerAutoCutMode verification failed");
  }
  else
  {
    testStepPass("Step1.6", "PowerAutoCutMode = Customer mode (0x2)");
  }

  testWaitForTimeout(3000);

  // 1.7: Log event notification values
  write("");
  write("Step 1.7: Logging event notification values...");
  Log_Event_Notifications();

  // 1.8: Capture screenshot of related signals
  write("");
  write("Step 1.8: Capturing screenshot of related signals...");
  CaptureGraphics("ICU_PowerAutoCutModSta;BLTN_CAM_RecSet_OWD;BLTN_CAM_RecSet_OWP;BLTN_CAM_RecSet_PEV;BLTN_CAM_SenSet_PEV;BLTN_CAM_Set_PrkTime;BLTN_CAM_State");

  step1_passed = 1;
  testStepPass("Step1", "KEY ON, USM/Rec Reset, Factory->Customer mode - PASS");
  write("=== FINISH STEP 1 ===");
}

testcase OWP_001_Step2()
{
  //============================================================================
  // STEP 2: Log notification - manual reset required
  //============================================================================
  write("");
  write("=== STEP 2: Manual Reset Required ===");
  testStep("Step2", "Manual reset notification");

  write("");
  write("*************************************************************");
  write("*** [ACTION REQUIRED - MANUAL RESET] ***");
  write("*** Please perform manual reset on the device. ***");
  write("*** Perform FRS reset: ***");
  write("*** [ccNC Settings] - [General] - [Reset] ***");
  write("*** - [Delete Guest Profile/Reset Entire System] ***");
  write("*** Then press Continue in CANoe Test Module ***");
  write("*************************************************************");
  write("");

  // Wait for user to perform manual reset (max 5 minutes)
  testWaitForTimeout(5000);

  write(">>> Waiting for manual reset confirmation... <<<");
  write(">>> Current signal values after reset: <<<");
  Log_Event_Notifications();

  CaptureGraphics("ICU_PowerAutoCutModSta;BLTN_CAM_RecSet_OWD;BLTN_CAM_RecSet_OWP;BLTN_CAM_RecSet_PEV;BLTN_CAM_SenSet_PEV;BLTN_CAM_Set_PrkTime");

  step2_passed = 1;
  testStepPass("Step2", "Manual reset notification logged - PASS");
  write("=== FINISH STEP 2 ===");
}

testcase OWP_001_Step3()
{
  //============================================================================
  // STEP 3: Check BLTN_CAM_SenSet_PEV = 0x3 (Lv.3), capture screenshot
  //============================================================================
  write("");
  write("=== STEP 3: Check BLTN_CAM_SenSet_PEV = 0x3 (Lv.3) ===");
  testStep("Step3", "Check PEV Sensitivity Level");

  testWaitForTimeout(3000);

  write("Reading BLTN_CAM_SenSet_PEV...");
  write("BLTN_CAM_SenSet_PEV = 0x%X", $BLTN_CAM_SenSet_PEV);

  CaptureGraphics("BLTN_CAM_SenSet_PEV;BLTN_CAM_RecSet_PEV;BLTN_CAM_Set_PrkTime;BLTN_CAM_State");

  if($BLTN_CAM_SenSet_PEV == 0x3)
  {
    write(">>> PASS: BLTN_CAM_SenSet_PEV = 0x3 (Lv.3) <<<");
    step3_passed = 1;
    testStepPass("Step3", "BLTN_CAM_SenSet_PEV = 0x3 (Lv.3) - PASS");
  }
  else
  {
    write(">>> FAIL: BLTN_CAM_SenSet_PEV = 0x%X, expected 0x3 (Lv.3) <<<", $BLTN_CAM_SenSet_PEV);
    step3_passed = 0;
    testStepFail("Step3", "BLTN_CAM_SenSet_PEV = 0x%X, expected 0x3 - FAIL", $BLTN_CAM_SenSet_PEV);
  }

  write("=== FINISH STEP 3 ===");
}

testcase OWP_001_Step4()
{
  //============================================================================
  // STEP 4: Check BLTN_CAM_Set_PrkTime = 0xC (20Hr)
  //         Valid range: 0x1 ~ 0x14 (1Hr ~ 20Hr)
  //============================================================================
  write("");
  write("=== STEP 4: Check BLTN_CAM_Set_PrkTime = 0xC (20Hr) ===");
  testStep("Step4", "Check Parking Time Setting");

  testWaitForTimeout(3000);

  write("Reading BLTN_CAM_Set_PrkTime...");
  write("BLTN_CAM_Set_PrkTime = 0x%X", $BLTN_CAM_Set_PrkTime);

  CaptureGraphics("BLTN_CAM_Set_PrkTime;BLTN_CAM_RecSet_OWP;BLTN_CAM_SenSet_PEV;BLTN_CAM_State");

  // Check if PrkTime = 0xC (20Hr)
  if($BLTN_CAM_Set_PrkTime == 0xC)
  {
    write(">>> PASS: BLTN_CAM_Set_PrkTime = 0xC (20Hr) <<<");
  }
  else
  {
    write(">>> INFO: BLTN_CAM_Set_PrkTime = 0x%X (expected 0xC for 20Hr) <<<", $BLTN_CAM_Set_PrkTime);
  }

  // Check if PrkTime is in valid range 0x1 ~ 0x14 (1Hr ~ 20Hr)
  if($BLTN_CAM_Set_PrkTime >= 0x1 && $BLTN_CAM_Set_PrkTime <= 0x14)
  {
    write(">>> PASS: BLTN_CAM_Set_PrkTime = 0x%X is in valid range 0x1~0x14 (1Hr~20Hr) <<<", $BLTN_CAM_Set_PrkTime);
    step4_passed = 1;
    testStepPass("Step4", "BLTN_CAM_Set_PrkTime = 0x%X in range 0x1~0x14 - PASS", $BLTN_CAM_Set_PrkTime);
  }
  else
  {
    write(">>> FAIL: BLTN_CAM_Set_PrkTime = 0x%X is OUT of valid range 0x1~0x14 <<<", $BLTN_CAM_Set_PrkTime);
    step4_passed = 0;
    testStepFail("Step4", "BLTN_CAM_Set_PrkTime = 0x%X out of range - FAIL", $BLTN_CAM_Set_PrkTime);
  }

  write("=== FINISH STEP 4 ===");
}

testcase OWP_001_Step5()
{
  //============================================================================
  // STEP 5: KEY OFF, check BLTN_CAM_RecSta_OWD = 0x0 (OFF)
  //============================================================================
  write("");
  write("=== STEP 5: KEY OFF, check BLTN_CAM_RecSta_OWD = 0x0 (OFF) ===");
  testStep("Step5", "KEY OFF, check RecSta_OWD = OFF");

  write("Setting KEY OFF...");
  KEY_OFF();
  testWaitForTimeout(5000);

  write("Reading BLTN_CAM_RecSta_OWD...");
  write("BLTN_CAM_RecSta_OWD = 0x%X", $BLTN_CAM_RecSta_OWD);

  CaptureGraphics("BLTN_CAM_RecSta_OWD;BLTN_CAM_RecSet_OWD;SMK_TrmnlCtrlGrpStaBDC;BLTN_CAM_State");

  if($BLTN_CAM_RecSta_OWD == 0x0)
  {
    write(">>> PASS: BLTN_CAM_RecSta_OWD = 0x0 (OFF) <<<");
    step5_passed = 1;
    testStepPass("Step5", "BLTN_CAM_RecSta_OWD = 0x0 (OFF) - PASS");
  }
  else
  {
    write(">>> FAIL: BLTN_CAM_RecSta_OWD = 0x%X, expected 0x0 (OFF) <<<", $BLTN_CAM_RecSta_OWD);
    step5_passed = 0;
    testStepFail("Step5", "BLTN_CAM_RecSta_OWD = 0x%X, expected 0x0 - FAIL", $BLTN_CAM_RecSta_OWD);
  }

  write("=== FINISH STEP 5 ===");
}

testcase OWP_001_Step6()
{
  //============================================================================
  // STEP 6: Log notification - LED blinking verification (manual)
  //============================================================================
  write("");
  write("=== STEP 6: LED Blinking Verification (Manual) ===");
  testStep("Step6", "LED blinking verification");

  write("");
  write("*************************************************************");
  write("*** [MANUAL VERIFICATION REQUIRED] ***");
  write("*** Please check if the LED is blinking on the device. ***");
  write("*** Verify LED behavior visually. ***");
  write("*************************************************************");
  write("");

  Log_Event_Notifications();

  step6_passed = 1;
  testStepPass("Step6", "LED blinking verification logged - PASS");
  write("=== FINISH STEP 6 ===");
}

testcase OWP_001_Step7()
{
  //============================================================================
  // STEP 7: Log notification - LED blinking verification (manual)
  //============================================================================
  write("");
  write("=== STEP 7: LED Blinking Verification (Manual) ===");
  testStep("Step7", "LED blinking verification");

  write("");
  write("*************************************************************");
  write("*** [MANUAL VERIFICATION REQUIRED] ***");
  write("*** Please check if the LED is blinking on the device. ***");
  write("*** Verify LED behavior visually. ***");
  write("*************************************************************");
  write("");

  Log_Event_Notifications();

  step7_passed = 1;
  testStepPass("Step7", "LED blinking verification logged - PASS");
  write("=== FINISH STEP 7 ===");
}

testcase OWP_001_Summary()
{
  //============================================================================
  // Overall Test Verdict
  //============================================================================
  if(step1_passed == 1 && step2_passed == 1 && step3_passed == 1 &&
     step4_passed == 1 && step5_passed == 1 && step6_passed == 1 && step7_passed == 1)
  {
    testStepPass("Overall_Verdict", "Test OWP_001 - 2.0: PASS");
    write("=== OVERALL VERDICT: PASS ===");
  }
  else
  {
    testStepFail("Overall_Verdict", "Test OWP_001 - 2.0: FAIL");
    write("=== OVERALL VERDICT: FAIL ===");
  }

  //============================================================================
  // SUMMARY
  //============================================================================
  write("");
  write("=== TEST SUMMARY ===");

  if(step1_passed == 1)
    write("Step 1: KEY ON (IGN), USM Reset, Rec Reset, Factory->Customer mode [Screenshot] => PASS");
  else
    write("Step 1: KEY ON (IGN), USM Reset, Rec Reset, Factory->Customer mode [Screenshot] => FAIL");

  if(step2_passed == 1)
    write("Step 2: Manual reset notification [Log] => PASS");
  else
    write("Step 2: Manual reset notification [Log] => FAIL");

  if(step3_passed == 1)
    write("Step 3: BLTN_CAM_SenSet_PEV = 0x3 (Lv.3) [Screenshot] => PASS");
  else
    write("Step 3: BLTN_CAM_SenSet_PEV = 0x3 (Lv.3) [Screenshot] => FAIL");

  if(step4_passed == 1)
    write("Step 4: BLTN_CAM_Set_PrkTime in range 0x1~0x14 (1Hr~20Hr) [Screenshot] => PASS");
  else
    write("Step 4: BLTN_CAM_Set_PrkTime in range 0x1~0x14 (1Hr~20Hr) [Screenshot] => FAIL");

  if(step5_passed == 1)
    write("Step 5: KEY OFF, BLTN_CAM_RecSta_OWD = 0x0 (OFF) [Screenshot] => PASS");
  else
    write("Step 5: KEY OFF, BLTN_CAM_RecSta_OWD = 0x0 (OFF) [Screenshot] => FAIL");

  if(step6_passed == 1)
    write("Step 6: LED blinking verification [Log/Manual] => PASS");
  else
    write("Step 6: LED blinking verification [Log/Manual] => FAIL");

  if(step7_passed == 1)
    write("Step 7: LED blinking verification [Log/Manual] => PASS");
  else
    write("Step 7: LED blinking verification [Log/Manual] => FAIL");

  @panel::Switch_CGWNM = 0;

  testStep("Notifications", "Finish OWP_001 - 2.0");
  write("");
  write("========================================");
  write("=== END TEST OWP_001 - 2.0 ===");
  write("========================================");
}

void MainTest()
{
  testReportFileName("TestReports\\OWP_001 - 2.0 generation_report");
  OWP_001_Init();
  OWP_001_Step1();
  OWP_001_Step2();
  OWP_001_Step3();
  OWP_001_Step4();
  OWP_001_Step5();
  OWP_001_Step6();
  OWP_001_Step7();
  OWP_001_Summary();
}
