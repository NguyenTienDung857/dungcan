/*@!Encoding:65001*/
includes { #include "DeclarationFunction_OWP_Gen2.h" }

//Preconditions: - ACC and IGN and ccNC/ccIC switch OFF, AVN mode
//               - Add signal: BLTN_CAM_RecSta_OWP
//               - Remind setting to get log

/*
  Test Case: OWP_003 - 2.0 (OWP_003)
  Title: [OWP Recording Time Setting]

  Step 1_2: OWP ON, set 20h, wait 20h, capture screenshot, OWP OFF
  Step 3  : OWP ON, set 12h, wait 12h, capture screenshot, OWP OFF
  Step 4  : OWP ON, set 6h, wait 6h, capture screenshot, OWP OFF
  Step 5  : OWP ON, set 2h, wait 2h, capture screenshot, OWP OFF
  Step 6  : OWP ON, set 20h with custom time (23:40), wait 1h, capture screenshot, OWP OFF

  NOTE: Uses countdown clock for time simulation.
*/

variables
{ // Global Variable Declaration
  byte time_Hour_value = 0x17;
  byte time_Minute_value = 0x28;
  byte time_Second_value = 0x0;
  int flag_RecSet_error = 0;
  byte check_DisplayYear2_value;
  byte check_DisplayYear1_value;
  byte check_DisplayMonth_value;
  byte check_DisplayDay_value;
  char PLBM_Battery[4] = {'P','L','B','M'};
  char eAGM_Battery[4] = {'E','A','G','M'};
  char answer[4];

  // Result tracking
  int step1_2_passed = 0;
  int step3_passed = 0;
  int step4_passed = 0;
  int step5_passed = 0;
  int step6_passed = 0;

  // Message Declaration for CAN
  message HU_BLTN_CAM_PE_00_200ms _HU_BLTN_CAM_PE_00_200ms;
  message HU_BLTN_CAM_E_00 _HU_BLTN_CAM_E_00;
  message HU_CLOCK_PE_02 _HU_CLOCK_PE_02;
  message HU_BLTN_CAM_E_01 _HU_BLTN_CAM_E_01;
}

int checkBatteryType(char a[], int size)
{
  int i, matchPLBM, matchEAGM;

  matchPLBM = 1;

  matchEAGM = 1;

  for (i = 0; i < size; i++)
  {
    if (a[i] != PLBM_Battery[i])
    {
      matchPLBM = 0;
    }
    if (a[i] != eAGM_Battery[i])
    {
      matchEAGM = 0;
    }
  }

  if (matchPLBM)
    return 1;
  else if (matchEAGM)
    return 2;
  else
    return 0;
}

void Set_Battery(){
  int flag_Timeout;
  int battery_Type;

  flag_Timeout = 0;
  battery_Type = 0;

  @panel::Switch_CGWNM = 1;

  KEY_ON();

  do
  {
    testWaitForStringInput("Please enter kind of battery (PLBM or EAGM):", 300000);

    testGetStringInput(answer, 5);

    write("You entered: %c%c%c%c", answer[0], answer[1], answer[2], answer[3]);

    battery_Type = checkBatteryType(answer,4);

    if(battery_Type == 0){
      write("Invalid input! Please enter 'PLBM' or 'EAGM'.");
    }
  } while(battery_Type == 0);

  switch(battery_Type){
    case(1):
      write("Battery type is PLBM.");
      @ControlPowerSupply::RadioBtn_PwrSplyModel = 1; //Choose model power suplly TL305TP
      @ControlPowerSupply::Numeric_PortNum = 3; //Choose numberic port to connect PC

      if( @ControlPowerSupply::RadioBtn_PwrSplyModel == 1 && @ControlPowerSupply::Numeric_PortNum == 3 ){
        while (@ControlPowerSupply::isConectedPwrSply == 0 && flag_Timeout <= 30){
        @ControlPowerSupply::Button_Connect = 0;
        testWaitForTimeout(1000);
        @ControlPowerSupply::Button_Connect = 1;
        testWaitForTimeout(1000);
        @ControlPowerSupply::Button_Connect = 0;
        flag_Timeout++;
        }
      }
      flag_Timeout = 0;
      break;
    case(2):
      write("Battery type is EAGM.");
      setSignal(ICU_BS2SoC, 0x50); break;
  }

  KEY_OFF();

  @panel::Switch_CGWNM = 0;
}

void Check_time(){
  check_DisplayYear2_value = getSignal(HU_DisplayYear2);
  check_DisplayYear1_value = getSignal(HU_DisplayYear1);
  check_DisplayMonth_value = getSignal(HU_DisplayMonth);
  check_DisplayDay_value = getSignal(HU_DisplayDay);
}

void BLTN_CAM_Settings(int Choose_Option){
  switch (Choose_Option){
    case(1):
      if ($BLTN_CAM_RecSet_OWP == 0x1){
        write("OWP On"); @panel::LED_Ctrl_SetOWP = 1;

        testWaitForTimeout(500);

        write("Set 20h"); @panel::TrackBar_OWP_TIME = 0x14;
      }
      break;
    case(2):
      if ($BLTN_CAM_RecSet_OWP == 0x1){
        write("OWP On"); @panel::LED_Ctrl_SetOWP = 1;

        testWaitForTimeout(500);

        write("Set 12h"); @panel::TrackBar_OWP_TIME = 0xC;
      }
      break;
    case(3):
      if ($BLTN_CAM_RecSet_OWP == 0x1){
        write("OWP On"); @panel::LED_Ctrl_SetOWP = 1;

        testWaitForTimeout(500);

        write("Set 6h"); @panel::TrackBar_OWP_TIME = 0x6;
      }
      break;
    case(4):
      if ($BLTN_CAM_RecSet_OWP == 0x1){
        write("OWP On"); @panel::LED_Ctrl_SetOWP = 1;

        testWaitForTimeout(500);

        write("Set 2h"); @panel::TrackBar_OWP_TIME = 0x2;
      }
      break;
  }
}

void Clock_Down(long CD_time){
  write("=== COUNT DOWN CLOCK === Total: %dh %02dm (%d min)", CD_time/60, CD_time%60, CD_time);
  while (CD_time > 0){
    write("Remaining: %dh %02dm (%d min left)", CD_time/60, CD_time%60, CD_time);
    testWaitForTimeout(60000);
    CD_time--;
  }
  write("=== COUNT DOWN COMPLETE ===");
}

void Set_Time(byte hour, byte min, byte sec, byte day, byte month, byte year1, byte year2){
  // CAN
  _HU_CLOCK_PE_02.HU_TimeFormat=0x2; //24h
  _HU_CLOCK_PE_02.HU_Status = 0x1; //User setting
  _HU_CLOCK_PE_02.HU_TimeSetting = 0x1;
  _HU_CLOCK_PE_02.HU_DisplayHour = hour;
  _HU_CLOCK_PE_02.HU_DisplayMinute = min;
  _HU_CLOCK_PE_02.HU_DisplaySecond = sec;
  _HU_CLOCK_PE_02.HU_DisplayYear1 = year1;
  _HU_CLOCK_PE_02.HU_DisplayYear2 = year2;
  _HU_CLOCK_PE_02.HU_DisplayMonth = month;
  _HU_CLOCK_PE_02.HU_DisplayDay = day;
  _HU_CLOCK_PE_02.HU_ClockInfo = 0x1; //ACLOCK Refresh
  _HU_CLOCK_PE_02.HU_ComRefresh = 0x2; //Internal Clock Exist
  _HU_CLOCK_PE_02.HU_AM_PM_INFO = 0x0; //Not used
  output(_HU_CLOCK_PE_02);
}



void Setup_Function(int Choose_Option){
  write(">>> [Setup] Starting Setup_Function: Choose_Option = %d", Choose_Option);
  write(">>> [Setup] Current: BLTN_CAM_RecSet_OWP = 0x%X", $BLTN_CAM_RecSet_OWP);

  @panel::Switch_CGWNM = 1;

  write(">>> [Setup] KEY_ON (SMK = 0x1)"); KEY_ON();
  testWaitForTimeout(3000);

  do {
    Enter_BLTN_CAM();
    testWaitForTimeout(3000);

    write(">>> [Setup] In BLTN_CAM: BLTN_CAM_RecSet_OWP = 0x%X", $BLTN_CAM_RecSet_OWP);
    BLTN_CAM_Settings(Choose_Option);
    testWaitForTimeout(1000);
    write(">>> [Setup] After settings: BLTN_CAM_RecSet_OWP = 0x%X", $BLTN_CAM_RecSet_OWP);

    @panel::Switch_Clock = 1;

    Exit_BLTN_CAM();
    testWaitForTimeout(3000);
  } while ($BLTN_CAM_RecSet_OWP == 0x1);

  write(">>> [Setup] OWP is ON (0x2) confirmed. KEY_OFF (SMK = 0x0)"); KEY_OFF();
  write(">>> [Setup] Waiting for BLTN_CAM_RecSta_OWP to change (OWP auto-start in parking mode, max 100s)...");

  if (WaitFor_RecSta_OWP_ON(100) == 1){
    write(">>> [OK] BLTN_CAM_RecSta_OWP = 0x1 - OWP recording is in progress!");
  }
  else{
    write(">>> [FAIL] OWP recording has NOT started within 100s.");
    write(">>> [FAIL] BLTN_CAM_RecSta_OWP = 0x%X (expected 0x1)", $BLTN_CAM_RecSta_OWP);

    Setup_End_test();

    KEY_OFF();

    stop();
  }
}

void Setup_End_test(){
  // KEY_ON is required here: OWP runs while KEY is OFF (parking mode).
  // Must KEY_ON to access HU for screenshot and to turn OWP OFF.
  write(">>> [EndTest] KEY_ON to access HU while OWP is recording...");
  KEY_ON();
  testWaitForTimeout(3000);

  write(">>> [EndTest] Current: BLTN_CAM_RecSet_OWP = 0x%X, RecSta_OWP = 0x%X",
        $BLTN_CAM_RecSet_OWP, $BLTN_CAM_RecSta_OWP);

  Enter_BLTN_CAM();
  write("Run CaptureGraphics()"); CaptureGraphics("BLTN_CAM_RecSta_OWP;BLTN_CAM_RecSet_OWP;BLTN_CAM_HU_UI_Mode");

  if ($BLTN_CAM_RecSet_OWP == 0x2){
    write("OWP Off"); @panel::LED_Ctrl_SetOWP = 1;
  }

  testWaitForTimeout(2000);
  Exit_BLTN_CAM();

  while($BLTN_CAM_RecSet_OWP == 0x2 && flag_RecSet_error <= 15){
    Enter_BLTN_CAM();
    testWaitForTimeout(3000);
    write("Set OWP Off (attempt %d/15)", flag_RecSet_error+1);
    @panel::LED_Ctrl_SetOWP = 1;
    testWaitForTimeout(2000);
    flag_RecSet_error++;
    Exit_BLTN_CAM();
  }

  write(">>> [EndTest] Final: BLTN_CAM_RecSet_OWP = 0x%X", $BLTN_CAM_RecSet_OWP);
  flag_RecSet_error = 0;
}

void Init(){
  @panel::Switch_CGWNM = 1;

  KEY_ON();

  write("Run Set_Battery()");
  Set_Battery();

  while (getSignal(BLTN_CAM_SD_Format_Op_State) != 0x1){
    @panel::Button_RecReset = 1;
    testWaitForTimeout(500);
  }

  KEY_OFF();

  @panel::Switch_CGWNM = 0;
}

testcase OWP_003_Init(){
  testStep("Notification","Start test OWP_003 - 2.0");
  write("=== START OWP_003 - 2.0 ===");

  write("===SETTING BEFORE TESTING===");

 

//  write("Run Init()"); Init();

  write("===START TEST===");
}

testcase OWP_003_1_2(){
  //============================================================================
  // STEP 1_2: OWP ON, set 20h, wait 20h, capture screenshot, OWP OFF
  //============================================================================
  write("");
  write("=== STEP 1_2: OWP ON -> set 20h -> wait 20h -> capture screenshot ===");
  testStep("Step1_2","Start test OWP_003_1_2");

  write("Run Setup_Function()"); Setup_Function(1);

  Clock_Down(1200); //20h

  write("Run Setup_End_test()"); Setup_End_test();

  @panel::Switch_Clock = 0;

  @panel::Switch_CGWNM = 0;

  write("Run KEY_OFF()"); KEY_OFF();

  step1_2_passed = 1;
  testStepPass("Step1_2","OWP 20h recording test - PASS");
  write("=== FINISH OWP_003_1_2 ===");
}

testcase OWP_003_3(){
  //============================================================================
  // STEP 3: OWP ON, set 12h, wait 12h, capture screenshot, OWP OFF
  //============================================================================
  write("");
  write("=== STEP 3: OWP ON -> set 12h -> wait 12h -> capture screenshot ===");
  testStep("Step3","Start test OWP_003_3");

  write("Run Setup_Function()"); Setup_Function(2);

  Clock_Down(720); //12h

  write("Run Setup_End_test()"); Setup_End_test();

  @panel::Switch_Clock = 0;

  @panel::Switch_CGWNM = 0;

  write("Run KEY_OFF()"); KEY_OFF();

  step3_passed = 1;
  testStepPass("Step3","OWP 12h recording test - PASS");
  write("=== FINISH OWP_003_3 ===");
}

testcase OWP_003_4(){
  //============================================================================
  // STEP 4: OWP ON, set 6h, wait 6h, capture screenshot, OWP OFF
  //============================================================================
  write("");
  write("=== STEP 4: OWP ON -> set 6h -> wait 6h -> capture screenshot ===");
  testStep("Step4","Start test OWP_003_4");

  write("Run Setup_Function()"); Setup_Function(3);

  Clock_Down(360); //6h

  write("Run Setup_End_test()"); Setup_End_test();

  @panel::Switch_Clock = 0;

  @panel::Switch_CGWNM = 0;

  write("Run KEY_OFF()"); KEY_OFF();

  step4_passed = 1;
  testStepPass("Step4","OWP 6h recording test - PASS");
  write("=== FINISH OWP_003_4 ===");
}

testcase OWP_003_5(){
  //============================================================================
  // STEP 5: OWP ON, set 2h, wait 2h, capture screenshot, OWP OFF
  //============================================================================
  write("");
  write("=== STEP 5: OWP ON -> set 2h -> wait 2h -> capture screenshot ===");
  testStep("Step5","Start test OWP_003_5");

  write("Run Setup_Function()"); Setup_Function(4);

  Clock_Down(120); //2h

  write("Run Setup_End_test()"); Setup_End_test();

  @panel::Switch_Clock = 0;

  @panel::Switch_CGWNM = 0;

  write("Run KEY_OFF()"); KEY_OFF();

  step5_passed = 1;
  testStepPass("Step5","OWP 2h recording test - PASS");
  write("=== FINISH OWP_003_5 ===");
}

testcase OWP_003_6(){
  //============================================================================
  // STEP 6: OWP ON, set 20h with custom time (23:40), wait 1h, capture screenshot, OWP OFF
  //============================================================================
  write("");
  write("=== STEP 6: OWP ON -> set 20h with custom time -> wait 1h -> capture screenshot ===");
  testStep("Step6","Start test OWP_003_6");

  @panel::Switch_CGWNM = 1;

  write("Run KEY_ON()"); KEY_ON();
  testWaitForTimeout(3000);

  write("Run Enter_BLTN_CAM()"); Enter_BLTN_CAM();
  testWaitForTimeout(3000);

  BLTN_CAM_Settings(1); write("Run BLTN_CAM_Settings(1)");
  testWaitForTimeout(1000);

  @panel::Switch_Clock = 1;
  testWaitForTimeout(1000);
  write("Run Check_time()"); Check_time();
  @panel::Switch_Clock = 0;

  write("Run Set_Time()"); Set_Time(time_Hour_value, time_Minute_value, time_Second_value, check_DisplayDay_value, check_DisplayMonth_value, check_DisplayYear1_value, check_DisplayYear2_value);

  write("Run Exit_BLTN_CAM()"); Exit_BLTN_CAM();
  testWaitForTimeout(3000);

  write("Run KEY_OFF()"); KEY_OFF();

  write(">>> [Step6] KEY_OFF done. Time manually set to %02X:%02X:00",
        time_Hour_value, time_Minute_value);
  write(">>> [Step6] Waiting for BLTN_CAM_RecSta_OWP to change (OWP auto-start, max 100s)...");
  write(">>> [Step6] No action required - OWP should start automatically.");

  if (WaitFor_RecSta_OWP_ON(100) == 1){
    write(">>> [OK] BLTN_CAM_RecSta_OWP = 0x1 - OWP recording is in progress!");
    write(">>> [Step6] Starting 1h countdown...");

    Clock_Down(60); //1h
  }
  else {
    write(">>> [FAIL] OWP recording has NOT started within 100s.");
    write(">>> [FAIL] BLTN_CAM_RecSta_OWP = 0x%X (expected 0x1)", $BLTN_CAM_RecSta_OWP);
    write("Error: OWP recording hasn't started. Stop test !!!");

    write("Run Setup_End_test()"); Setup_End_test();

    write("Run KEY_OFF()"); KEY_OFF();

    step6_passed = 0;
    testStepFail("Step6","OWP recording hasn't started - FAIL");
    write("=== FINISH OWP_003_6 ===");
    stop();
  }

  write("Run Setup_End_test()"); Setup_End_test();

  @panel::Switch_CGWNM = 0;

  write("Run KEY_OFF()"); KEY_OFF();

  step6_passed = 1;
  testStepPass("Step6","OWP custom time recording test - PASS");
  write("=== FINISH OWP_003_6 ===");
}

testcase OWP_003_Summary(){
  //============================================================================
  // Overall Test Verdict
  //============================================================================
  if(step1_2_passed == 1 && step3_passed == 1 && step4_passed == 1 && step5_passed == 1 && step6_passed == 1)
  {
    testStepPass("Overall_Verdict", "Test OWP_003 - 2.0: PASS");
    write("=== OVERALL VERDICT: PASS ===");
  }
  else
  {
    testStepFail("Overall_Verdict", "Test OWP_003 - 2.0: FAIL");
    write("=== OVERALL VERDICT: FAIL ===");
  }

  //============================================================================
  // SUMMARY
  //============================================================================
  write("");
  write("=== TEST SUMMARY ===");

  if(step1_2_passed == 1)
    write("Step 1_2: OWP ON, set 20h, wait 20h, capture screenshot [Screenshot] => PASS");
  else
    write("Step 1_2: OWP ON, set 20h, wait 20h, capture screenshot [Screenshot] => FAIL");

  if(step3_passed == 1)
    write("Step 3: OWP ON, set 12h, wait 12h, capture screenshot [Screenshot] => PASS");
  else
    write("Step 3: OWP ON, set 12h, wait 12h, capture screenshot [Screenshot] => FAIL");

  if(step4_passed == 1)
    write("Step 4: OWP ON, set 6h, wait 6h, capture screenshot [Screenshot] => PASS");
  else
    write("Step 4: OWP ON, set 6h, wait 6h, capture screenshot [Screenshot] => FAIL");

  if(step5_passed == 1)
    write("Step 5: OWP ON, set 2h, wait 2h, capture screenshot [Screenshot] => PASS");
  else
    write("Step 5: OWP ON, set 2h, wait 2h, capture screenshot [Screenshot] => FAIL");

  if(step6_passed == 1)
    write("Step 6: OWP ON, set 20h with custom time, wait 1h, capture screenshot [Screenshot] => PASS");
  else
    write("Step 6: OWP ON, set 20h with custom time, wait 1h, capture screenshot [Screenshot] => FAIL");

  testStep("Notifications","Finish OWP_003 - 2.0");
  write("=== FINISH OWP_003 - 2.0 ===");
}

void MainTest(){
  testReportFileName("TestReports\\OWP_003 - 2.0 generation_report");
  OWP_003_Init();

   OWP_003_1_2();

   OWP_003_3();

   OWP_003_4();

   OWP_003_5();

   OWP_003_6();

  OWP_003_Summary();
}
