/*@!Encoding:65001*/
includes { #include "DeclarationFunction_OWP_Gen2.h" }

/*
  Test Case: OWP_009 - 2.0 (OWP_009)
  Title: [PEV Recording - Before/After Time Setting Combinations]

  Verification items:
    - Check PEV recording with different Before/After time combinations
    - Measure PEV recording duration

  Preconditions:
    - ACC and IGN and ccNC/ccIC switch OFF, AVN mode

  Step 1: PEV ON, Bfr -10s, Aft +10s -> trigger PEV -> check recording time
  Step 2: PEV ON, Bfr -15s, Aft +10s -> trigger PEV -> check recording time
  Step 3: PEV ON, Bfr -20s, Aft +10s -> trigger PEV -> check recording time
  Step 4: PEV ON, Bfr -10s, Aft +15s -> trigger PEV -> check recording time
  Step 5: PEV ON, Bfr -15s, Aft +15s -> trigger PEV -> check recording time
  Step 6: PEV ON, Bfr -20s, Aft +15s -> trigger PEV -> check recording time
  Step 7: PEV ON, Bfr -10s, Aft +20s -> trigger PEV -> check recording time
  Step 8: PEV ON, Bfr -15s, Aft +20s -> trigger PEV -> check recording time
  Step 9: PEV ON, Bfr -20s, Aft +20s -> trigger PEV -> check recording time

  NOTE: Uses 2s delay for signal propagation after each state transition.
*/

variables {
  // Global Variable Declaration
  float count_PEVRec_time = 0.0;
  int flag_RecSet_error = 0;
  byte value_Bfr = 0x0;
  byte value_Aft = 0x0;
  char PLBM_Battery[4] = {'P','L','B','M'};
  char eAGM_Battery[4] = {'E','A','G','M'};
  char answer[4];

  // Result tracking
  int step1_passed = 0;
  int step2_passed = 0;
  int step3_passed = 0;
  int step4_passed = 0;
  int step5_passed = 0;
  int step6_passed = 0;
  int step7_passed = 0;
  int step8_passed = 0;
  int step9_passed = 0;

  //Message Declaration for CAN
  message HU_BLTN_CAM_PE_00_200ms _HU_BLTN_CAM_PE_00_200ms;
  message HU_BLTN_CAM_E_00 _HU_BLTN_CAM_E_00;
  message HU_CLOCK_PE_02 _HU_CLOCK_PE_02;
  message BCM_02_200ms _BCM_02_200ms;
}

int checkBatteryType(char a[], int size)
{
  int i, matchPLBM, matchEAGM;

  matchPLBM = 1;

  matchEAGM = 1;

  for (i = 0; i < size; i++)
  {
    if (a[i] != PLBM_Battery[i])
    {
      matchPLBM = 0;
    }
    if (a[i] != eAGM_Battery[i])
    {
      matchEAGM = 0;
    }
  }

  if (matchPLBM)
    return 1;
  else if (matchEAGM)
    return 2;
  else
    return 0;
}

void Set_Battery(){
  int flag_Timeout;
  int battery_Type;

  flag_Timeout = 0;
  battery_Type = 0;

  @panel::Switch_CGWNM = 1;

  KEY_ON();

  do
  {
    testWaitForStringInput("Please enter kind of battery (PLBM or EAGM):", 300000);

    testGetStringInput(answer, 5);

    write("You entered: %c%c%c%c", answer[0], answer[1], answer[2], answer[3]);

    battery_Type = checkBatteryType(answer,4);

    if(battery_Type == 0){
      write("Invalid input! Please enter 'PLBM' or 'EAGM'.");
    }
  } while(battery_Type == 0);

  switch(battery_Type){
    case(1):
      write("Battery type is PLBM.");
      @ControlPowerSupply::RadioBtn_PwrSplyModel = 1; //Choose model power suplly TL305TP
      @ControlPowerSupply::Numeric_PortNum = 3; //Choose numberic port to connect PC

      if( @ControlPowerSupply::RadioBtn_PwrSplyModel == 1 && @ControlPowerSupply::Numeric_PortNum == 3 ){
        while (@ControlPowerSupply::isConectedPwrSply == 0 && flag_Timeout <= 30){
        @ControlPowerSupply::Button_Connect = 0;
        testWaitForTimeout(1000);
        @ControlPowerSupply::Button_Connect = 1;
        testWaitForTimeout(1000);
        @ControlPowerSupply::Button_Connect = 0;
        flag_Timeout++;
        }
      }
      flag_Timeout = 0;
      break;
    case(2):
      write("Battery type is EAGM.");
      setSignal(ICU_BS2SoC, 0x64); break;
  }

  KEY_OFF();

  @panel::Switch_CGWNM = 0;
}

void BLTN_CAM_Settings(int Choose_Option){
  switch (Choose_Option){
    case(1):
      if ($BLTN_CAM_RecSet_PEV == 0x1){
        @panel::LED_Ctrl_SetPEV = 1;

        testWaitForTimeout(500);

        if ($BLTN_CAM_RecSet_PEV == 0x2){

          write("PEV: 0x%X (ON)",$BLTN_CAM_RecSet_PEV);
        }
        else if ($BLTN_CAM_RecSet_PEV == 0x1){

          write("PEV: 0x%X (OFF)",$BLTN_CAM_RecSet_PEV);

        }
      }
      testWaitForTimeout(500);
      value_Bfr = 0x0; write("Bft: -10"); @panel::TrackBar_EV_Time_Bfr = 3;/*Before Time Setting: -10s*/
      testWaitForTimeout(500);
      value_Aft = 0x0; write("Aft: +10"); @panel::TrackBar_EV_Time_Aft = 10;/*After Time Setting: +10s*/break;
    case(2):
      if ($BLTN_CAM_RecSet_PEV == 0x1){
        @panel::LED_Ctrl_SetPEV = 1;

        testWaitForTimeout(500);

        if ($BLTN_CAM_RecSet_PEV == 0x2){

          write("PEV: 0x%X (ON)",$BLTN_CAM_RecSet_PEV);
        }
        else if ($BLTN_CAM_RecSet_PEV == 0x1){

          write("PEV: 0x%X (OFF)",$BLTN_CAM_RecSet_PEV);

        }
      }
      testWaitForTimeout(500);
      value_Bfr = 0x5; write("Bft: -15"); @panel::TrackBar_EV_Time_Bfr = 2;/*Before Time Setting: -15s*/
      testWaitForTimeout(500);
      value_Aft = 0x0; write("Aft: +10"); @panel::TrackBar_EV_Time_Aft = 10;/*After Time Setting: +10s*/break;
    case(3):
      if ($BLTN_CAM_RecSet_PEV == 0x1){
        @panel::LED_Ctrl_SetPEV = 1;

        testWaitForTimeout(500);

        if ($BLTN_CAM_RecSet_PEV == 0x2){

          write("PEV: 0x%X (ON)",$BLTN_CAM_RecSet_PEV);
        }
        else if ($BLTN_CAM_RecSet_PEV == 0x1){

          write("PEV: 0x%X (OFF)",$BLTN_CAM_RecSet_PEV);

        }
      }
      testWaitForTimeout(500);
      value_Bfr = 0xA; write("Bft: -20"); @panel::TrackBar_EV_Time_Bfr = 1;/*Before Time Setting: -20s*/
      testWaitForTimeout(500);
      value_Aft = 0x0; write("Aft: +10"); @panel::TrackBar_EV_Time_Aft = 10;/*After Time Setting: +10s*/break;
    case(4):
      if ($BLTN_CAM_RecSet_PEV == 0x1){
        @panel::LED_Ctrl_SetPEV = 1;

        testWaitForTimeout(500);

        if ($BLTN_CAM_RecSet_PEV == 0x2){

          write("PEV: 0x%X (ON)",$BLTN_CAM_RecSet_PEV);
        }
        else if ($BLTN_CAM_RecSet_PEV == 0x1){

          write("PEV: 0x%X (OFF)",$BLTN_CAM_RecSet_PEV);

        }
      }
      testWaitForTimeout(500);
      value_Bfr = 0x0; write("Bft: -10"); @panel::TrackBar_EV_Time_Bfr = 3;/*Before Time Setting: -10s*/
      testWaitForTimeout(500);
      value_Aft = 0x5; write("Aft: +15"); @panel::TrackBar_EV_Time_Aft = 15;/*After Time Setting: +15s*/break;
    case(5):
      if ($BLTN_CAM_RecSet_PEV == 0x1){
        @panel::LED_Ctrl_SetPEV = 1;

        testWaitForTimeout(500);

        if ($BLTN_CAM_RecSet_PEV == 0x2){

          write("PEV: 0x%X (ON)",$BLTN_CAM_RecSet_PEV);
        }
        else if ($BLTN_CAM_RecSet_PEV == 0x1){

          write("PEV: 0x%X (OFF)",$BLTN_CAM_RecSet_PEV);

        }
      }
      testWaitForTimeout(500);
      value_Bfr = 0x5; write("Bft: -15"); @panel::TrackBar_EV_Time_Bfr = 2;/*Before Time Setting: -15s*/
      testWaitForTimeout(500);
      value_Aft = 0x5; write("Aft: +15"); @panel::TrackBar_EV_Time_Aft = 15;/*After Time Setting: +15s*/break;
    case(6):
      if ($BLTN_CAM_RecSet_PEV == 0x1){
        @panel::LED_Ctrl_SetPEV = 1;

        testWaitForTimeout(500);

        if ($BLTN_CAM_RecSet_PEV == 0x2){

          write("PEV: 0x%X (ON)",$BLTN_CAM_RecSet_PEV);
        }
        else if ($BLTN_CAM_RecSet_PEV == 0x1){

          write("PEV: 0x%X (OFF)",$BLTN_CAM_RecSet_PEV);

        }
      }
      testWaitForTimeout(500);
      value_Bfr = 0xA; write("Bft: -20"); @panel::TrackBar_EV_Time_Bfr = 1;/*Before Time Setting: -20s*/
      testWaitForTimeout(500);
      value_Aft = 0x5; write("Aft: +15"); @panel::TrackBar_EV_Time_Aft = 15;/*After Time Setting: +15s*/break;
    case(7):
      if ($BLTN_CAM_RecSet_PEV == 0x1){
        @panel::LED_Ctrl_SetPEV = 1;

        testWaitForTimeout(500);

        if ($BLTN_CAM_RecSet_PEV == 0x2){

          write("PEV: 0x%X (ON)",$BLTN_CAM_RecSet_PEV);
        }
        else if ($BLTN_CAM_RecSet_PEV == 0x1){

          write("PEV: 0x%X (OFF)",$BLTN_CAM_RecSet_PEV);

        }
      }
      testWaitForTimeout(500);
      value_Bfr = 0x0; write("Bft: -10"); @panel::TrackBar_EV_Time_Bfr = 3;/*Before Time Setting: -10s*/
      testWaitForTimeout(500);
      value_Aft = 0xA; write("Aft: +20"); @panel::TrackBar_EV_Time_Aft = 20;/*After Time Setting: +20s*/break;
    case(8):
      if ($BLTN_CAM_RecSet_PEV == 0x1){
        @panel::LED_Ctrl_SetPEV = 1;

        testWaitForTimeout(500);

        if ($BLTN_CAM_RecSet_PEV == 0x2){

          write("PEV: 0x%X (ON)",$BLTN_CAM_RecSet_PEV);
        }
        else if ($BLTN_CAM_RecSet_PEV == 0x1){

          write("PEV: 0x%X (OFF)",$BLTN_CAM_RecSet_PEV);

        }
      }
      testWaitForTimeout(500);
      value_Bfr = 0x5; write("Bft: -15"); @panel::TrackBar_EV_Time_Bfr = 2;/*Before Time Setting: -15s*/
      testWaitForTimeout(500);
      value_Aft = 0xA; write("Aft: +20"); @panel::TrackBar_EV_Time_Aft = 20;/*After Time Setting: +20s*/break;
    case(9):
      if ($BLTN_CAM_RecSet_PEV == 0x1){
        @panel::LED_Ctrl_SetPEV = 1;

        testWaitForTimeout(500);

        if ($BLTN_CAM_RecSet_PEV == 0x2){

          write("PEV: 0x%X (ON)",$BLTN_CAM_RecSet_PEV);
        }
        else if ($BLTN_CAM_RecSet_PEV == 0x1){

          write("PEV: 0x%X (OFF)",$BLTN_CAM_RecSet_PEV);

        }
      }
      testWaitForTimeout(500);
      value_Bfr = 0xA; write("Bft: -20"); @panel::TrackBar_EV_Time_Bfr = 1;/*Before Time Setting: -20s*/
      testWaitForTimeout(500);
      value_Aft = 0xA; write("Aft: +20"); @panel::TrackBar_EV_Time_Aft = 20;/*After Time Setting: +20s*/break;
  }

  testWaitForTimeout(500);

  if($BLTN_CAM_Set_EV_BfrTime != value_Bfr){

    write("Bfr_time is not match");

    write("Stop test"); stop();

  }
  else if($BLTN_CAM_Set_EV_AftTime != value_Aft){

    write("Aft_time is not match");

    write("Stop test"); stop();

  }
}



void Setup_Function(int Option, long Wait_Time){
  float start_sec, end_sec;

  write(">>> [Setup] Starting Setup_Function: Option=%d, Wait_Time=%d ms", Option, Wait_Time);
  write(">>> [Setup] Current: BLTN_CAM_RecSet_PEV = 0x%X", $BLTN_CAM_RecSet_PEV);

    @panel::Switch_CGWNM = 1;

    write(">>> [Setup] KEY_ON (SMK = 0x1)"); KEY_ON();
    testWaitForTimeout(3000);

    Enter_BLTN_CAM();
    testWaitForTimeout(3000);

    write(">>> [Setup] Applying PEV settings: Option %d...", Option);
    BLTN_CAM_Settings(Option);
    testWaitForTimeout(2000);

    write(">>> [Setup] After settings: BLTN_CAM_RecSet_PEV = 0x%X, BfrTime = 0x%X, AftTime = 0x%X",
          $BLTN_CAM_RecSet_PEV, $BLTN_CAM_Set_EV_BfrTime, $BLTN_CAM_Set_EV_AftTime);

    @panel::Switch_Clock = 1;

    Exit_BLTN_CAM();
    testWaitForTimeout(3000);

    write(">>> [Setup] KEY_OFF (SMK = 0x0)"); KEY_OFF();
    write(">>> [Setup] BLTN_CAM_RecSet_PEV = 0x%X after KEY_OFF", $BLTN_CAM_RecSet_PEV);
    write(">>> [Setup] Stabilizing: waiting %d ms before PEV trigger prompt...", Wait_Time);

    testWaitForTimeout(Wait_Time);

    write("");
    write("*************************************************************");
    write("*** [ACTION REQUIRED - TRIGGER PEV NOW!] ***");
    write("*** >> Please bump/shake the vehicle to trigger PEV! << ***");
    write("*** Script monitors BLTN_CAM_RecSta_PEV change (10s timeout) ***");
    write("*** Current: BLTN_CAM_RecSta_PEV = 0x%X ***", $BLTN_CAM_RecSta_PEV);
    write("*************************************************************");
    write("");

    if (WaitFor_RecSta_PEV_ON(10) == 1){
      write(">>> [OK] PEV recording STARTED! BLTN_CAM_RecSta_PEV = 0x%X", $BLTN_CAM_RecSta_PEV);
      start_sec = timeNow()/100000.0;
      write(">>> [Timer] Recording start time = %.2f s", start_sec);
    }
    else {
      write(">>> [FAIL] PEV recording did NOT start within 10s.");
      write(">>> [FAIL] BLTN_CAM_RecSta_PEV = 0x%X (no change detected)", $BLTN_CAM_RecSta_PEV);
      testStepFail("Fail","PEV recording hasn't started");
      stop();
    }

    write(">>> Waiting for PEV recording to stop (max 30s)...");
    if (WaitFor_RecSta_PEV_OFF(30) == 1){
      write(">>> [OK] PEV recording STOPPED. BLTN_CAM_RecSta_PEV = 0x%X", $BLTN_CAM_RecSta_PEV);
      end_sec = timeNow()/100000.0;
      write(">>> [Timer] Recording end time = %.2f s", end_sec);
    }

    count_PEVRec_time = end_sec - start_sec;
    write(">>> [Result] PEV recording duration = %.2f s", count_PEVRec_time);
}

void Setup_End_test(){

  write(">>> [EndTest] KEY_ON to enter BLTN_CAM and turn PEV OFF...");
  KEY_ON();
  testWaitForTimeout(3000);

  write(">>> [EndTest] Current: BLTN_CAM_RecSet_PEV = 0x%X", $BLTN_CAM_RecSet_PEV);

  while(getSignal(BLTN_CAM_RecSet_PEV) == 0x2 && flag_RecSet_error < 15){

    Enter_BLTN_CAM();
    testWaitForTimeout(3000);
    write("PEV Off (attempt %d/15)", flag_RecSet_error+1); @panel::LED_Ctrl_SetPEV = 1;
    testWaitForTimeout(1000);
    Exit_BLTN_CAM();
    testWaitForTimeout(1000);
    flag_RecSet_error++;

  }

  write(">>> [EndTest] Final: BLTN_CAM_RecSet_PEV = 0x%X", $BLTN_CAM_RecSet_PEV);
  flag_RecSet_error = 0;
}

void Init(){
  @panel::Switch_CGWNM = 1;

  KEY_ON();

  while (getSignal(BLTN_CAM_SD_Format_Op_State) != 0x1){
    @panel::Button_RecReset = 1;
    testWaitForTimeout(500);
  }

  write("Run Set_Battery()");
  Set_Battery();

  KEY_OFF();

  @panel::Switch_CGWNM = 0;
}

testcase OWP_009_Init(){
  write("========================================");
  write("=== START TEST OWP_009 - 2.0 ===");
  write("========================================");

  write("===SETTING BEFORE TESTING===");

  

  write("Init()"); Init();

  write("===START TEST===");
}

testcase OWP_009_1(){
  //============================================================================
  // STEP 1: PEV ON, Bfr -10s, Aft +10s -> trigger PEV -> check recording time
  //============================================================================
  write("");
  write("=== STEP 1: PEV ON, Bfr -10s, Aft +10s ===");
  testStep("Step1","Start test OWP_009_1");
  write(">>> [Step1] Current: BLTN_CAM_RecSet_PEV = 0x%X, RecSta_PEV = 0x%X",
        $BLTN_CAM_RecSet_PEV, $BLTN_CAM_RecSta_PEV);

  write("Run Setup_Function()"); Setup_Function(1, 15000);

  write(">>> [Step1] Result: count_PEVRec_time = %.2f s", count_PEVRec_time);

  write("Run CaptureGraphics()"); CaptureGraphics("BLTN_CAM_RecSta_PEV;BLTN_CAM_RecSet_PEV;BLTN_CAM_HU_UI_Mode");

  write("Run Setup_End_test()"); Setup_End_test();

  @panel::Switch_Clock = 0;

  @panel::Switch_CGWNM = 0;

  count_PEVRec_time = 0.0;

  write("Run KEY_OFF()"); KEY_OFF();

  step1_passed = 1;
  testStepPass("Step1","PEV Bfr -10s, Aft +10s recording test - PASS");
  write("=== FINISH OWP_009_1 ===");
}

testcase OWP_009_2(){
  //============================================================================
  // STEP 2: PEV ON, Bfr -15s, Aft +10s -> trigger PEV -> check recording time
  //============================================================================
  write("");
  write("=== STEP 2: PEV ON, Bfr -15s, Aft +10s ===");
  testStep("Step2","Start test OWP_009_2");
  write(">>> [Step2] Current: BLTN_CAM_RecSet_PEV = 0x%X, RecSta_PEV = 0x%X",
        $BLTN_CAM_RecSet_PEV, $BLTN_CAM_RecSta_PEV);

  write("Run Setup_Function()"); Setup_Function(2, 20000);

  write(">>> [Step2] Result: count_PEVRec_time = %.2f s", count_PEVRec_time);

  write("Run CaptureGraphics()"); CaptureGraphics("BLTN_CAM_RecSta_PEV;BLTN_CAM_RecSet_PEV;BLTN_CAM_HU_UI_Mode");

  write("Run Setup_End_test()"); Setup_End_test();

  @panel::Switch_Clock = 0;

  @panel::Switch_CGWNM = 0;

  count_PEVRec_time = 0.0;

  write("Run KEY_OFF()"); KEY_OFF();

  step2_passed = 1;
  testStepPass("Step2","PEV Bfr -15s, Aft +10s recording test - PASS");
  write("=== FINISH OWP_009_2 ===");
}

testcase OWP_009_3(){
  //============================================================================
  // STEP 3: PEV ON, Bfr -20s, Aft +10s -> trigger PEV -> check recording time
  //============================================================================
  write("");
  write("=== STEP 3: PEV ON, Bfr -20s, Aft +10s ===");
  testStep("Step3","Start test OWP_009_3");
  write(">>> [Step3] Current: BLTN_CAM_RecSet_PEV = 0x%X, RecSta_PEV = 0x%X",
        $BLTN_CAM_RecSet_PEV, $BLTN_CAM_RecSta_PEV);

  write("Run Setup_Function()"); Setup_Function(3, 25000);

  write(">>> [Step3] Result: count_PEVRec_time = %.2f s", count_PEVRec_time);

  write("Run CaptureGraphics()"); CaptureGraphics("BLTN_CAM_RecSta_PEV;BLTN_CAM_RecSet_PEV;BLTN_CAM_HU_UI_Mode");

  write("Run Setup_End_test()"); Setup_End_test();

  @panel::Switch_Clock = 0;

  @panel::Switch_CGWNM = 0;

  count_PEVRec_time = 0.0;

  write("Run KEY_OFF()"); KEY_OFF();

  step3_passed = 1;
  testStepPass("Step3","PEV Bfr -20s, Aft +10s recording test - PASS");
  write("=== FINISH OWP_009_3 ===");
}

testcase OWP_009_4(){
  //============================================================================
  // STEP 4: PEV ON, Bfr -10s, Aft +15s -> trigger PEV -> check recording time
  //============================================================================
  write("");
  write("=== STEP 4: PEV ON, Bfr -10s, Aft +15s ===");
  testStep("Step4","Start test OWP_009_4");
  write(">>> [Step4] Current: BLTN_CAM_RecSet_PEV = 0x%X, RecSta_PEV = 0x%X",
        $BLTN_CAM_RecSet_PEV, $BLTN_CAM_RecSta_PEV);

  write("Run Setup_Function()"); Setup_Function(4, 15000);

  write(">>> [Step4] Result: count_PEVRec_time = %.2f s", count_PEVRec_time);

  write("Run CaptureGraphics()"); CaptureGraphics("BLTN_CAM_RecSta_PEV;BLTN_CAM_RecSet_PEV;BLTN_CAM_HU_UI_Mode");

  write("Run Setup_End_test()"); Setup_End_test();

  @panel::Switch_Clock = 0;

  @panel::Switch_CGWNM = 0;

  count_PEVRec_time = 0.0;

  write("Run KEY_OFF()"); KEY_OFF();

  step4_passed = 1;
  testStepPass("Step4","PEV Bfr -10s, Aft +15s recording test - PASS");
  write("=== FINISH OWP_009_4 ===");
}

testcase OWP_009_5(){
  //============================================================================
  // STEP 5: PEV ON, Bfr -15s, Aft +15s -> trigger PEV -> check recording time
  //============================================================================
  write("");
  write("=== STEP 5: PEV ON, Bfr -15s, Aft +15s ===");
  testStep("Step5","Start test OWP_009_5");
  write(">>> [Step5] Current: BLTN_CAM_RecSet_PEV = 0x%X, RecSta_PEV = 0x%X",
        $BLTN_CAM_RecSet_PEV, $BLTN_CAM_RecSta_PEV);

  write("Run Setup_Function()"); Setup_Function(5, 20000);

  write(">>> [Step5] Result: count_PEVRec_time = %.2f s", count_PEVRec_time);

  write("Run CaptureGraphics()"); CaptureGraphics("BLTN_CAM_RecSta_PEV;BLTN_CAM_RecSet_PEV;BLTN_CAM_HU_UI_Mode");

  write("Run Setup_End_test()"); Setup_End_test();

  @panel::Switch_Clock = 0;

  @panel::Switch_CGWNM = 0;

  count_PEVRec_time = 0.0;

  write("Run KEY_OFF()"); KEY_OFF();

  step5_passed = 1;
  testStepPass("Step5","PEV Bfr -15s, Aft +15s recording test - PASS");
  write("=== FINISH OWP_009_5 ===");
}

testcase OWP_009_6(){
  //============================================================================
  // STEP 6: PEV ON, Bfr -20s, Aft +15s -> trigger PEV -> check recording time
  //============================================================================
  write("");
  write("=== STEP 6: PEV ON, Bfr -20s, Aft +15s ===");
  testStep("Step6","Start test OWP_009_6");
  write(">>> [Step6] Current: BLTN_CAM_RecSet_PEV = 0x%X, RecSta_PEV = 0x%X",
        $BLTN_CAM_RecSet_PEV, $BLTN_CAM_RecSta_PEV);

  write("Run Setup_Function()"); Setup_Function(6, 25000);

  write(">>> [Step6] Result: count_PEVRec_time = %.2f s", count_PEVRec_time);

  write("Run CaptureGraphics()"); CaptureGraphics("BLTN_CAM_RecSta_PEV;BLTN_CAM_RecSet_PEV;BLTN_CAM_HU_UI_Mode");

  write("Run Setup_End_test()"); Setup_End_test();

  @panel::Switch_Clock = 0;

  @panel::Switch_CGWNM = 0;

  count_PEVRec_time = 0.0;

  write("Run KEY_OFF()"); KEY_OFF();

  step6_passed = 1;
  testStepPass("Step6","PEV Bfr -20s, Aft +15s recording test - PASS");
  write("=== FINISH OWP_009_6 ===");
}

testcase OWP_009_7(){
  //============================================================================
  // STEP 7: PEV ON, Bfr -10s, Aft +20s -> trigger PEV -> check recording time
  //============================================================================
  write("");
  write("=== STEP 7: PEV ON, Bfr -10s, Aft +20s ===");
  testStep("Step7","Start test OWP_009_7");
  write(">>> [Step7] Current: BLTN_CAM_RecSet_PEV = 0x%X, RecSta_PEV = 0x%X",
        $BLTN_CAM_RecSet_PEV, $BLTN_CAM_RecSta_PEV);

  write("Run Setup_Function()"); Setup_Function(7, 15000);

  write(">>> [Step7] Result: count_PEVRec_time = %.2f s", count_PEVRec_time);

  write("Run CaptureGraphics()"); CaptureGraphics("BLTN_CAM_RecSta_PEV;BLTN_CAM_RecSet_PEV;BLTN_CAM_HU_UI_Mode");

  write("Run Setup_End_test()"); Setup_End_test();

  @panel::Switch_Clock = 0;

  @panel::Switch_CGWNM = 0;

  count_PEVRec_time = 0.0;

  write("Run KEY_OFF()"); KEY_OFF();

  step7_passed = 1;
  testStepPass("Step7","PEV Bfr -10s, Aft +20s recording test - PASS");
  write("=== FINISH OWP_009_7 ===");
}

testcase OWP_009_8(){
  //============================================================================
  // STEP 8: PEV ON, Bfr -15s, Aft +20s -> trigger PEV -> check recording time
  //============================================================================
  write("");
  write("=== STEP 8: PEV ON, Bfr -15s, Aft +20s ===");
  testStep("Step8","Start test OWP_009_8");
  write(">>> [Step8] Current: BLTN_CAM_RecSet_PEV = 0x%X, RecSta_PEV = 0x%X",
        $BLTN_CAM_RecSet_PEV, $BLTN_CAM_RecSta_PEV);

  write("Run Setup_Function()"); Setup_Function(8, 20000);

  write(">>> [Step8] Result: count_PEVRec_time = %.2f s", count_PEVRec_time);

  write("Run CaptureGraphics()"); CaptureGraphics("BLTN_CAM_RecSta_PEV;BLTN_CAM_RecSet_PEV;BLTN_CAM_HU_UI_Mode");

  write("Run Setup_End_test()"); Setup_End_test();

  @panel::Switch_Clock = 0;

  @panel::Switch_CGWNM = 0;

  count_PEVRec_time = 0.0;

  write("Run KEY_OFF()"); KEY_OFF();

  step8_passed = 1;
  testStepPass("Step8","PEV Bfr -15s, Aft +20s recording test - PASS");
  write("=== FINISH OWP_009_8 ===");
}

testcase OWP_009_9(){
  //============================================================================
  // STEP 9: PEV ON, Bfr -20s, Aft +20s -> trigger PEV -> check recording time
  //============================================================================
  write("");
  write("=== STEP 9: PEV ON, Bfr -20s, Aft +20s ===");
  testStep("Step9","Start test OWP_009_9");
  write(">>> [Step9] Current: BLTN_CAM_RecSet_PEV = 0x%X, RecSta_PEV = 0x%X",
        $BLTN_CAM_RecSet_PEV, $BLTN_CAM_RecSta_PEV);

  write("Run Setup_Function()"); Setup_Function(9, 25000);

  write(">>> [Step9] Result: count_PEVRec_time = %.2f s", count_PEVRec_time);

  write("Run CaptureGraphics()"); CaptureGraphics("BLTN_CAM_RecSta_PEV;BLTN_CAM_RecSet_PEV;BLTN_CAM_HU_UI_Mode");

  write("Run Setup_End_test()"); Setup_End_test();

  @panel::Switch_Clock = 0;

  @panel::Switch_CGWNM = 0;

  count_PEVRec_time = 0.0;

  write("Run KEY_OFF()"); KEY_OFF();

  step9_passed = 1;
  testStepPass("Step9","PEV Bfr -20s, Aft +20s recording test - PASS");
  write("=== FINISH OWP_009_9 ===");
}

testcase OWP_009_Summary(){
  //============================================================================
  // Overall Test Verdict
  //============================================================================
  if(step1_passed == 1 && step2_passed == 1 && step3_passed == 1 && step4_passed == 1 && step5_passed == 1 && step6_passed == 1 && step7_passed == 1 && step8_passed == 1 && step9_passed == 1)
  {
    testStepPass("Overall_Verdict", "Test OWP_009 - 2.0: PASS");
    write("=== OVERALL VERDICT: PASS ===");
  }
  else
  {
    testStepFail("Overall_Verdict", "Test OWP_009 - 2.0: FAIL");
    write("=== OVERALL VERDICT: FAIL ===");
  }

  //============================================================================
  // SUMMARY
  //============================================================================
  write("");
  write("=== TEST SUMMARY ===");

  if(step1_passed == 1)
    write("Step 1: PEV ON, Bfr -10s, Aft +10s [Screenshot] => PASS");
  else
    write("Step 1: PEV ON, Bfr -10s, Aft +10s [Screenshot] => FAIL");

  if(step2_passed == 1)
    write("Step 2: PEV ON, Bfr -15s, Aft +10s [Screenshot] => PASS");
  else
    write("Step 2: PEV ON, Bfr -15s, Aft +10s [Screenshot] => FAIL");

  if(step3_passed == 1)
    write("Step 3: PEV ON, Bfr -20s, Aft +10s [Screenshot] => PASS");
  else
    write("Step 3: PEV ON, Bfr -20s, Aft +10s [Screenshot] => FAIL");

  if(step4_passed == 1)
    write("Step 4: PEV ON, Bfr -10s, Aft +15s [Screenshot] => PASS");
  else
    write("Step 4: PEV ON, Bfr -10s, Aft +15s [Screenshot] => FAIL");

  if(step5_passed == 1)
    write("Step 5: PEV ON, Bfr -15s, Aft +15s [Screenshot] => PASS");
  else
    write("Step 5: PEV ON, Bfr -15s, Aft +15s [Screenshot] => FAIL");

  if(step6_passed == 1)
    write("Step 6: PEV ON, Bfr -20s, Aft +15s [Screenshot] => PASS");
  else
    write("Step 6: PEV ON, Bfr -20s, Aft +15s [Screenshot] => FAIL");

  if(step7_passed == 1)
    write("Step 7: PEV ON, Bfr -10s, Aft +20s [Screenshot] => PASS");
  else
    write("Step 7: PEV ON, Bfr -10s, Aft +20s [Screenshot] => FAIL");

  if(step8_passed == 1)
    write("Step 8: PEV ON, Bfr -15s, Aft +20s [Screenshot] => PASS");
  else
    write("Step 8: PEV ON, Bfr -15s, Aft +20s [Screenshot] => FAIL");

  if(step9_passed == 1)
    write("Step 9: PEV ON, Bfr -20s, Aft +20s [Screenshot] => PASS");
  else
    write("Step 9: PEV ON, Bfr -20s, Aft +20s [Screenshot] => FAIL");

  testStep("Notifications","Finish OWP_009 - 2.0");
  write("=== FINISH OWP_009 - 2.0 ===");
}

void MainTest(){
  testReportFileName("TestReports\\OWP_009 - 2.0 generation_report");
  OWP_009_Init();

  OWP_009_1();

  OWP_009_2();

  OWP_009_3();

  OWP_009_4();

  OWP_009_5();

  OWP_009_6();

  OWP_009_7();

  OWP_009_8();

  OWP_009_9();

  OWP_009_Summary();
}
