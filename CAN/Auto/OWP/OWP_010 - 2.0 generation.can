/*@!Encoding:65001*/
includes { #include "DeclarationFunction_OWP_Gen2.h" }

/*
  Test Case: OWP_010 - 2.0 (OWP_010)
  Title: [PEV Recording - Sensitivity Level Test]

  Verification items:
    - Check PEV recording with different sensitivity levels (Lv.1 ~ Lv.5)
    - Measure PEV recording duration for each sensitivity level

  Preconditions:
    - ACC and IGN and ccNC/ccIC switch OFF, AVN mode

  Step 1: PEV ON, Sensitivity Lv.1, Bfr -10s, Aft +10s -> trigger PEV -> check recording time
  Step 2: PEV ON, Sensitivity Lv.2, Bfr -10s, Aft +10s -> trigger PEV -> check recording time
  Step 3: PEV ON, Sensitivity Lv.3, Bfr -10s, Aft +10s -> trigger PEV -> check recording time
  Step 4: PEV ON, Sensitivity Lv.4, Bfr -10s, Aft +10s -> trigger PEV -> check recording time
  Step 5: PEV ON, Sensitivity Lv.5, Bfr -10s, Aft +10s -> trigger PEV -> check recording time

  NOTE: Uses 2s delay for signal propagation after each state transition.
*/

variables {
  // Global Variable Declaration
  float count_PEVRec_time = 0.0;
  int flag_RecSet_error = 0;
  byte value_SenPEV = 0x0;
  byte value_Bfr;
  byte value_Aft;
  byte value_PEVSet;
  char PLBM_Battery[4] = {'P','L','B','M'};
  char eAGM_Battery[4] = {'E','A','G','M'};
  char answer[4];

  // Result tracking
  int step1_passed = 0;
  int step2_passed = 0;
  int step3_passed = 0;
  int step4_passed = 0;
  int step5_passed = 0;

  //Message Declaration for CAN
  message HU_BLTN_CAM_PE_00_200ms _HU_BLTN_CAM_PE_00_200ms;
  message HU_BLTN_CAM_E_00 _HU_BLTN_CAM_E_00;
  message HU_CLOCK_PE_02 _HU_CLOCK_PE_02;
  message BCM_02_200ms _BCM_02_200ms;
}

int checkBatteryType(char a[], int size)
{
  int i, matchPLBM, matchEAGM;

  matchPLBM = 1;

  matchEAGM = 1;

  for (i = 0; i < size; i++)
  {
    if (a[i] != PLBM_Battery[i])
    {
      matchPLBM = 0;
    }
    if (a[i] != eAGM_Battery[i])
    {
      matchEAGM = 0;
    }
  }

  if (matchPLBM)
    return 1;
  else if (matchEAGM)
    return 2;
  else
    return 0;
}

void Set_Battery(){
  int flag_Timeout;
  int battery_Type;

  flag_Timeout = 0;
  battery_Type = 0;

  @panel::Switch_CGWNM = 1;

  KEY_ON();

  do
  {
    testWaitForStringInput("Please enter kind of battery (PLBM or EAGM):", 300000);

    testGetStringInput(answer, 5);

    write("You entered: %c%c%c%c", answer[0], answer[1], answer[2], answer[3]);

    battery_Type = checkBatteryType(answer,4);

    if(battery_Type == 0){
      write("Invalid input! Please enter 'PLBM' or 'EAGM'.");
    }
  } while(battery_Type == 0);

  switch(battery_Type){
    case(1):
      write("Battery type is PLBM.");
      @ControlPowerSupply::RadioBtn_PwrSplyModel = 1; //Choose model power suplly TL305TP
      @ControlPowerSupply::Numeric_PortNum = 3; //Choose numberic port to connect PC

      if( @ControlPowerSupply::RadioBtn_PwrSplyModel == 1 && @ControlPowerSupply::Numeric_PortNum == 3 ){
        while (@ControlPowerSupply::isConectedPwrSply == 0 && flag_Timeout <= 30){
        @ControlPowerSupply::Button_Connect = 0;
        testWaitForTimeout(1000);
        @ControlPowerSupply::Button_Connect = 1;
        testWaitForTimeout(1000);
        @ControlPowerSupply::Button_Connect = 0;
        flag_Timeout++;
        }
      }
      flag_Timeout = 0;
      break;
    case(2):
      write("Battery type is EAGM.");
      setSignal(ICU_BS2SoC, 0x64); break;
  }

  KEY_OFF();

  @panel::Switch_CGWNM = 0;
}

void BLTN_CAM_Settings(int Choose_Option){
  switch (Choose_Option){
    case(1):
      if ($BLTN_CAM_RecSet_PEV == 0x1){
        @panel::LED_Ctrl_SetPEV = 1; value_PEVSet = 0x2;

        testWaitForTimeout(500);

        if ($BLTN_CAM_RecSet_PEV == 0x2){

          write("PEV: 0x%X (ON)",$BLTN_CAM_RecSet_PEV);
        }
        else if ($BLTN_CAM_RecSet_PEV == 0x1){

          write("PEV: 0x%X (OFF)",$BLTN_CAM_RecSet_PEV);
        }
      }
      testWaitForTimeout(500);
      value_SenPEV = 0x1; write("SenPEV: Lv.1"); @panel::TrackBar_PEV_Sen = 1;/* Parked Sensitivity Lv.1 */
      value_Bfr = 0x0; write("Bft: -10"); @panel::TrackBar_EV_Time_Bfr = 3;/*Before Time Setting: -10s*/
      value_Aft = 0x0; write("Aft: +10"); @panel::TrackBar_EV_Time_Aft = 10;/*After Time Setting: +10s*/break;
    case(2):
      if ($BLTN_CAM_RecSet_PEV == 0x1){
        @panel::LED_Ctrl_SetPEV = 1; value_PEVSet = 0x2;

        testWaitForTimeout(500);

        if ($BLTN_CAM_RecSet_PEV == 0x2){

          write("PEV: 0x%X (ON)",$BLTN_CAM_RecSet_PEV);
        }
        else if ($BLTN_CAM_RecSet_PEV == 0x1){

          write("PEV: 0x%X (OFF)",$BLTN_CAM_RecSet_PEV);

        }
      }
      testWaitForTimeout(500);
      value_SenPEV = 0x2; write("SenPEV: Lv.2"); @panel::TrackBar_PEV_Sen = 2;/* Parked Sensitivity Lv.2 */
      value_Bfr = 0x0; write("Bft: -10"); @panel::TrackBar_EV_Time_Bfr = 3;/*Before Time Setting: -10s*/
      value_Aft = 0x0; write("Aft: +10"); @panel::TrackBar_EV_Time_Aft = 10;/*After Time Setting: +10s*/break;
    case(3):
      if ($BLTN_CAM_RecSet_PEV == 0x1){
        @panel::LED_Ctrl_SetPEV = 1; value_PEVSet = 0x2;

        testWaitForTimeout(500);

        if ($BLTN_CAM_RecSet_PEV == 0x2){

          write("PEV: 0x%X (ON)",$BLTN_CAM_RecSet_PEV);
        }
        else if ($BLTN_CAM_RecSet_PEV == 0x1){

          write("PEV: 0x%X (OFF)",$BLTN_CAM_RecSet_PEV);

        }
      }
      testWaitForTimeout(500);
      value_SenPEV = 0x3; write("SenPEV: Lv.3"); @panel::TrackBar_PEV_Sen = 3;/* Parked Sensitivity Lv.3 */
      value_Bfr = 0x0; write("Bft: -10"); @panel::TrackBar_EV_Time_Bfr = 3;/*Before Time Setting: -10s*/
      value_Aft = 0x0; write("Aft: +10"); @panel::TrackBar_EV_Time_Aft = 10;/*After Time Setting: +10s*/break;
    case(4):
      if ($BLTN_CAM_RecSet_PEV == 0x1){
        @panel::LED_Ctrl_SetPEV = 1; value_PEVSet = 0x2;

        testWaitForTimeout(500);

        if ($BLTN_CAM_RecSet_PEV == 0x2){

          write("PEV: 0x%X (ON)",$BLTN_CAM_RecSet_PEV);
        }
        else if ($BLTN_CAM_RecSet_PEV == 0x1){

          write("PEV: 0x%X (OFF)",$BLTN_CAM_RecSet_PEV);

        }
      }
      testWaitForTimeout(500);
      value_SenPEV = 0x4; write("SenPEV: Lv.4"); @panel::TrackBar_PEV_Sen = 4;/* Parked Sensitivity Lv.4 */
      value_Bfr = 0x0; write("Bft: -10"); @panel::TrackBar_EV_Time_Bfr = 3;/*Before Time Setting: -10s*/
      value_Aft = 0x0; write("Aft: +10"); @panel::TrackBar_EV_Time_Aft = 10;/*After Time Setting: +10s*/break;
    case(5):
      if ($BLTN_CAM_RecSet_PEV == 0x1){
        @panel::LED_Ctrl_SetPEV = 1; value_PEVSet = 0x2;

        testWaitForTimeout(500);

        if ($BLTN_CAM_RecSet_PEV == 0x2){

          write("PEV: 0x%X (ON)",$BLTN_CAM_RecSet_PEV);
        }
        else if ($BLTN_CAM_RecSet_PEV == 0x1){

          write("PEV: 0x%X (OFF)",$BLTN_CAM_RecSet_PEV);

        }
      }
      testWaitForTimeout(500);
      value_SenPEV = 0x5; write("SenPEV: Lv.5"); @panel::TrackBar_PEV_Sen = 5;/* Parked Sensitivity Lv.5 */
      value_Bfr = 0x0; write("Bft: -10"); @panel::TrackBar_EV_Time_Bfr = 3;/*Before Time Setting: -10s*/
      value_Aft = 0x0; write("Aft: +10"); @panel::TrackBar_EV_Time_Aft = 10;/*After Time Setting: +10s*/break;
  }

  testWaitForTimeout(500);

  if($BLTN_CAM_Set_EV_BfrTime != value_Bfr){

    write("Bfr_time is not match");

    write("Stop test"); stop();

  }
  else if($BLTN_CAM_Set_EV_AftTime != value_Aft){

    write("Aft_time is not match");

    write("Stop test"); stop();

  }
}



void Setup_Function(int Option, long Wait_Time){
  float start_sec, end_sec;

  write(">>> [Setup] Starting Setup_Function: Option=%d, Wait_Time=%d ms", Option, Wait_Time);
  write(">>> [Setup] Current: BLTN_CAM_RecSet_PEV = 0x%X", $BLTN_CAM_RecSet_PEV);

  @panel::Switch_CGWNM = 1;

  write(">>> [Setup] KEY_ON (SMK = 0x1)"); KEY_ON();
  testWaitForTimeout(3000);

  do {
    Enter_BLTN_CAM();
    testWaitForTimeout(3000);

    write(">>> [Setup] Applying PEV settings: Option %d...", Option);
    BLTN_CAM_Settings(Option);
    testWaitForTimeout(2000);

    write(">>> [Setup] After settings: BLTN_CAM_RecSet_PEV = 0x%X, SenPEV = 0x%X, BfrTime = 0x%X, AftTime = 0x%X",
          $BLTN_CAM_RecSet_PEV, $BLTN_CAM_SenSet_PEV, $BLTN_CAM_Set_EV_BfrTime, $BLTN_CAM_Set_EV_AftTime);

    @panel::Switch_Clock = 1;

    Exit_BLTN_CAM();
    testWaitForTimeout(3000);
  } while ($BLTN_CAM_RecSet_PEV != value_PEVSet);

  write(">>> [Setup] PEV confirmed ON (RecSet_PEV = 0x%X). KEY_OFF (SMK = 0x0)", $BLTN_CAM_RecSet_PEV);
  KEY_OFF();
  write(">>> [Setup] BLTN_CAM_RecSet_PEV = 0x%X after KEY_OFF", $BLTN_CAM_RecSet_PEV);

  write(">>> [Setup] Stabilizing: waiting %d ms before PEV trigger prompt...", Wait_Time);
  testWaitForTimeout(Wait_Time);

  write("");
  write("*************************************************************");
  write("*** [ACTION REQUIRED - TRIGGER PEV NOW!] ***");
  write("*** >> Please bump/shake the vehicle to trigger PEV! << ***");
  write("*** Script monitors BLTN_CAM_RecSta_PEV change (10s timeout) ***");
  write("*** Current: BLTN_CAM_RecSta_PEV = 0x%X ***", $BLTN_CAM_RecSta_PEV);
  write("*************************************************************");
  write("");

  if (WaitFor_RecSta_PEV_ON(10) == 1){
    write(">>> [OK] PEV recording STARTED! BLTN_CAM_RecSta_PEV = 0x%X", $BLTN_CAM_RecSta_PEV);
    start_sec = timeNow()/100000.0;
    write(">>> [Timer] Recording start time = %.2f s", start_sec);
  }
  else {
    write(">>> [FAIL] PEV recording did NOT start within 10s.");
    write(">>> [FAIL] BLTN_CAM_RecSta_PEV = 0x%X (no change detected)", $BLTN_CAM_RecSta_PEV);
    testStepFail("Fail","PEV recording hasn't started");
    stop();
  }

  write(">>> Waiting for PEV recording to stop (max 30s)...");
  if (WaitFor_RecSta_PEV_OFF(30) == 1){
    write(">>> [OK] PEV recording STOPPED. BLTN_CAM_RecSta_PEV = 0x%X", $BLTN_CAM_RecSta_PEV);
    end_sec = timeNow()/100000.0;
    write(">>> [Timer] Recording end time = %.2f s", end_sec);
  }

  count_PEVRec_time = end_sec - start_sec;
  write(">>> [Result] PEV recording duration = %.2f s", count_PEVRec_time);
}

void Setup_End_test(){
  write(">>> [EndTest] KEY_ON to turn off PEV...");
  KEY_ON();
  testWaitForTimeout(3000);

  write(">>> [EndTest] Current: BLTN_CAM_RecSet_PEV = 0x%X, RecSta_PEV = 0x%X",
        $BLTN_CAM_RecSet_PEV, $BLTN_CAM_RecSta_PEV);

  while(getSignal(BLTN_CAM_RecSet_PEV) == 0x2 && flag_RecSet_error < 15){

    Enter_BLTN_CAM();
    testWaitForTimeout(3000);
    write("Set PEV Off (attempt %d/15)", flag_RecSet_error+1);
    @panel::LED_Ctrl_SetPEV = 1;
    testWaitForTimeout(1000);
    Exit_BLTN_CAM();
    testWaitForTimeout(1000);
    flag_RecSet_error++;

  }

  write(">>> [EndTest] Final: BLTN_CAM_RecSet_PEV = 0x%X", $BLTN_CAM_RecSet_PEV);
  flag_RecSet_error = 0;
}

void Init(){
  @panel::Switch_CGWNM = 1;

  KEY_ON();

  while (getSignal(BLTN_CAM_SD_Format_Op_State) != 0x1){
    @panel::Button_RecReset = 1;
    testWaitForTimeout(500);
  }

  write("Run Set_Battery()");
  Set_Battery();

  KEY_OFF();

  @panel::Switch_CGWNM = 0;
}

testcase OWP_010_Init(){
  write("========================================");
  write("=== START TEST OWP_010 - 2.0 ===");
  write("========================================");

  write("===SETTING BEFORE TESTING===");

  

  write("Init()"); Init();

  write("===START TEST===");
}

testcase OWP_010_1(){
  //============================================================================
  // STEP 1: PEV ON, Sensitivity Lv.1, Bfr -10s, Aft +10s
  //============================================================================
  write("");
  write("=== STEP 1: PEV ON, Sensitivity Lv.1, Bfr -10s, Aft +10s ===");
  testStep("Step1","Start test OWP_010_1");

  write(">>> [Step1] Current: BLTN_CAM_RecSet_PEV = 0x%X, RecSta_PEV = 0x%X",
        $BLTN_CAM_RecSet_PEV, $BLTN_CAM_RecSta_PEV);

  write("Run Setup_Function()"); Setup_Function(1, 11000);

  write(">>> [Step1] Result: count_PEVRec_time = %.2f s", count_PEVRec_time);

  write("Run CaptureGraphics()"); CaptureGraphics("BLTN_CAM_RecSta_PEV;BLTN_CAM_RecSet_PEV;BLTN_CAM_HU_UI_Mode");

  write("Run Setup_End_test()"); Setup_End_test();

  @panel::Switch_Clock = 0;

  @panel::Switch_CGWNM = 0;

  count_PEVRec_time = 0.0;

  write("Run KEY_OFF()"); KEY_OFF();

  step1_passed = 1;
  testStepPass("Step1","PEV Sensitivity Lv.1 recording test - PASS");
  write("=== FINISH OWP_010_1 ===");
}

testcase OWP_010_2(){
  //============================================================================
  // STEP 2: PEV ON, Sensitivity Lv.2, Bfr -10s, Aft +10s
  //============================================================================
  write("");
  write("=== STEP 2: PEV ON, Sensitivity Lv.2, Bfr -10s, Aft +10s ===");
  testStep("Step2","Start test OWP_010_2");

  write(">>> [Step2] Current: BLTN_CAM_RecSet_PEV = 0x%X, RecSta_PEV = 0x%X",
        $BLTN_CAM_RecSet_PEV, $BLTN_CAM_RecSta_PEV);

  write("Run Setup_Function()"); Setup_Function(2, 11000);

  write(">>> [Step2] Result: count_PEVRec_time = %.2f s", count_PEVRec_time);

  write("Run CaptureGraphics()"); CaptureGraphics("BLTN_CAM_RecSta_PEV;BLTN_CAM_RecSet_PEV;BLTN_CAM_HU_UI_Mode");

  write("Run Setup_End_test()"); Setup_End_test();

  @panel::Switch_Clock = 0;

  @panel::Switch_CGWNM = 0;

  count_PEVRec_time = 0.0;

  write("Run KEY_OFF()"); KEY_OFF();

  step2_passed = 1;
  testStepPass("Step2","PEV Sensitivity Lv.2 recording test - PASS");
  write("=== FINISH OWP_010_2 ===");
}

testcase OWP_010_3(){
  //============================================================================
  // STEP 3: PEV ON, Sensitivity Lv.3, Bfr -10s, Aft +10s
  //============================================================================
  write("");
  write("=== STEP 3: PEV ON, Sensitivity Lv.3, Bfr -10s, Aft +10s ===");
  testStep("Step3","Start test OWP_010_3");

  write(">>> [Step3] Current: BLTN_CAM_RecSet_PEV = 0x%X, RecSta_PEV = 0x%X",
        $BLTN_CAM_RecSet_PEV, $BLTN_CAM_RecSta_PEV);

  write("Run Setup_Function()"); Setup_Function(3, 11000);

  write(">>> [Step3] Result: count_PEVRec_time = %.2f s", count_PEVRec_time);

  write("Run CaptureGraphics()"); CaptureGraphics("BLTN_CAM_RecSta_PEV;BLTN_CAM_RecSet_PEV;BLTN_CAM_HU_UI_Mode");

  write("Run Setup_End_test()"); Setup_End_test();

  @panel::Switch_Clock = 0;

  @panel::Switch_CGWNM = 0;

  count_PEVRec_time = 0.0;

  write("Run KEY_OFF()"); KEY_OFF();

  step3_passed = 1;
  testStepPass("Step3","PEV Sensitivity Lv.3 recording test - PASS");
  write("=== FINISH OWP_010_3 ===");
}

testcase OWP_010_4(){
  //============================================================================
  // STEP 4: PEV ON, Sensitivity Lv.4, Bfr -10s, Aft +10s
  //============================================================================
  write("");
  write("=== STEP 4: PEV ON, Sensitivity Lv.4, Bfr -10s, Aft +10s ===");
  testStep("Step4","Start test OWP_010_4");

  write(">>> [Step4] Current: BLTN_CAM_RecSet_PEV = 0x%X, RecSta_PEV = 0x%X",
        $BLTN_CAM_RecSet_PEV, $BLTN_CAM_RecSta_PEV);

  write("Run Setup_Function()"); Setup_Function(4, 11000);

  write(">>> [Step4] Result: count_PEVRec_time = %.2f s", count_PEVRec_time);

  write("Run CaptureGraphics()"); CaptureGraphics("BLTN_CAM_RecSta_PEV;BLTN_CAM_RecSet_PEV;BLTN_CAM_HU_UI_Mode");

  write("Run Setup_End_test()"); Setup_End_test();

  @panel::Switch_Clock = 0;

  @panel::Switch_CGWNM = 0;

  count_PEVRec_time = 0.0;

  write("Run KEY_OFF()"); KEY_OFF();

  step4_passed = 1;
  testStepPass("Step4","PEV Sensitivity Lv.4 recording test - PASS");
  write("=== FINISH OWP_010_4 ===");
}

testcase OWP_010_5(){
  //============================================================================
  // STEP 5: PEV ON, Sensitivity Lv.5, Bfr -10s, Aft +10s
  //============================================================================
  write("");
  write("=== STEP 5: PEV ON, Sensitivity Lv.5, Bfr -10s, Aft +10s ===");
  testStep("Step5","Start test OWP_010_5");

  write(">>> [Step5] Current: BLTN_CAM_RecSet_PEV = 0x%X, RecSta_PEV = 0x%X",
        $BLTN_CAM_RecSet_PEV, $BLTN_CAM_RecSta_PEV);

  write("Run Setup_Function()"); Setup_Function(5, 11000);

  write(">>> [Step5] Result: count_PEVRec_time = %.2f s", count_PEVRec_time);

  write("Run CaptureGraphics()"); CaptureGraphics("BLTN_CAM_RecSta_PEV;BLTN_CAM_RecSet_PEV;BLTN_CAM_HU_UI_Mode");

  write("Run Setup_End_test()"); Setup_End_test();

  @panel::Switch_Clock = 0;

  @panel::Switch_CGWNM = 0;

  count_PEVRec_time = 0.0;

  write("Run KEY_OFF()"); KEY_OFF();

  step5_passed = 1;
  testStepPass("Step5","PEV Sensitivity Lv.5 recording test - PASS");
  write("=== FINISH OWP_010_5 ===");
}

testcase OWP_010_Summary(){
  //============================================================================
  // Overall Test Verdict
  //============================================================================
  if(step1_passed == 1 && step2_passed == 1 && step3_passed == 1 && step4_passed == 1 && step5_passed == 1)
  {
    testStepPass("Overall_Verdict", "Test OWP_010 - 2.0: PASS");
    write("=== OVERALL VERDICT: PASS ===");
  }
  else
  {
    testStepFail("Overall_Verdict", "Test OWP_010 - 2.0: FAIL");
    write("=== OVERALL VERDICT: FAIL ===");
  }

  //============================================================================
  // SUMMARY
  //============================================================================
  write("");
  write("=== TEST SUMMARY ===");

  if(step1_passed == 1)
    write("Step 1: PEV ON, Sensitivity Lv.1, Bfr -10s, Aft +10s [Screenshot] => PASS");
  else
    write("Step 1: PEV ON, Sensitivity Lv.1, Bfr -10s, Aft +10s [Screenshot] => FAIL");

  if(step2_passed == 1)
    write("Step 2: PEV ON, Sensitivity Lv.2, Bfr -10s, Aft +10s [Screenshot] => PASS");
  else
    write("Step 2: PEV ON, Sensitivity Lv.2, Bfr -10s, Aft +10s [Screenshot] => FAIL");

  if(step3_passed == 1)
    write("Step 3: PEV ON, Sensitivity Lv.3, Bfr -10s, Aft +10s [Screenshot] => PASS");
  else
    write("Step 3: PEV ON, Sensitivity Lv.3, Bfr -10s, Aft +10s [Screenshot] => FAIL");

  if(step4_passed == 1)
    write("Step 4: PEV ON, Sensitivity Lv.4, Bfr -10s, Aft +10s [Screenshot] => PASS");
  else
    write("Step 4: PEV ON, Sensitivity Lv.4, Bfr -10s, Aft +10s [Screenshot] => FAIL");

  if(step5_passed == 1)
    write("Step 5: PEV ON, Sensitivity Lv.5, Bfr -10s, Aft +10s [Screenshot] => PASS");
  else
    write("Step 5: PEV ON, Sensitivity Lv.5, Bfr -10s, Aft +10s [Screenshot] => FAIL");

  testStep("Notifications","Finish OWP_010 - 2.0");
  write("=== FINISH OWP_010 - 2.0 ===");
}

void MainTest(){
  testReportFileName("TestReports\\OWP_010 - 2.0 generation_report");
  OWP_010_Init();

  OWP_010_1();

  OWP_010_2();

  OWP_010_3();

  OWP_010_4();

  OWP_010_5();

  OWP_010_Summary();
}
