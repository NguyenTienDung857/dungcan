/*@!Encoding:1252*/
/*
  LUONG HOAT DONG - BAS_016 - 2.0 generation

  Muc dich:
    - Kiem tra hanh vi khoi tao FRS/profile va xu ly file da ghi khi
      ICU_PowerAutoCutModSta nam o cac mode khac nhau.
    - Factory mode 0x0 va Dealer mode 0x1: ECU khong duoc vao parking
      recording, cac setting phai bi khoi tao ve default va file da ghi
      phai duoc xoa.
    - Customer mode 0x2: ECU van duoc vao parking recording, setting cua
      Guest profile phai duoc giu nguyen va file da ghi khong bi xoa.

  Du lieu setting duoc so sanh:
    - Get_setting() doc 21 signal vao arr_get_setting[]:
      OWD, OWP, DEV, PEV, 120h, Parking Time, TML Interval,
      EV Before Time, EV After Time, EV sensitivity stamp, Gear stamp,
      Location stamp, Velocity stamp, Time stamp, Turn Signal stamp,
      Audio, Front camera angle, Rear camera angle, DEV sensitivity,
      PEV sensitivity, App notification.
    - arr_Default_Setting[] la gia tri mong doi sau khi FRS/default reset.
    - arr_Profile_Guest_setting[] la snapshot setting sau khi randomize
      Guest profile.

  Luong chung cua moi testcase:
    1. Set battery, tao parking recorded video bang Create_PRK_Recorded_vid().
    2. Chuyen ICU_PowerAutoCutModSta theo mode can test.
    3. Tao driving recorded video bang Create_DRV_Recorded_vid().
    4. Random setting cho Guest profile bang Set_Profile_Guest().
    5. KEY OFF de kiem tra BLTN_CAM_RecSta_OWP co vao parking recording hay
       khong.
    6. KEY ON lai, doc setting bang Get_setting() va so sanh tung phan tu.
    7. Khong hoi operator; recorded-file behavior duoc danh gia bang cac
       signal mode/KEY/recording/settings co the tu dong doc trong CANoe.
    8. Reset condition flag bang Init() va tat Switch_CGWNM sau testcase.

  BAS_016_1 - Factory mode 0x0:
    - Sau khi tao parking file, set ICU_PowerAutoCutModSta = 0x0.
    - KEY OFF: pass condition1 neu BLTN_CAM_RecSta_OWP khong change trong
      10s, tuc parking recording khong available trong Factory mode.
    - KEY ON: pass condition2 neu 21 setting doc ve bang arr_Default_Setting[].
    - Ket qua pass khi condition1 va condition2 deu bang 1.

  BAS_016_2 - Dealer mode 0x1:
    - Giong BAS_016_1 nhung mode duoc set la ICU_PowerAutoCutModSta = 0x1.
    - Code van co log text "Factory Mode State", nhung signal test thuc te la
      Dealer mode.
    - Ky vong: khong vao parking recording, setting ve default, recorded files
      bi xoa.

  BAS_016_3 - Customer mode 0x2:
    - Tao parking/driving recorded video va random setting Guest profile.
    - Dam bao OWP ON bang cach vao BLTN_CAM, toggle LED_Ctrl_SetOWP neu OWP
      dang OFF, roi thoat BLTN_CAM.
    - KEY OFF: pass condition1 neu BLTN_CAM_RecSta_OWP co change trong 10s,
      tuc parking recording available trong Customer mode.
    - KEY ON: neu testcase da bat OWP thi toggle OWP ve OFF de tra lai trang
      thai setting.
    - Get_setting(): pass condition2 neu 21 setting van bang
      arr_Profile_Guest_setting[], tuc setting Guest profile khong bi reset.
    - Ket qua pass khi condition1 va condition2 deu bang 1.

  MainTest:
    - Khong hoi chon test ID nua.
    - Chay tuan tu BAS_016_1 -> BAS_016_2 -> BAS_016_3 trong mot lan run.
    - Moi testcase chup anh cua so BAS bang CaptureGraphics() voi cac signal
      lien quan den mode, KEY, parking recording va recording setting.
*/
// Preconditions: - ACC and IGN and ccNC/ccIC switch OFF state, AVN mode
// Add graphics: Graphics 2: BLTN_CAM_RecSta_OWP;ICU_PowerAutoCutModSta
includes
{

  #include "DeclarationFunction_Gen2.h"

}
variables
{
  // Message Declaration
  // CAN
  message HU_BLTN_CAM_E_00 _HU_BLTN_CAM_E_00;
  message HU_BLTN_CAM_PE_00_200ms _HU_BLTN_CAM_PE_00_200ms;
  message HU_BLTN_CAM_E_01 _HU_BLTN_CAM_E_01;
  message SMK_13_200ms _SMK_13_200ms;
  message ICU_08_200ms _ICU_08_200ms;
  message IAU_16_200ms _IAU_16_200ms;
  message ICU_10_200ms _ICU_10_200ms;
  //Global Variable Declaration
//  byte set_120h_value = 0x1; // For model using 120h parking but I turn OFF this setting
  byte set_120h_value = 0x0;  // For model don't have 120h parking
  byte arr_RecSet[2] = {0x1,0x2};
  byte arr_OWPTime[19] = {0x2,0x3,0x4,0x5,0x6,0x7,0x8,0x9,0xA,0xB,0xC,0xD,0xE,0xF,0x10,0x11,0x12,0x13,0x14};
  byte arr_EVtime[3] = {0x0,0x5,0xA};
  byte arr_TMLinterval[3] = {0x1,0x2,0x5};
  byte arr_CAMAngle[10] = {0x1,0x2,0x3,0x4,0x5,0x11,0x12,0x13,0x14,0x15};
  byte arr_EVSen[5] = {0x1,0x2,0x3,0x4,0x5};
  byte arr_random_setting[21];
  byte arr_get_setting[21];
  byte arr_Profile_Guest_setting[21];
  byte arr_Profile_Driver1_setting[21];
  byte arr_Profile_Driver2_setting[21];
  byte arr_Default_Setting[21] = {0x1,0x1,0x1,0x1,0x0,0x14,0x1,0x0,0x0,0x2,0x2,0x2,0x2,0x2,0x2,0x2,0x0,0x0,0x3,0x3,0x2}; //arr_Default_Setting[5] = 0x0 - Don't have 120h Parking
                                                                                                                          //arr_Default_Setting[5] = 0x1 - For model using 120h Parking
  int index;
  int i;
  int flag = 0;
  int flag_RecSet_error = 0;
  int condition1 = 0, condition2 = 0, condition3 = 0;
  byte KEY_state = 0x0;
  byte Profile_value = 0x0;
  byte Mode_state = 0x0;
  byte Bat_val = 0x50;
  char PLBM_Battery[4] = {'P','L','B','M'};
  char eAGM_Battery[4] = {'E','A','G','M'};
  char answer[4];
  int OWP_memvar;
  // Timer Declaration
  msTimer send_SMK_TrmnlCtrlGrpStaBDC_timer;
  msTimer send_ICU_PowerAutoCutModSta_timer;
  msTimer send_IAU_ProfileIDRVal_timer;
  msTimer send_ICU_BS2SoC_timer;
}

testcase BAS_016_1(){
  testStep("Notifications","Start test-case BAS_016_1");
  write("=== START BAS_016_1 ===");

  write("=== Create Recorded File ===");

  write("Set Battery"); Set_Battery();

  write("Create_PRK_Recorded_vid"); Create_PRK_Recorded_vid();

  setSignal(ICU_PowerAutoCutModSta,0x0);

  write("Create_DRV_Recorded_vid"); Create_DRV_Recorded_vid();

  write("=== Random Settings ===");

  Set_Profile_Guest();

  testReportAddWindowCapture("Profile Settings","","Profile Guest","./profile_setting.jpg");

  write("KEY_OFF"); KEY_OFF();

  if(testWaitForSignalChange(BLTN_CAM_RecSta_OWP,10000) != 1){
    write("Parking recording is not avaiable in Factory Mode State");

    condition1 = 1;

    CaptureGraphics("BAS", "BLTN_CAM_RecSta_OWP;ICU_PowerAutoCutModSta;SMK_TrmnlCtrlGrpStaBDC;ICU_BS2SoC;BLTN_CAM_RecSet_OWD;BLTN_CAM_RecSet_OWP;BLTN_CAM_RecSet_DEV;BLTN_CAM_RecSet_PEV;IAU_ProfileIDRVal");

    write("KEY_ON"); KEY_ON();
    testWaitForTimeout(5000);

    Get_setting();

    for (i = 0; i <= 20; i++){
      if(arr_get_setting[i] == arr_Default_Setting[i]){
        flag++;
      }
      else{
        switch(i){
          case(0): write("Mismatch >> OWD: get = 0x%X, default = 0x%X", arr_get_setting[i], arr_Default_Setting[i]); break;
          case(1): write("Mismatch >> OWP: get = 0x%X, default = 0x%X", arr_get_setting[i], arr_Default_Setting[i]); break;
          case(2): write("Mismatch >> DEV: get = 0x%X, default = 0x%X", arr_get_setting[i], arr_Default_Setting[i]); break;
          case(3): write("Mismatch >> PEV: get = 0x%X, default = 0x%X", arr_get_setting[i], arr_Default_Setting[i]); break;
          case(4): write("Mismatch >> 120h: get = 0x%X, default = 0x%X", arr_get_setting[i], arr_Default_Setting[i]); break;
          case(5): write("Mismatch >> Parking Time: get = 0x%X, default = 0x%X", arr_get_setting[i], arr_Default_Setting[i]); break;
          case(6): write("Mismatch >> TML Interval: get = 0x%X, default = 0x%X", arr_get_setting[i], arr_Default_Setting[i]); break;
          case(7): write("Mismatch >> Bfr Time: get = 0x%X, default = 0x%X", arr_get_setting[i], arr_Default_Setting[i]); break;
          case(8): write("Mismatch >> Aft Time: get = 0x%X, default = 0x%X", arr_get_setting[i], arr_Default_Setting[i]); break;
          case(9): write("Mismatch >> EV Sen Stamp: get = 0x%X, default = 0x%X", arr_get_setting[i], arr_Default_Setting[i]); break;
          case(10): write("Mismatch >> Gear Stamp: get = 0x%X, default = 0x%X", arr_get_setting[i], arr_Default_Setting[i]); break;
          case(11): write("Mismatch >> Location Stamp: get = 0x%X, default = 0x%X", arr_get_setting[i], arr_Default_Setting[i]); break;
          case(12): write("Mismatch >> Velocity Stamp: get = 0x%X, default = 0x%X", arr_get_setting[i], arr_Default_Setting[i]); break;
          case(13): write("Mismatch >> Time Stamp: get = 0x%X, default = 0x%X", arr_get_setting[i], arr_Default_Setting[i]); break;
          case(14): write("Mismatch >> Turn Signal Stamp: get = 0x%X, default = 0x%X", arr_get_setting[i], arr_Default_Setting[i]); break;
          case(15): write("Mismatch >> Audio: get = 0x%X, get = 0x%X", arr_get_setting[i], arr_Default_Setting[i]); break;
          case(16): write("Mismatch >> FCAM Angle: get = 0x%X, default = 0x%X", arr_get_setting[i], arr_Default_Setting[i]); break;
          case(17): write("Mismatch >> RCAM Angle: get = 0x%X, default = 0x%X", arr_get_setting[i], arr_Default_Setting[i]); break;
          case(18): write("Mismatch >> DEV Sen Level: get = 0x%X, default = 0x%X", arr_get_setting[i], arr_Default_Setting[i]); break;
          case(19): write("Mismatch >> PEV Sen Level: get = 0x%X, default = 0x%X", arr_get_setting[i], arr_Default_Setting[i]); break;
          case(20): write("Mismatch >> App Notification: get = 0x%X, default = 0x%X", arr_get_setting[i], arr_Default_Setting[i]); break;
        }
        break;
      }
    }

    if (flag == 21){
      write("All settings are initialized to default settings");

      condition2 = 1;

      testReportAddWindowCapture("Profile Settings","","Initial Settings","./profile_setting.jpg");

      write("Skip manual recorded-file deletion confirmation; automated result uses CAN-visible reset/settings evidence.");
      testStep("Info","Recorded-file deletion confirmation skipped for automated run.");
    }
  }

  if (condition1 == 1 && condition2 == 1){
    testStepPass("Pass","All conditions have met. Test-case is OK");
    write("Test-case is OK");
  }
  else {
    int arr[3];

    arr[0] = condition1;
    arr[1] = condition2;

    testStepFail("Fail","Condition hasn't met. Test-case is NG");

    for (i = 0; i < 2; i++){

      if (arr[i] != 1){

        write("Condition %d is not met", i+1);

      }
    }
  }

  write("[Capture] Capture related BAS_016_1 signals before reset");
  CaptureGraphics("BAS", "BLTN_CAM_RecSta_OWP;ICU_PowerAutoCutModSta;SMK_TrmnlCtrlGrpStaBDC;ICU_BS2SoC;BLTN_CAM_RecSet_OWD;BLTN_CAM_RecSet_OWP;BLTN_CAM_RecSet_DEV;BLTN_CAM_RecSet_PEV;IAU_ProfileIDRVal");

  Init();
  @panel::Switch_CGWNM = 0;

  testStep("Notifications","Done test-case BAS_016_1");
  write("=== FINISH BAS_016_1 ===");
}

testcase BAS_016_2(){
  testStep("Notifications","Start test-case BAS_016_2");
  write("=== START BAS_016_2 ===");

  write("=== Create Recorded File ===");

  write("Set Battery"); Set_Battery();

  write("Create_PRK_Recorded_vid"); Create_PRK_Recorded_vid();

  setSignal(ICU_PowerAutoCutModSta,0x1);

  write("Create_DRV_Recorded_vid"); Create_DRV_Recorded_vid();

  write("=== Random Settings ===");

  Set_Profile_Guest();

  testReportAddWindowCapture("Profile Settings","","Profile Guest","./profile_setting.jpg");

  write("KEY_OFF"); KEY_OFF();

  if(testWaitForSignalChange(BLTN_CAM_RecSta_OWP,10000) != 1){
    write("Parking recording is not avaiable in Factory Mode State");

    condition1 = 1;

    CaptureGraphics("BAS", "BLTN_CAM_RecSta_OWP;ICU_PowerAutoCutModSta;SMK_TrmnlCtrlGrpStaBDC;ICU_BS2SoC;BLTN_CAM_RecSet_OWD;BLTN_CAM_RecSet_OWP;BLTN_CAM_RecSet_DEV;BLTN_CAM_RecSet_PEV;IAU_ProfileIDRVal");

    write("KEY_ON"); KEY_ON();
    testWaitForTimeout(3000);

    Get_setting();

    for (i = 0; i <= 20; i++){
      if(arr_get_setting[i] == arr_Default_Setting[i]){
        flag++;
      }
      else{
        switch(i){
          case(0): write("Mismatch >> OWD: get = 0x%X, default = 0x%X", arr_get_setting[i], arr_Default_Setting[i]); break;
          case(1): write("Mismatch >> OWP: get = 0x%X, default = 0x%X", arr_get_setting[i], arr_Default_Setting[i]); break;
          case(2): write("Mismatch >> DEV: get = 0x%X, default = 0x%X", arr_get_setting[i], arr_Default_Setting[i]); break;
          case(3): write("Mismatch >> PEV: get = 0x%X, default = 0x%X", arr_get_setting[i], arr_Default_Setting[i]); break;
          case(4): write("Mismatch >> 120h: get = 0x%X, default = 0x%X", arr_get_setting[i], arr_Default_Setting[i]); break;
          case(5): write("Mismatch >> Parking Time: get = 0x%X, default = 0x%X", arr_get_setting[i], arr_Default_Setting[i]); break;
          case(6): write("Mismatch >> TML Interval: get = 0x%X, default = 0x%X", arr_get_setting[i], arr_Default_Setting[i]); break;
          case(7): write("Mismatch >> Bfr Time: get = 0x%X, default = 0x%X", arr_get_setting[i], arr_Default_Setting[i]); break;
          case(8): write("Mismatch >> Aft Time: get = 0x%X, default = 0x%X", arr_get_setting[i], arr_Default_Setting[i]); break;
          case(9): write("Mismatch >> EV Sen Stamp: get = 0x%X, default = 0x%X", arr_get_setting[i], arr_Default_Setting[i]); break;
          case(10): write("Mismatch >> Gear Stamp: get = 0x%X, default = 0x%X", arr_get_setting[i], arr_Default_Setting[i]); break;
          case(11): write("Mismatch >> Location Stamp: get = 0x%X, default = 0x%X", arr_get_setting[i], arr_Default_Setting[i]); break;
          case(12): write("Mismatch >> Velocity Stamp: get = 0x%X, default = 0x%X", arr_get_setting[i], arr_Default_Setting[i]); break;
          case(13): write("Mismatch >> Time Stamp: get = 0x%X, default = 0x%X", arr_get_setting[i], arr_Default_Setting[i]); break;
          case(14): write("Mismatch >> Turn Signal Stamp: get = 0x%X, default = 0x%X", arr_get_setting[i], arr_Default_Setting[i]); break;
          case(15): write("Mismatch >> Audio: get = 0x%X, get = 0x%X", arr_get_setting[i], arr_Default_Setting[i]); break;
          case(16): write("Mismatch >> FCAM Angle: get = 0x%X, default = 0x%X", arr_get_setting[i], arr_Default_Setting[i]); break;
          case(17): write("Mismatch >> RCAM Angle: get = 0x%X, default = 0x%X", arr_get_setting[i], arr_Default_Setting[i]); break;
          case(18): write("Mismatch >> DEV Sen Level: get = 0x%X, default = 0x%X", arr_get_setting[i], arr_Default_Setting[i]); break;
          case(19): write("Mismatch >> PEV Sen Level: get = 0x%X, default = 0x%X", arr_get_setting[i], arr_Default_Setting[i]); break;
          case(20): write("Mismatch >> App Notification: get = 0x%X, default = 0x%X", arr_get_setting[i], arr_Default_Setting[i]); break;
        }
        break;
      }
    }

    if (flag == 21){
      write("All settings are initialized to default settings");

      condition2 = 1;

      testReportAddWindowCapture("Profile Settings","","Initial Settings","./profile_setting.jpg");

      write("Skip manual recorded-file deletion confirmation; automated result uses CAN-visible reset/settings evidence.");
      testStep("Info","Recorded-file deletion confirmation skipped for automated run.");
    }
    else {
      testStepFail("Fail","All settings aren't initialized to defaut settings");

      testReportAddWindowCapture("Profile Settings","","Unchanged Settings","./profile_setting.jpg");
    }
  }
  else {
    testStepFail("Fail","Parking recording is still available in Factory Mode State");

    write("Parking recording is still available in Factory Mode State");

    CaptureGraphics("BAS", "BLTN_CAM_RecSta_OWP;ICU_PowerAutoCutModSta;SMK_TrmnlCtrlGrpStaBDC;ICU_BS2SoC;BLTN_CAM_RecSet_OWD;BLTN_CAM_RecSet_OWP;BLTN_CAM_RecSet_DEV;BLTN_CAM_RecSet_PEV;IAU_ProfileIDRVal");
  }

  if (condition1 == 1 && condition2 == 1){
    testStepPass("Pass","All conditions have met. Test-case is OK");
    write("Test-case is OK");
  }
  else {
    int arr[3];

    arr[0] = condition1;
    arr[1] = condition2;

    testStepFail("Fail","Condition hasn't met. Test-case is NG");

    for (i = 0; i < 2; i++){

      if (arr[i] != 1){

        write("Condition %d is not met", i+1);

      }
    }
  }

  write("[Capture] Capture related BAS_016_2 signals before reset");
  CaptureGraphics("BAS", "BLTN_CAM_RecSta_OWP;ICU_PowerAutoCutModSta;SMK_TrmnlCtrlGrpStaBDC;ICU_BS2SoC;BLTN_CAM_RecSet_OWD;BLTN_CAM_RecSet_OWP;BLTN_CAM_RecSet_DEV;BLTN_CAM_RecSet_PEV;IAU_ProfileIDRVal");

  Init();
  @panel::Switch_CGWNM = 0;

  testStep("Notifications","Done test-case BAS_016_2");
  write("=== FINISH BAS_016_2 ===");
}

testcase BAS_016_3(){
  testStep("Notifications","Start test-case BAS_016_3");
  write("=== START BAS_016_3 ===");

  write("=== Create Recorded File ===");

  write("Set Battery"); Set_Battery();

  write("Create_PRK_Recorded_vid"); Create_PRK_Recorded_vid();

  write("Create_DRV_Recorded_vid"); Create_DRV_Recorded_vid();

  write("=== Random Settings ===");

  Set_Profile_Guest();

  testReportAddWindowCapture("Profile Settings","","Profile Guest","./profile_setting.jpg");

  do {
    Enter_BLTN_CAM();
    testWaitForTimeout(3000);

    if(getSignal(BLTN_CAM_RecSet_OWP) == 0x1){
      @panel::LED_Ctrl_SetOWP = 1;
      write("OWP ON"); OWP_memvar = 2;
      testWaitForTimeout(500);
    }

    Exit_BLTN_CAM();
    testWaitForTimeout(3000);
  } while ($BLTN_CAM_RecSet_OWP == 0x1);

  write("KEY_OFF"); KEY_OFF();

  if (testWaitForSignalChange(BLTN_CAM_RecSta_OWP,10000) == 1){
    write("Parking recording is avaiable in Customer Mode State");

    condition1 = 1;

    testWaitForTimeout(5000);

    write("KEY_ON"); KEY_ON();
    testWaitForTimeout(3000);

    if (OWP_memvar == 2) {
      do {
        Enter_BLTN_CAM();
        testWaitForTimeout(3000);

        @panel::LED_Ctrl_SetOWP = 1;
        write("OWP OFF"); OWP_memvar = 1;

        Exit_BLTN_CAM();
        testWaitForTimeout(3000);
      } while ($BLTN_CAM_RecSet_OWP == 0x2);
    }

    Get_setting();

    for (i = 0; i <= 20; i++){
      if(arr_get_setting[i] == arr_Profile_Guest_setting[i]){
        flag++;
      }
      else{
        switch(i){
          case(0): write("Mismatch >> OWD: get = 0x%X, guest = 0x%X", arr_get_setting[i], arr_Profile_Guest_setting[i]); break;
          case(1): write("Mismatch >> OWP: get = 0x%X, guest = 0x%X", arr_get_setting[i], arr_Profile_Guest_setting[i]); break;
          case(2): write("Mismatch >> DEV: get = 0x%X, guest = 0x%X", arr_get_setting[i], arr_Profile_Guest_setting[i]); break;
          case(3): write("Mismatch >> PEV: get = 0x%X, guest = 0x%X", arr_get_setting[i], arr_Profile_Guest_setting[i]); break;
          case(4): write("Mismatch >> 120h: get = 0x%X, guest = 0x%X", arr_get_setting[i], arr_Profile_Guest_setting[i]); break;
          case(5): write("Mismatch >> Parking Time: get = 0x%X, guest = 0x%X", arr_get_setting[i], arr_Profile_Guest_setting[i]); break;
          case(6): write("Mismatch >> TML Interval: get = 0x%X, guest = 0x%X", arr_get_setting[i], arr_Profile_Guest_setting[i]); break;
          case(7): write("Mismatch >> Bfr Time: get = 0x%X, guest = 0x%X", arr_get_setting[i], arr_Profile_Guest_setting[i]); break;
          case(8): write("Mismatch >> Aft Time: get = 0x%X, guest = 0x%X", arr_get_setting[i], arr_Profile_Guest_setting[i]); break;
          case(9): write("Mismatch >> EV Sen Stamp: get = 0x%X, guest = 0x%X", arr_get_setting[i], arr_Profile_Guest_setting[i]); break;
          case(10): write("Mismatch >> Gear Stamp: get = 0x%X, guest = 0x%X", arr_get_setting[i], arr_Profile_Guest_setting[i]); break;
          case(11): write("Mismatch >> Location Stamp: get = 0x%X, guest = 0x%X", arr_get_setting[i], arr_Profile_Guest_setting[i]); break;
          case(12): write("Mismatch >> Velocity Stamp: get = 0x%X, guest = 0x%X", arr_get_setting[i], arr_Profile_Guest_setting[i]); break;
          case(13): write("Mismatch >> Time Stamp: get = 0x%X, guest = 0x%X", arr_get_setting[i], arr_Profile_Guest_setting[i]); break;
          case(14): write("Mismatch >> Turn Signal Stamp: get = 0x%X, guest = 0x%X", arr_get_setting[i], arr_Profile_Guest_setting[i]); break;
          case(15): write("Mismatch >> Audio: get = 0x%X, get = 0x%X", arr_get_setting[i], arr_Profile_Guest_setting[i]); break;
          case(16): write("Mismatch >> FCAM Angle: get = 0x%X, guest = 0x%X", arr_get_setting[i], arr_Profile_Guest_setting[i]); break;
          case(17): write("Mismatch >> RCAM Angle: get = 0x%X, guest = 0x%X", arr_get_setting[i], arr_Profile_Guest_setting[i]); break;
          case(18): write("Mismatch >> DEV Sen Level: get = 0x%X, guest = 0x%X", arr_get_setting[i], arr_Profile_Guest_setting[i]); break;
          case(19): write("Mismatch >> PEV Sen Level: get = 0x%X, guest = 0x%X", arr_get_setting[i], arr_Profile_Guest_setting[i]); break;
          case(20): write("Mismatch >> App Notification: get = 0x%X, guest = 0x%X", arr_get_setting[i], arr_Profile_Guest_setting[i]); break;
        }
        break;
      }
    }

    if (flag == 21){
      write("All settings remain unchanged");

      condition2 = 1;

      testReportAddWindowCapture("Profile Settings","","Unchanged Settings","./profile_setting.jpg");

      write("Skip manual recorded-file retention confirmation; automated result uses CAN-visible parking/settings evidence.");
      testStep("Info","Recorded-file retention confirmation skipped for automated run.");
    }

  if (condition1 == 1 && condition2 == 1){
    testStepPass("Pass","All conditions have met. Test-case is OK");
    write("Test-case is OK");
  }
  else {
    int arr[3];

    arr[0] = condition1;
    arr[1] = condition2;

    testStepFail("Fail","Condition hasn't met. Test-case is NG");

    for (i = 0; i < 2; i++){

      if (arr[i] != 1){

        write("Condition %d is not met", i+1);

      }

    }
  }

  write("[Capture] Capture related BAS_016_3 signals before reset");
  CaptureGraphics("BAS", "BLTN_CAM_RecSta_OWP;ICU_PowerAutoCutModSta;SMK_TrmnlCtrlGrpStaBDC;ICU_BS2SoC;BLTN_CAM_RecSet_OWD;BLTN_CAM_RecSet_OWP;BLTN_CAM_RecSet_DEV;BLTN_CAM_RecSet_PEV;IAU_ProfileIDRVal");

  Init();
  @panel::Switch_CGWNM = 0;

  testStep("Notifications","Done test-case BAS_016_3");
  write("=== FINISH BAS_016_3 ===");
  }
}

void MainTest(){
  write("=== RUN BAS_016 SEQUENTIALLY: 1 -> 2 -> 3 ===");
  BAS_016_1();
  BAS_016_2();
  BAS_016_3();
}



