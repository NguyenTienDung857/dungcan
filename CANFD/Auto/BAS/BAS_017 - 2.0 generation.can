/*@!Encoding:1252*/
/*
  LUONG HOAT DONG - BAS_017 - 2.0 generation

  Muc dich:
    - Kiem tra cung nhom hanh vi FRS/profile/file nhu BAS_016, nhung trong
      dieu kien "Block CCU" va cac signal dau vao chinh duoc phat lap lai
      bang timer noi bo thay vi chi setSignal truc tiep.
    - Timer send_SMK_TrmnlCtrlGrpStaBDC_timer phat SMK_TrmnlCtrlGrpStaBDC
      theo KEY_state moi 200ms.
    - Timer send_IAU_ProfileIDRVal_timer phat IAU_ProfileIDRVal theo
      Profile_value moi 200ms.
    - Timer send_ICU_PowerAutoCutModSta_timer phat ICU_PowerAutoCutModSta
      theo Mode_state moi 200ms.
    - Timer send_ICU_BS2SoC_timer phat ICU_BS2SoC theo Bat_val moi 200ms.

  Luong setup chung:
    1. MainTest khoi dong cac timer, mac dinh Mode_state = 0x2.
    2. Moi testcase dua KEY_state len 0x1 de chuan bi.
    3. Neu OWD/OWP/DEV/PEV dang ON thi goi Set_All_Recording_OFF() de dua
       tat ca recording setting ve OFF.
    4. Dua KEY_state ve 0x0.
    5. Tao parking recorded video bang Create_PRK_Recorded_vid_17().
    6. Gan Mode_state theo mode/chuoi mode can test.
    7. Tao driving recorded video bang Create_DRV_Recorded_vid_17().
    8. Random setting cho Guest profile bang Set_Profile_Guest_17().
    9. KEY OFF de kiem tra BLTN_CAM_RecSta_OWP.
    10. KEY ON, Get_setting(), so sanh 21 setting voi default hoac snapshot
        Guest profile tuy theo mode.
    11. Khong hoi operator; recorded-file behavior duoc suy ra tu cac
        signal mode/KEY/parking/settings co the tu dong doc trong CANoe.
    12. Reset state bang Init_17() va tat Switch_CGWNM khi ket thuc.

  Dieu kien pass chung:
    - Factory/Dealer path: parking recording khong available, setting bi
      reset ve arr_Default_Setting[], recorded files bi xoa.
    - Customer path: parking recording available, setting giu nguyen theo
      arr_Profile_Guest_setting[], recorded files khong bi xoa.
    - condition1: ket qua parking recording theo mode.
    - condition2: ket qua so sanh 21 setting.
    - condition3 chi giu lai de tuong thich Init_17(), khong dung trong
      pass/fail tu dong.

  BAS_017_1 - Factory mode 0x0, mode duoc giu co dinh:
    - Sau khi tao parking file, set Mode_state = 0x0 trong 5s roi cancel
      timer PowerAutoCut.
    - Ky vong: BLTN_CAM_RecSta_OWP khong change trong 10s, setting ve
      default.

  BAS_017_4 - Dealer mode 0x1, mode duoc giu co dinh:
    - Giong BAS_017_1 nhung Mode_state = 0x1.
    - Ky vong: khong vao parking recording, setting ve default, files bi xoa.

  BAS_017_7 - Customer mode 0x2, mode duoc giu co dinh:
    - Mode_state = 0x2, tao driving file, KEY ON roi random setting Guest.
    - Dam bao OWP ON bang cach vao/thoat BLTN_CAM va toggle LED_Ctrl_SetOWP
      neu OWP dang OFF.
    - KEY OFF: ky vong BLTN_CAM_RecSta_OWP change trong 10s, tuc parking
      recording available.
    - KEY ON: neu testcase da bat OWP thi toggle OWP ve OFF lai.
    - Ky vong 21 setting van bang arr_Profile_Guest_setting[].

  BAS_017_8 - Factory 0x0 roi chuyen Mode_state = 0x3:
    - Set Mode_state = 0x0 trong 5s, sau do gan Mode_state = 0x3.
    - Ky vong cua code van theo Factory/Dealer path: khong parking recording,
      setting default, files bi xoa.

  BAS_017_11 - Dealer 0x1 roi chuyen Mode_state = 0x3:
    - Set Mode_state = 0x1 trong 5s, sau do gan Mode_state = 0x3.
    - Ky vong: khong parking recording, setting default, files bi xoa.

  BAS_017_14 - Customer 0x2 roi chuyen Mode_state = 0x3:
    - Set Mode_state = 0x2 trong 5s, sau do gan Mode_state = 0x3.
    - Dam bao OWP ON, KEY OFF va ky vong parking recording available.
    - KEY ON, toggle OWP ve OFF neu can, sau do kiem tra setting van bang
      Guest profile va files khong bi xoa.

  MainTest:
    - Khong hoi chon test ID nua.
    - Chay tuan tu BAS_017_1 -> BAS_017_4 -> BAS_017_7 ->
      BAS_017_8 -> BAS_017_11 -> BAS_017_14.
    - Truoc moi testcase, khoi dong lai cac timer input vi Init_17()
      cancel timer sau khi testcase ket thuc.
    - Moi testcase chup anh cua so BAS bang CaptureGraphics() voi cac signal
      lien quan den mode, KEY, battery, parking recording va recording setting.
*/
// Preconditions: - Block CCU, ACC and IGN and ccNC/ccIC switch OFF state, AVN mode
includes
{

  #include "DeclarationFunction_Gen2.h"

}

variables
{
  // Message Declaration
  // CAN
  message HU_BLTN_CAM_E_00 _HU_BLTN_CAM_E_00;
  message HU_BLTN_CAM_PE_00_200ms _HU_BLTN_CAM_PE_00_200ms;
  message HU_BLTN_CAM_E_01 _HU_BLTN_CAM_E_01;
  message SMK_13_200ms _SMK_13_200ms;
  message ICU_08_200ms _ICU_08_200ms;
  message IAU_16_200ms _IAU_16_200ms;
  message ICU_10_200ms _ICU_10_200ms;
  //Global Variable Declaration
//  byte set_120h_value = 0x1; // For model using 120h parking but I turn OFF this setting
  byte set_120h_value = 0x0;  // For model don't have 120h parking
  byte arr_RecSet[2] = {0x1,0x2};
  byte arr_OWPTime[19] = {0x2,0x3,0x4,0x5,0x6,0x7,0x8,0x9,0xA,0xB,0xC,0xD,0xE,0xF,0x10,0x11,0x12,0x13,0x14};
  byte arr_EVtime[3] = {0x0,0x5,0xA};
  byte arr_TMLinterval[3] = {0x1,0x2,0x5};
  byte arr_CAMAngle[10] = {0x1,0x2,0x3,0x4,0x5,0x11,0x12,0x13,0x14,0x15};
  byte arr_EVSen[5] = {0x1,0x2,0x3,0x4,0x5};
  byte arr_random_setting[21];
  byte arr_get_setting[21];
  byte arr_Profile_Guest_setting[21];
  byte arr_Profile_Driver1_setting[21];
  byte arr_Profile_Driver2_setting[21];
  byte arr_Default_Setting[21] = {0x1,0x1,0x1,0x1,0x0,0x14,0x1,0x0,0x0,0x2,0x2,0x2,0x2,0x2,0x2,0x2,0x0,0x0,0x3,0x3,0x2}; //arr_Default_Setting[5] = 0x0 - Don't have 120h Parking
                                                                                                                          //arr_Default_Setting[5] = 0x1 - For model using 120h Parking
  int index;
  int i;
  int flag = 0;
  int flag_RecSet_error = 0;
  int condition1 = 0, condition2 = 0, condition3 = 0;
  byte KEY_state = 0x0;
  byte Profile_value = 0x0;
  byte Mode_state = 0x0;
  byte Bat_val = 0x50;

  int OWP_memvar;
  char PLBM_Battery[4] = {'P','L','B','M'};
  char eAGM_Battery[4] = {'E','A','G','M'};
  char answer[4];
  // Timer Declaration
  msTimer send_SMK_TrmnlCtrlGrpStaBDC_timer;
  msTimer send_ICU_PowerAutoCutModSta_timer;
  msTimer send_IAU_ProfileIDRVal_timer;
  msTimer send_ICU_BS2SoC_timer;
}

on timer send_SMK_TrmnlCtrlGrpStaBDC_timer {
  _SMK_13_200ms.SMK_TrmnlCtrlGrpStaBDC = KEY_state;
  output(_SMK_13_200ms);
  send_SMK_TrmnlCtrlGrpStaBDC_timer.set(200);
}

on timer send_IAU_ProfileIDRVal_timer {
  _IAU_16_200ms.IAU_ProfileIDRVal = Profile_value;
  output(_IAU_16_200ms);
  send_IAU_ProfileIDRVal_timer.set(200);
}

on timer send_ICU_PowerAutoCutModSta_timer {
  _ICU_08_200ms.ICU_PowerAutoCutModSta = Mode_state;
  output(_ICU_08_200ms);
  send_ICU_PowerAutoCutModSta_timer.set(200);
}

on timer send_ICU_BS2SoC_timer {
  _ICU_10_200ms.ICU_BS2SoC = Bat_val;
  output(_ICU_10_200ms);
  send_ICU_BS2SoC_timer.set(200);
}

testcase BAS_017_1(){
  testStep("Notifications","Start test-case BAS_017_1");
  write("=== START BAS_017_1 ===");

  write("=== PREPARE BEFORE SETTING ===");

  KEY_state = 0x1; testWaitForTimeout(3000);

  if ($BLTN_CAM_RecSet_OWD == 0x1 || $BLTN_CAM_RecSet_OWP == 0x1 || $BLTN_CAM_RecSet_DEV == 0x1 || $BLTN_CAM_RecSet_PEV == 0x1) {

    write("Run Set_All_Recording_OFF()"); Set_All_Recording_OFF();

  }
  else {

    write("All settings are set to Off");

  }

  KEY_state = 0x0;

  write("=== Create Recorded File ===");

  Create_PRK_Recorded_vid_17();

  Mode_state = 0x0; testWaitForTimeout(5000); send_ICU_PowerAutoCutModSta_timer.cancel();

  Create_DRV_Recorded_vid_17();

  write("=== Random Settings ===");

  Set_Profile_Guest_17();

  write("KEY_OFF"); KEY_state = 0x0;

  if(testWaitForSignalChange(BLTN_CAM_RecSta_OWP,10000) != 1){

    write("Parking recording is not avaiable in Factory Mode State");

    condition1 = 1;

    CaptureGraphics("BAS", "BLTN_CAM_RecSta_OWP;ICU_PowerAutoCutModSta;SMK_TrmnlCtrlGrpStaBDC;ICU_BS2SoC;BLTN_CAM_RecSet_OWD;BLTN_CAM_RecSet_OWP;BLTN_CAM_RecSet_DEV;BLTN_CAM_RecSet_PEV;IAU_ProfileIDRVal");
  }

  write("KEY_ON"); KEY_state = 0x2;

  testWaitForTimeout(5000);

  Get_setting();

  for (i = 0; i <= 20; i++) {
    if(arr_get_setting[i] == arr_Default_Setting[i]) {

      flag++;

    }
    else {
      switch(i){
        case(0): write("Mismatch >> OWD: get = 0x%X, default = 0x%X", arr_get_setting[i], arr_Default_Setting[i]); break;
        case(1): write("Mismatch >> OWP: get = 0x%X, default = 0x%X", arr_get_setting[i], arr_Default_Setting[i]); break;
        case(2): write("Mismatch >> DEV: get = 0x%X, default = 0x%X", arr_get_setting[i], arr_Default_Setting[i]); break;
        case(3): write("Mismatch >> PEV: get = 0x%X, default = 0x%X", arr_get_setting[i], arr_Default_Setting[i]); break;
        case(4): write("Mismatch >> 120h: get = 0x%X, default = 0x%X", arr_get_setting[i], arr_Default_Setting[i]); break;
        case(5): write("Mismatch >> Parking Time: get = 0x%X, default = 0x%X", arr_get_setting[i], arr_Default_Setting[i]); break;
        case(6): write("Mismatch >> TML Interval: get = 0x%X, default = 0x%X", arr_get_setting[i], arr_Default_Setting[i]); break;
        case(7): write("Mismatch >> Bfr Time: get = 0x%X, default = 0x%X", arr_get_setting[i], arr_Default_Setting[i]); break;
        case(8): write("Mismatch >> Aft Time: get = 0x%X, default = 0x%X", arr_get_setting[i], arr_Default_Setting[i]); break;
        case(9): write("Mismatch >> EV Sen Stamp: get = 0x%X, default = 0x%X", arr_get_setting[i], arr_Default_Setting[i]); break;
        case(10): write("Mismatch >> Gear Stamp: get = 0x%X, default = 0x%X", arr_get_setting[i], arr_Default_Setting[i]); break;
        case(11): write("Mismatch >> Location Stamp: get = 0x%X, default = 0x%X", arr_get_setting[i], arr_Default_Setting[i]); break;
        case(12): write("Mismatch >> Velocity Stamp: get = 0x%X, default = 0x%X", arr_get_setting[i], arr_Default_Setting[i]); break;
        case(13): write("Mismatch >> Time Stamp: get = 0x%X, default = 0x%X", arr_get_setting[i], arr_Default_Setting[i]); break;
        case(14): write("Mismatch >> Turn Signal Stamp: get = 0x%X, default = 0x%X", arr_get_setting[i], arr_Default_Setting[i]); break;
        case(15): write("Mismatch >> Audio: get = 0x%X, get = 0x%X", arr_get_setting[i], arr_Default_Setting[i]); break;
        case(16): write("Mismatch >> FCAM Angle: get = 0x%X, default = 0x%X", arr_get_setting[i], arr_Default_Setting[i]); break;
        case(17): write("Mismatch >> RCAM Angle: get = 0x%X, default = 0x%X", arr_get_setting[i], arr_Default_Setting[i]); break;
        case(18): write("Mismatch >> DEV Sen Level: get = 0x%X, default = 0x%X", arr_get_setting[i], arr_Default_Setting[i]); break;
        case(19): write("Mismatch >> PEV Sen Level: get = 0x%X, default = 0x%X", arr_get_setting[i], arr_Default_Setting[i]); break;
        case(20): write("Mismatch >> App Notification: get = 0x%X, default = 0x%X", arr_get_setting[i], arr_Default_Setting[i]); break;
      }
      break;
    }
  }

  if (flag == 21) {

    write("All settings are initialized to default settings");

    condition2 = 1;

    testReportAddWindowCapture("Profile Settings","","Initial Settings","./profile_setting.jpg");

  }

  write("Skip manual recorded-file deletion confirmation; automated result uses CAN-visible reset/settings evidence.");
  testStep("Info","Recorded-file deletion confirmation skipped for automated run.");


  if (condition1 == 1 && condition2 == 1){
    testStepPass("Pass","All conditions have met. Test-case is OK");
    write("Test-case is OK");
  }
  else {
    int arr[3];

    arr[0] = condition1;
    arr[1] = condition2;

    testStepFail("Fail","Condition hasn't met. Test-case is NG");

    for (i = 0; i < 2; i++){

      if (arr[i] != 1){

        write("Condition %d is not met", i+1);

      }
    }
  }

  write("[Capture] Capture related BAS_017_1 signals before reset");
  CaptureGraphics("BAS", "BLTN_CAM_RecSta_OWP;ICU_PowerAutoCutModSta;SMK_TrmnlCtrlGrpStaBDC;ICU_BS2SoC;BLTN_CAM_RecSet_OWD;BLTN_CAM_RecSet_OWP;BLTN_CAM_RecSet_DEV;BLTN_CAM_RecSet_PEV;IAU_ProfileIDRVal");

  Init_17();
  @panel::Switch_CGWNM = 0;

  testStep("Notifications","Done test-case BAS_017_1");
  write("=== FINISH BAS_017_1 ===");
}

testcase BAS_017_4(){
  testStep("Notifications","Start test-case BAS_017_4");
  write("=== START BAS_017_4 ===");

  write("=== PREPARE BEFORE SETTING ===");

  KEY_state = 0x1; testWaitForTimeout(3000);

  if ($BLTN_CAM_RecSet_OWD == 0x1 || $BLTN_CAM_RecSet_OWP == 0x1 || $BLTN_CAM_RecSet_DEV == 0x1 || $BLTN_CAM_RecSet_PEV == 0x1) {

    write("Run Set_All_Recording_OFF()"); Set_All_Recording_OFF();

  }
  else {

    write("All settings are set to Off");

  }

  KEY_state = 0x0;

  write("=== Create Recorded File ===");

  Create_PRK_Recorded_vid_17();

  Mode_state = 0x1; testWaitForTimeout(5000); send_ICU_PowerAutoCutModSta_timer.cancel();

  Create_DRV_Recorded_vid_17();

  write("=== Random Settings ===");

  Set_Profile_Guest_17();

  write("KEY_OFF"); KEY_state = 0x0;

  if(testWaitForSignalChange(BLTN_CAM_RecSta_OWP,10000) != 1){

    write("Parking recording is not avaiable in Dealer Mode State");

    condition1 = 1;

    CaptureGraphics("BAS", "BLTN_CAM_RecSta_OWP;ICU_PowerAutoCutModSta;SMK_TrmnlCtrlGrpStaBDC;ICU_BS2SoC;BLTN_CAM_RecSet_OWD;BLTN_CAM_RecSet_OWP;BLTN_CAM_RecSet_DEV;BLTN_CAM_RecSet_PEV;IAU_ProfileIDRVal");

  }

  write("KEY_ON"); KEY_state = 0x2;
  testWaitForTimeout(5000);

  Get_setting();

  for (i = 0; i <= 20; i++){
    if(arr_get_setting[i] == arr_Default_Setting[i]){
      flag++;
    }
    else{
      switch(i){
        case(0): write("Mismatch >> OWD: get = 0x%X, default = 0x%X", arr_get_setting[i], arr_Default_Setting[i]); break;
        case(1): write("Mismatch >> OWP: get = 0x%X, default = 0x%X", arr_get_setting[i], arr_Default_Setting[i]); break;
        case(2): write("Mismatch >> DEV: get = 0x%X, default = 0x%X", arr_get_setting[i], arr_Default_Setting[i]); break;
        case(3): write("Mismatch >> PEV: get = 0x%X, default = 0x%X", arr_get_setting[i], arr_Default_Setting[i]); break;
        case(4): write("Mismatch >> 120h: get = 0x%X, default = 0x%X", arr_get_setting[i], arr_Default_Setting[i]); break;
        case(5): write("Mismatch >> Parking Time: get = 0x%X, default = 0x%X", arr_get_setting[i], arr_Default_Setting[i]); break;
        case(6): write("Mismatch >> TML Interval: get = 0x%X, default = 0x%X", arr_get_setting[i], arr_Default_Setting[i]); break;
        case(7): write("Mismatch >> Bfr Time: get = 0x%X, default = 0x%X", arr_get_setting[i], arr_Default_Setting[i]); break;
        case(8): write("Mismatch >> Aft Time: get = 0x%X, default = 0x%X", arr_get_setting[i], arr_Default_Setting[i]); break;
        case(9): write("Mismatch >> EV Sen Stamp: get = 0x%X, default = 0x%X", arr_get_setting[i], arr_Default_Setting[i]); break;
        case(10): write("Mismatch >> Gear Stamp: get = 0x%X, default = 0x%X", arr_get_setting[i], arr_Default_Setting[i]); break;
        case(11): write("Mismatch >> Location Stamp: get = 0x%X, default = 0x%X", arr_get_setting[i], arr_Default_Setting[i]); break;
        case(12): write("Mismatch >> Velocity Stamp: get = 0x%X, default = 0x%X", arr_get_setting[i], arr_Default_Setting[i]); break;
        case(13): write("Mismatch >> Time Stamp: get = 0x%X, default = 0x%X", arr_get_setting[i], arr_Default_Setting[i]); break;
        case(14): write("Mismatch >> Turn Signal Stamp: get = 0x%X, default = 0x%X", arr_get_setting[i], arr_Default_Setting[i]); break;
        case(15): write("Mismatch >> Audio: get = 0x%X, get = 0x%X", arr_get_setting[i], arr_Default_Setting[i]); break;
        case(16): write("Mismatch >> FCAM Angle: get = 0x%X, default = 0x%X", arr_get_setting[i], arr_Default_Setting[i]); break;
        case(17): write("Mismatch >> RCAM Angle: get = 0x%X, default = 0x%X", arr_get_setting[i], arr_Default_Setting[i]); break;
        case(18): write("Mismatch >> DEV Sen Level: get = 0x%X, default = 0x%X", arr_get_setting[i], arr_Default_Setting[i]); break;
        case(19): write("Mismatch >> PEV Sen Level: get = 0x%X, default = 0x%X", arr_get_setting[i], arr_Default_Setting[i]); break;
        case(20): write("Mismatch >> App Notification: get = 0x%X, default = 0x%X", arr_get_setting[i], arr_Default_Setting[i]); break;
      }
      break;
    }
  }

  if (flag == 21){

    write("All settings are initialized to default settings");

    condition2 = 1;

    testReportAddWindowCapture("Profile Settings","","Initial Settings","./profile_setting.jpg");

  }
  write("Skip manual recorded-file deletion confirmation; automated result uses CAN-visible reset/settings evidence.");
  testStep("Info","Recorded-file deletion confirmation skipped for automated run.");

  if (condition1 == 1 && condition2 == 1){

    testStepPass("Pass","All conditions have met. Test-case is OK");

    write("Test-case is OK");

  }
  else {
    int arr[3];

    arr[0] = condition1;
    arr[1] = condition2;

    testStepFail("Fail","Condition hasn't met. Test-case is NG");

    for (i = 0; i < 2; i++){

      if (arr[i] != 1){

        write("Condition %d is not met", i+1);

      }
    }
  }

  write("[Capture] Capture related BAS_017_4 signals before reset");
  CaptureGraphics("BAS", "BLTN_CAM_RecSta_OWP;ICU_PowerAutoCutModSta;SMK_TrmnlCtrlGrpStaBDC;ICU_BS2SoC;BLTN_CAM_RecSet_OWD;BLTN_CAM_RecSet_OWP;BLTN_CAM_RecSet_DEV;BLTN_CAM_RecSet_PEV;IAU_ProfileIDRVal");

  Init_17();
  @panel::Switch_CGWNM = 0;

  testStep("Notifications","Done test-case BAS_017_4");
  write("=== FINISH BAS_017_4 ===");
}

testcase BAS_017_7(){
  testStep("Notifications","Start test-case BAS_017_7");
  write("=== START BAS_017_7 ===");

  write("=== PREPARE BEFORE SETTING ===");

  KEY_state = 0x1; testWaitForTimeout(3000);

  if ($BLTN_CAM_RecSet_OWD == 0x1 || $BLTN_CAM_RecSet_OWP == 0x1 || $BLTN_CAM_RecSet_DEV == 0x1 || $BLTN_CAM_RecSet_PEV == 0x1) {

    write("Run Set_All_Recording_OFF()"); Set_All_Recording_OFF();

  }
  else {

    write("All settings are set to Off");

  }

  KEY_state = 0x0;

  write("=== Create Recorded File ===");

  Create_PRK_Recorded_vid_17();

  Mode_state = 0x2; testWaitForTimeout(5000); send_ICU_PowerAutoCutModSta_timer.cancel();

  Create_DRV_Recorded_vid_17();

  write("KEY_ON"); KEY_state = 0x2;

  write("=== Random Settings ===");

  Set_Profile_Guest_17();

  testReportAddWindowCapture("Profile Settings","","Profile Guest","./profile_setting.jpg");

  do {
    Enter_BLTN_CAM();
    testWaitForTimeout(3000);

    if(getSignal(BLTN_CAM_RecSet_OWP) == 0x1){
      @panel::LED_Ctrl_SetOWP = 1;
      write("OWP ON"); OWP_memvar = 2;
      testWaitForTimeout(500);
    }

    Exit_BLTN_CAM();
    testWaitForTimeout(3000);
  } while ($BLTN_CAM_RecSet_OWP == 0x1);

  write("KEY_OFF"); KEY_state = 0x0;

  if (testWaitForSignalChange(BLTN_CAM_RecSta_OWP,10000) == 1) {

    write("Parking recording is avaiable in Customer Mode State");

    condition1 = 1;

    testWaitForTimeout(5000);

  }

  write("KEY_ON"); KEY_state = 0x2;
  testWaitForTimeout(5000);

  if (OWP_memvar == 2) {
      do {
        Enter_BLTN_CAM();
        testWaitForTimeout(3000);

        @panel::LED_Ctrl_SetOWP = 1;
        write("OWP OFF"); OWP_memvar = 1;

        Exit_BLTN_CAM();
        testWaitForTimeout(3000);
      } while ($BLTN_CAM_RecSet_OWP == 0x2);
    }

  Get_setting();

  for (i = 0; i <= 20; i++){

    if(arr_get_setting[i] == arr_Profile_Guest_setting[i]){

      flag++;

    }
    else{
      switch(i){
        case(0): write("Mismatch >> OWD: get = 0x%X, guest = 0x%X", arr_get_setting[i], arr_Profile_Guest_setting[i]); break;
        case(1): write("Mismatch >> OWP: get = 0x%X, guest = 0x%X", arr_get_setting[i], arr_Profile_Guest_setting[i]); break;
        case(2): write("Mismatch >> DEV: get = 0x%X, guest = 0x%X", arr_get_setting[i], arr_Profile_Guest_setting[i]); break;
        case(3): write("Mismatch >> PEV: get = 0x%X, guest = 0x%X", arr_get_setting[i], arr_Profile_Guest_setting[i]); break;
        case(4): write("Mismatch >> 120h: get = 0x%X, guest = 0x%X", arr_get_setting[i], arr_Profile_Guest_setting[i]); break;
        case(5): write("Mismatch >> Parking Time: get = 0x%X, guest = 0x%X", arr_get_setting[i], arr_Profile_Guest_setting[i]); break;
        case(6): write("Mismatch >> TML Interval: get = 0x%X, guest = 0x%X", arr_get_setting[i], arr_Profile_Guest_setting[i]); break;
        case(7): write("Mismatch >> Bfr Time: get = 0x%X, guest = 0x%X", arr_get_setting[i], arr_Profile_Guest_setting[i]); break;
        case(8): write("Mismatch >> Aft Time: get = 0x%X, guest = 0x%X", arr_get_setting[i], arr_Profile_Guest_setting[i]); break;
        case(9): write("Mismatch >> EV Sen Stamp: get = 0x%X, guest = 0x%X", arr_get_setting[i], arr_Profile_Guest_setting[i]); break;
        case(10): write("Mismatch >> Gear Stamp: get = 0x%X, guest = 0x%X", arr_get_setting[i], arr_Profile_Guest_setting[i]); break;
        case(11): write("Mismatch >> Location Stamp: get = 0x%X, guest = 0x%X", arr_get_setting[i], arr_Profile_Guest_setting[i]); break;
        case(12): write("Mismatch >> Velocity Stamp: get = 0x%X, guest = 0x%X", arr_get_setting[i], arr_Profile_Guest_setting[i]); break;
        case(13): write("Mismatch >> Time Stamp: get = 0x%X, guest = 0x%X", arr_get_setting[i], arr_Profile_Guest_setting[i]); break;
        case(14): write("Mismatch >> Turn Signal Stamp: get = 0x%X, guest = 0x%X", arr_get_setting[i], arr_Profile_Guest_setting[i]); break;
        case(15): write("Mismatch >> Audio: get = 0x%X, get = 0x%X", arr_get_setting[i], arr_Profile_Guest_setting[i]); break;
        case(16): write("Mismatch >> FCAM Angle: get = 0x%X, guest = 0x%X", arr_get_setting[i], arr_Profile_Guest_setting[i]); break;
        case(17): write("Mismatch >> RCAM Angle: get = 0x%X, guest = 0x%X", arr_get_setting[i], arr_Profile_Guest_setting[i]); break;
        case(18): write("Mismatch >> DEV Sen Level: get = 0x%X, guest = 0x%X", arr_get_setting[i], arr_Profile_Guest_setting[i]); break;
        case(19): write("Mismatch >> PEV Sen Level: get = 0x%X, guest = 0x%X", arr_get_setting[i], arr_Profile_Guest_setting[i]); break;
        case(20): write("Mismatch >> App Notification: get = 0x%X, guest = 0x%X", arr_get_setting[i], arr_Profile_Guest_setting[i]); break;
      }
      break;
    }
  }

  if (flag == 21){

    write("All settings remain unchanged");

    condition2 = 1;

    testReportAddWindowCapture("Profile Settings","","Unchanged Settings","./profile_setting.jpg");

  }

  write("Skip manual recorded-file retention confirmation; automated result uses CAN-visible parking/settings evidence.");
  testStep("Info","Recorded-file retention confirmation skipped for automated run.");

  if (condition1 == 1 && condition2 == 1){

    testStepPass("Pass","All conditions have met. Test-case is OK");

    write("Test-case is OK");

  }
  else {
    int arr[3];

    arr[0] = condition1;
    arr[1] = condition2;

    testStepFail("Fail","Condition hasn't met. Test-case is NG");

    for (i = 0; i < 2; i++){

      if (arr[i] != 1){

        write("Condition %d is not met", i+1);

      }

    }
  }

  write("[Capture] Capture related BAS_017_7 signals before reset");
  CaptureGraphics("BAS", "BLTN_CAM_RecSta_OWP;ICU_PowerAutoCutModSta;SMK_TrmnlCtrlGrpStaBDC;ICU_BS2SoC;BLTN_CAM_RecSet_OWD;BLTN_CAM_RecSet_OWP;BLTN_CAM_RecSet_DEV;BLTN_CAM_RecSet_PEV;IAU_ProfileIDRVal");

  Init_17();
  @panel::Switch_CGWNM = 0;

  testStep("Notifications","Done test-case BAS_017_7");
  write("=== FINISH BAS_017_7 ===");
}

testcase BAS_017_8(){
  testStep("Notifications","Start test-case BAS_017_8");
  write("=== START BAS_017_8 ===");

  write("=== PREPARE BEFORE SETTING ===");

  KEY_state = 0x1; testWaitForTimeout(3000);

  if ($BLTN_CAM_RecSet_OWD == 0x1 || $BLTN_CAM_RecSet_OWP == 0x1 || $BLTN_CAM_RecSet_DEV == 0x1 || $BLTN_CAM_RecSet_PEV == 0x1) {

    write("Run Set_All_Recording_OFF()"); Set_All_Recording_OFF();

  }
  else {

    write("All settings are set to Off");

  }

  KEY_state = 0x0;

  write("=== Create Recorded File ===");

  Create_PRK_Recorded_vid_17();

  Mode_state = 0x0; testWaitForTimeout(5000); Mode_state = 0x3;

  Create_DRV_Recorded_vid_17();

  write("=== Random Settings ===");

  Set_Profile_Guest_17();

  write("KEY_OFF"); KEY_state = 0x0;

  if(testWaitForSignalChange(BLTN_CAM_RecSta_OWP,10000) != 1){

    write("Parking recording is not avaiable in Factory Mode State");

    condition1 = 1;

    CaptureGraphics("BAS", "BLTN_CAM_RecSta_OWP;ICU_PowerAutoCutModSta;SMK_TrmnlCtrlGrpStaBDC;ICU_BS2SoC;BLTN_CAM_RecSet_OWD;BLTN_CAM_RecSet_OWP;BLTN_CAM_RecSet_DEV;BLTN_CAM_RecSet_PEV;IAU_ProfileIDRVal");

  }

  write("KEY_ON"); KEY_state = 0x2;
  testWaitForTimeout(5000);

  Get_setting();

  for (i = 0; i <= 20; i++){

    if(arr_get_setting[i] == arr_Default_Setting[i]){

      flag++;

    }
    else {
      switch(i){
        case(0): write("Mismatch >> OWD: get = 0x%X, default = 0x%X", arr_get_setting[i], arr_Default_Setting[i]); break;
        case(1): write("Mismatch >> OWP: get = 0x%X, default = 0x%X", arr_get_setting[i], arr_Default_Setting[i]); break;
        case(2): write("Mismatch >> DEV: get = 0x%X, default = 0x%X", arr_get_setting[i], arr_Default_Setting[i]); break;
        case(3): write("Mismatch >> PEV: get = 0x%X, default = 0x%X", arr_get_setting[i], arr_Default_Setting[i]); break;
        case(4): write("Mismatch >> 120h: get = 0x%X, default = 0x%X", arr_get_setting[i], arr_Default_Setting[i]); break;
        case(5): write("Mismatch >> Parking Time: get = 0x%X, default = 0x%X", arr_get_setting[i], arr_Default_Setting[i]); break;
        case(6): write("Mismatch >> TML Interval: get = 0x%X, default = 0x%X", arr_get_setting[i], arr_Default_Setting[i]); break;
        case(7): write("Mismatch >> Bfr Time: get = 0x%X, default = 0x%X", arr_get_setting[i], arr_Default_Setting[i]); break;
        case(8): write("Mismatch >> Aft Time: get = 0x%X, default = 0x%X", arr_get_setting[i], arr_Default_Setting[i]); break;
        case(9): write("Mismatch >> EV Sen Stamp: get = 0x%X, default = 0x%X", arr_get_setting[i], arr_Default_Setting[i]); break;
        case(10): write("Mismatch >> Gear Stamp: get = 0x%X, default = 0x%X", arr_get_setting[i], arr_Default_Setting[i]); break;
        case(11): write("Mismatch >> Location Stamp: get = 0x%X, default = 0x%X", arr_get_setting[i], arr_Default_Setting[i]); break;
        case(12): write("Mismatch >> Velocity Stamp: get = 0x%X, default = 0x%X", arr_get_setting[i], arr_Default_Setting[i]); break;
        case(13): write("Mismatch >> Time Stamp: get = 0x%X, default = 0x%X", arr_get_setting[i], arr_Default_Setting[i]); break;
        case(14): write("Mismatch >> Turn Signal Stamp: get = 0x%X, default = 0x%X", arr_get_setting[i], arr_Default_Setting[i]); break;
        case(15): write("Mismatch >> Audio: get = 0x%X, get = 0x%X", arr_get_setting[i], arr_Default_Setting[i]); break;
        case(16): write("Mismatch >> FCAM Angle: get = 0x%X, default = 0x%X", arr_get_setting[i], arr_Default_Setting[i]); break;
        case(17): write("Mismatch >> RCAM Angle: get = 0x%X, default = 0x%X", arr_get_setting[i], arr_Default_Setting[i]); break;
        case(18): write("Mismatch >> DEV Sen Level: get = 0x%X, default = 0x%X", arr_get_setting[i], arr_Default_Setting[i]); break;
        case(19): write("Mismatch >> PEV Sen Level: get = 0x%X, default = 0x%X", arr_get_setting[i], arr_Default_Setting[i]); break;
        case(20): write("Mismatch >> App Notification: get = 0x%X, default = 0x%X", arr_get_setting[i], arr_Default_Setting[i]); break;
      }
      break;
    }
  }

  if (flag == 21){

    write("All settings are initialized to default settings");

    condition2 = 1;

    testReportAddWindowCapture("Profile Settings","","Initial Settings","./profile_setting.jpg");

  }

  write("Skip manual recorded-file deletion confirmation; automated result uses CAN-visible reset/settings evidence.");
  testStep("Info","Recorded-file deletion confirmation skipped for automated run.");

  if (condition1 == 1 && condition2 == 1){

    testStepPass("Pass","All conditions have met. Test-case is OK");

    write("Test-case is OK");

  }
  else {
    int arr[3];

    arr[0] = condition1;
    arr[1] = condition2;

    testStepFail("Fail","Condition hasn't met. Test-case is NG");

    for (i = 0; i < 2; i++){

      if (arr[i] != 1){

        write("Condition %d is not met", i+1);

      }

    }
  }

  write("[Capture] Capture related BAS_017_8 signals before reset");
  CaptureGraphics("BAS", "BLTN_CAM_RecSta_OWP;ICU_PowerAutoCutModSta;SMK_TrmnlCtrlGrpStaBDC;ICU_BS2SoC;BLTN_CAM_RecSet_OWD;BLTN_CAM_RecSet_OWP;BLTN_CAM_RecSet_DEV;BLTN_CAM_RecSet_PEV;IAU_ProfileIDRVal");

  Init_17();
  @panel::Switch_CGWNM = 0;

  testStep("Notifications","Done test-case BAS_017_8");
  write("=== FINISH BAS_017_8 ===");
}

testcase BAS_017_11(){
  testStep("Notifications","Start test-case BAS_017_11");
  write("=== START BAS_017_11 ===");

  write("=== PREPARE BEFORE SETTING ===");

  KEY_state = 0x1; testWaitForTimeout(3000);

  if ($BLTN_CAM_RecSet_OWD == 0x1 || $BLTN_CAM_RecSet_OWP == 0x1 || $BLTN_CAM_RecSet_DEV == 0x1 || $BLTN_CAM_RecSet_PEV == 0x1) {

    write("Run Set_All_Recording_OFF()"); Set_All_Recording_OFF();

  }
  else {

    write("All settings are set to Off");

  }

  KEY_state = 0x0;

  write("=== Create Recorded File ===");

  Create_PRK_Recorded_vid_17();

  Mode_state = 0x1; testWaitForTimeout(5000); Mode_state = 0x3;

  Create_DRV_Recorded_vid_17();

  write("=== Random Settings ===");

  Set_Profile_Guest_17();

  write("KEY_OFF"); KEY_state = 0x0;

  if(testWaitForSignalChange(BLTN_CAM_RecSta_OWP,10000) != 1){

    write("Parking recording is not avaiable in Factory Mode State");

    condition1 = 1;

    CaptureGraphics("BAS", "BLTN_CAM_RecSta_OWP;ICU_PowerAutoCutModSta;SMK_TrmnlCtrlGrpStaBDC;ICU_BS2SoC;BLTN_CAM_RecSet_OWD;BLTN_CAM_RecSet_OWP;BLTN_CAM_RecSet_DEV;BLTN_CAM_RecSet_PEV;IAU_ProfileIDRVal");

  }

  write("KEY_ON"); KEY_state = 0x2;
  testWaitForTimeout(5000);

  Get_setting();

  for (i = 0; i <= 20; i++){
    if(arr_get_setting[i] == arr_Default_Setting[i]){

      flag++;

    }
    else{
      switch(i){
        case(0): write("Mismatch >> OWD: get = 0x%X, default = 0x%X", arr_get_setting[i], arr_Default_Setting[i]); break;
        case(1): write("Mismatch >> OWP: get = 0x%X, default = 0x%X", arr_get_setting[i], arr_Default_Setting[i]); break;
        case(2): write("Mismatch >> DEV: get = 0x%X, default = 0x%X", arr_get_setting[i], arr_Default_Setting[i]); break;
        case(3): write("Mismatch >> PEV: get = 0x%X, default = 0x%X", arr_get_setting[i], arr_Default_Setting[i]); break;
        case(4): write("Mismatch >> 120h: get = 0x%X, default = 0x%X", arr_get_setting[i], arr_Default_Setting[i]); break;
        case(5): write("Mismatch >> Parking Time: get = 0x%X, default = 0x%X", arr_get_setting[i], arr_Default_Setting[i]); break;
        case(6): write("Mismatch >> TML Interval: get = 0x%X, default = 0x%X", arr_get_setting[i], arr_Default_Setting[i]); break;
        case(7): write("Mismatch >> Bfr Time: get = 0x%X, default = 0x%X", arr_get_setting[i], arr_Default_Setting[i]); break;
        case(8): write("Mismatch >> Aft Time: get = 0x%X, default = 0x%X", arr_get_setting[i], arr_Default_Setting[i]); break;
        case(9): write("Mismatch >> EV Sen Stamp: get = 0x%X, default = 0x%X", arr_get_setting[i], arr_Default_Setting[i]); break;
        case(10): write("Mismatch >> Gear Stamp: get = 0x%X, default = 0x%X", arr_get_setting[i], arr_Default_Setting[i]); break;
        case(11): write("Mismatch >> Location Stamp: get = 0x%X, default = 0x%X", arr_get_setting[i], arr_Default_Setting[i]); break;
        case(12): write("Mismatch >> Velocity Stamp: get = 0x%X, default = 0x%X", arr_get_setting[i], arr_Default_Setting[i]); break;
        case(13): write("Mismatch >> Time Stamp: get = 0x%X, default = 0x%X", arr_get_setting[i], arr_Default_Setting[i]); break;
        case(14): write("Mismatch >> Turn Signal Stamp: get = 0x%X, default = 0x%X", arr_get_setting[i], arr_Default_Setting[i]); break;
        case(15): write("Mismatch >> Audio: get = 0x%X, get = 0x%X", arr_get_setting[i], arr_Default_Setting[i]); break;
        case(16): write("Mismatch >> FCAM Angle: get = 0x%X, default = 0x%X", arr_get_setting[i], arr_Default_Setting[i]); break;
        case(17): write("Mismatch >> RCAM Angle: get = 0x%X, default = 0x%X", arr_get_setting[i], arr_Default_Setting[i]); break;
        case(18): write("Mismatch >> DEV Sen Level: get = 0x%X, default = 0x%X", arr_get_setting[i], arr_Default_Setting[i]); break;
        case(19): write("Mismatch >> PEV Sen Level: get = 0x%X, default = 0x%X", arr_get_setting[i], arr_Default_Setting[i]); break;
        case(20): write("Mismatch >> App Notification: get = 0x%X, default = 0x%X", arr_get_setting[i], arr_Default_Setting[i]); break;
      }
      break;
    }
  }

  if (flag == 21){

    write("All settings are initialized to default settings");

    condition2 = 1;

    testReportAddWindowCapture("Profile Settings","","Initial Settings","./profile_setting.jpg");

  }

  write("Skip manual recorded-file deletion confirmation; automated result uses CAN-visible reset/settings evidence.");
  testStep("Info","Recorded-file deletion confirmation skipped for automated run.");

  if (condition1 == 1 && condition2 == 1){
    testStepPass("Pass","All conditions have met. Test-case is OK");
    write("Test-case is OK");
  }

  write("[Capture] Capture related BAS_017_11 signals before reset");
  CaptureGraphics("BAS", "BLTN_CAM_RecSta_OWP;ICU_PowerAutoCutModSta;SMK_TrmnlCtrlGrpStaBDC;ICU_BS2SoC;BLTN_CAM_RecSet_OWD;BLTN_CAM_RecSet_OWP;BLTN_CAM_RecSet_DEV;BLTN_CAM_RecSet_PEV;IAU_ProfileIDRVal");

  Init_17();
  @panel::Switch_CGWNM = 0;

  testStep("Notifications","Done test-case BAS_017_11");
  write("=== FINISH BAS_017_11 ===");
}

testcase BAS_017_14(){
  testStep("Notifications","Start test-case BAS_017_14");
  write("=== START BAS_017_14 ===");

  write("=== PREPARE BEFORE SETTING ===");

  KEY_state = 0x1; testWaitForTimeout(3000);

  if ($BLTN_CAM_RecSet_OWD == 0x1 || $BLTN_CAM_RecSet_OWP == 0x1 || $BLTN_CAM_RecSet_DEV == 0x1 || $BLTN_CAM_RecSet_PEV == 0x1) {

    write("Run Set_All_Recording_OFF()"); Set_All_Recording_OFF();

  }
  else {

    write("All settings are set to Off");

  }

  KEY_state = 0x0;

  write("=== Create Recorded File ===");

  Create_PRK_Recorded_vid_17();

  Mode_state = 0x2; testWaitForTimeout(5000); Mode_state = 0x3;

  Create_DRV_Recorded_vid_17();

  write("=== Random Settings ===");

  Set_Profile_Guest_17();

  testReportAddWindowCapture("Profile Settings","","Profile Guest","./profile_setting.jpg");

  do {
    Enter_BLTN_CAM();
    testWaitForTimeout(3000);

    if(getSignal(BLTN_CAM_RecSet_OWP) == 0x1){
      @panel::LED_Ctrl_SetOWP = 1;
      write("OWP ON"); OWP_memvar = 2;
      testWaitForTimeout(500);
    }

    Exit_BLTN_CAM();
    testWaitForTimeout(3000);
  } while ($BLTN_CAM_RecSet_OWP == 0x1);

  write("KEY_OFF"); KEY_state = 0x0;

  if (testWaitForSignalChange(BLTN_CAM_RecSta_OWP,10000) == 1) {

    write("Parking recording is avaiable in Customer Mode State");

    condition1 = 1;

    testWaitForTimeout(5000);

  }

  write("KEY_ON"); KEY_state = 0x2;
  testWaitForTimeout(5000);

  if (OWP_memvar == 2) {
      do {
        Enter_BLTN_CAM();
        testWaitForTimeout(3000);

        @panel::LED_Ctrl_SetOWP = 1;
        write("OWP OFF"); OWP_memvar = 1;

        Exit_BLTN_CAM();
        testWaitForTimeout(3000);
      } while ($BLTN_CAM_RecSet_OWP == 0x2);
    }

  Get_setting();

  for (i = 0; i <= 20; i++){
    if(arr_get_setting[i] == arr_Profile_Guest_setting[i]){
      flag++;
    }
    else{
      switch(i){
        case(0): write("Mismatch >> OWD: get = 0x%X, guest = 0x%X", arr_get_setting[i], arr_Profile_Guest_setting[i]); break;
        case(1): write("Mismatch >> OWP: get = 0x%X, guest = 0x%X", arr_get_setting[i], arr_Profile_Guest_setting[i]); break;
        case(2): write("Mismatch >> DEV: get = 0x%X, guest = 0x%X", arr_get_setting[i], arr_Profile_Guest_setting[i]); break;
        case(3): write("Mismatch >> PEV: get = 0x%X, guest = 0x%X", arr_get_setting[i], arr_Profile_Guest_setting[i]); break;
        case(4): write("Mismatch >> 120h: get = 0x%X, guest = 0x%X", arr_get_setting[i], arr_Profile_Guest_setting[i]); break;
        case(5): write("Mismatch >> Parking Time: get = 0x%X, guest = 0x%X", arr_get_setting[i], arr_Profile_Guest_setting[i]); break;
        case(6): write("Mismatch >> TML Interval: get = 0x%X, guest = 0x%X", arr_get_setting[i], arr_Profile_Guest_setting[i]); break;
        case(7): write("Mismatch >> Bfr Time: get = 0x%X, guest = 0x%X", arr_get_setting[i], arr_Profile_Guest_setting[i]); break;
        case(8): write("Mismatch >> Aft Time: get = 0x%X, guest = 0x%X", arr_get_setting[i], arr_Profile_Guest_setting[i]); break;
        case(9): write("Mismatch >> EV Sen Stamp: get = 0x%X, guest = 0x%X", arr_get_setting[i], arr_Profile_Guest_setting[i]); break;
        case(10): write("Mismatch >> Gear Stamp: get = 0x%X, guest = 0x%X", arr_get_setting[i], arr_Profile_Guest_setting[i]); break;
        case(11): write("Mismatch >> Location Stamp: get = 0x%X, guest = 0x%X", arr_get_setting[i], arr_Profile_Guest_setting[i]); break;
        case(12): write("Mismatch >> Velocity Stamp: get = 0x%X, guest = 0x%X", arr_get_setting[i], arr_Profile_Guest_setting[i]); break;
        case(13): write("Mismatch >> Time Stamp: get = 0x%X, guest = 0x%X", arr_get_setting[i], arr_Profile_Guest_setting[i]); break;
        case(14): write("Mismatch >> Turn Signal Stamp: get = 0x%X, guest = 0x%X", arr_get_setting[i], arr_Profile_Guest_setting[i]); break;
        case(15): write("Mismatch >> Audio: get = 0x%X, get = 0x%X", arr_get_setting[i], arr_Profile_Guest_setting[i]); break;
        case(16): write("Mismatch >> FCAM Angle: get = 0x%X, guest = 0x%X", arr_get_setting[i], arr_Profile_Guest_setting[i]); break;
        case(17): write("Mismatch >> RCAM Angle: get = 0x%X, guest = 0x%X", arr_get_setting[i], arr_Profile_Guest_setting[i]); break;
        case(18): write("Mismatch >> DEV Sen Level: get = 0x%X, guest = 0x%X", arr_get_setting[i], arr_Profile_Guest_setting[i]); break;
        case(19): write("Mismatch >> PEV Sen Level: get = 0x%X, guest = 0x%X", arr_get_setting[i], arr_Profile_Guest_setting[i]); break;
        case(20): write("Mismatch >> App Notification: get = 0x%X, guest = 0x%X", arr_get_setting[i], arr_Profile_Guest_setting[i]); break;
      }
      break;
    }
  }

  if (flag == 21){

    write("All settings remain unchanged");

    condition2 = 1;

    testReportAddWindowCapture("Profile Settings","","Unchanged Settings","./profile_setting.jpg");

  }

  write("Skip manual recorded-file retention confirmation; automated result uses CAN-visible parking/settings evidence.");
  testStep("Info","Recorded-file retention confirmation skipped for automated run.");

  if (condition1 == 1 && condition2 == 1){

    testStepPass("Pass","All conditions have met. Test-case is OK");

    write("Test-case is OK");

  }
  else {
    int arr[3];

    arr[0] = condition1;
    arr[1] = condition2;

    testStepFail("Fail","Condition hasn't met. Test-case is NG");

    for (i = 0; i < 2; i++){

      if (arr[i] != 1){

        write("Condition %d is not met", i+1);

      }

    }
  }

  write("[Capture] Capture related BAS_017_14 signals before reset");
  CaptureGraphics("BAS", "BLTN_CAM_RecSta_OWP;ICU_PowerAutoCutModSta;SMK_TrmnlCtrlGrpStaBDC;ICU_BS2SoC;BLTN_CAM_RecSet_OWD;BLTN_CAM_RecSet_OWP;BLTN_CAM_RecSet_DEV;BLTN_CAM_RecSet_PEV;IAU_ProfileIDRVal");

  Init_17();
  @panel::Switch_CGWNM = 0;

  testStep("Notifications","Done test-case BAS_017_14");
  write("=== FINISH BAS_017_14 ===");
}

void MainTest(){
  write("=== RUN BAS_017 SEQUENTIALLY: 1 -> 4 -> 7 -> 8 -> 11 -> 14 ===");

  Mode_state = 0x2;
  KEY_state = 0x0;
  Profile_value = 0x1;
  Bat_val = 0x50;
  send_SMK_TrmnlCtrlGrpStaBDC_timer.set(10);
  send_ICU_PowerAutoCutModSta_timer.set(10);
  send_IAU_ProfileIDRVal_timer.set(10);
  send_ICU_BS2SoC_timer.set(10);
  BAS_017_1();

  Mode_state = 0x2;
  KEY_state = 0x0;
  Profile_value = 0x1;
  Bat_val = 0x50;
  send_SMK_TrmnlCtrlGrpStaBDC_timer.set(10);
  send_ICU_PowerAutoCutModSta_timer.set(10);
  send_IAU_ProfileIDRVal_timer.set(10);
  send_ICU_BS2SoC_timer.set(10);
  BAS_017_4();

  Mode_state = 0x2;
  KEY_state = 0x0;
  Profile_value = 0x1;
  Bat_val = 0x50;
  send_SMK_TrmnlCtrlGrpStaBDC_timer.set(10);
  send_ICU_PowerAutoCutModSta_timer.set(10);
  send_IAU_ProfileIDRVal_timer.set(10);
  send_ICU_BS2SoC_timer.set(10);
  BAS_017_7();

  Mode_state = 0x2;
  KEY_state = 0x0;
  Profile_value = 0x1;
  Bat_val = 0x50;
  send_SMK_TrmnlCtrlGrpStaBDC_timer.set(10);
  send_ICU_PowerAutoCutModSta_timer.set(10);
  send_IAU_ProfileIDRVal_timer.set(10);
  send_ICU_BS2SoC_timer.set(10);
  BAS_017_8();

  Mode_state = 0x2;
  KEY_state = 0x0;
  Profile_value = 0x1;
  Bat_val = 0x50;
  send_SMK_TrmnlCtrlGrpStaBDC_timer.set(10);
  send_ICU_PowerAutoCutModSta_timer.set(10);
  send_IAU_ProfileIDRVal_timer.set(10);
  send_ICU_BS2SoC_timer.set(10);
  BAS_017_11();

  Mode_state = 0x2;
  KEY_state = 0x0;
  Profile_value = 0x1;
  Bat_val = 0x50;
  send_SMK_TrmnlCtrlGrpStaBDC_timer.set(10);
  send_ICU_PowerAutoCutModSta_timer.set(10);
  send_IAU_ProfileIDRVal_timer.set(10);
  send_ICU_BS2SoC_timer.set(10);
  BAS_017_14();
}

