/*@!Encoding:65001*/
// Preconditions: - Block CCU, ACC and IGN and ccNC/ccIC switch OFF state, AVN
// mode
includes {

#include "..\DeclarationFunction_Gen2.5.h"
}

variables {
  char failReason[512];
  // Global Variable Declaration
  int i;
  int get_PEVRecorded_change = 0;
  byte get_PEVRecorded_value = 0x0;

  // Variables for test summary
  int total_tests = 0;
  int passed_tests = 0;
  int failed_tests = 0;
  char failed_test_names[2048] = ""; // To store names of failed tests
}

testcase CCS_009_1() {
  Send_Value_To_COM(30901);
  SetTestStep("Buoc 1 - CCS_009");
  StartTestTimer();
  @panel::Switch_CGWNM = 1;
  testStep("Step 1", "Start test-case CCS_009_1");
  write("=== START CCS_009_1 ===");

  write("=== SETTING ===");

  Set_BglrAlrm(0x0); // Off

  write("KEY ON");
  KEY_ON();
  testWaitForTimeout(3000);
  Apply_CCS_RecSettings(0x2, 0);

  write("=== TESTING ===");

  write("KEY OFF");
  KEY_OFF();

  if (WaitFor_RecSta_OWP_Recording(60000) == 1) {

    write("OWP recording is started");
    @panel::Switch_CGWNM = 1;

    Set_BglrAlrm(0x2); // Arm
    testWaitForTimeout(5000);
    Set_BglrAlrm(0x0); // Off
    testWaitForTimeout(5000);


    if (WaitFor_RecSta_PEV_Recording(60) == 1) {

      write("PEV recording is started");

      get_PEVRecorded_change = WaitFor_PEV_Recorded_Value(0x2, 10000);
    get_PEVRecorded_value = $BLTN_CAM_PEV_Recorded;
    if (get_PEVRecorded_value == 0x2) {

        write("PEV_Recorded: 0x%X << Test-case is OK >>",
              get_PEVRecorded_value);

        testStepPass("Pass", "Test-case is OK");
        passed_tests++;

      } else {

        write("PEV_Recorded: 0x%X << Test-case is NG >>",
              get_PEVRecorded_value);

        snprintf(failReason, elcount(failReason), "Fail reason: Test-case is NG (PEV_Recorded=0x%X). Cause: expected condition was not satisfied.", get_PEVRecorded_value);
        testStepFail("Fail", failReason);
        failed_tests++;
        strncat(failed_test_names, "CCS_009_1 (PEV check), ",
                elcount(failed_test_names));
      }
    } else {
      write("PEV recording hasn't started");
      snprintf(failReason, elcount(failReason), "Fail reason: PEV recording hasn\'t started (BLTN_CAM_RecSta_PEV=0x%X). Cause: expected condition was not satisfied.", $BLTN_CAM_RecSta_PEV);
      testStepFail("Fail", failReason);
      failed_tests++;
      strncat(failed_test_names, "CCS_009_1 (PEV timeout), ",
              elcount(failed_test_names));
    }
  } else {
    write("OWP recording hasn't started");
    snprintf(failReason, elcount(failReason), "Fail reason: OWP recording hasn\'t started (BLTN_CAM_RecSta_OWP=0x%X). Cause: expected condition was not satisfied.", $BLTN_CAM_RecSta_OWP);
    testStepFail("Fail", failReason);
    failed_tests++;
    strncat(failed_test_names, "CCS_009_1 (OWP timeout), ",
            elcount(failed_test_names));
  }

  total_tests++;

  write("Run CaptureGraphics()");
  CaptureGraphics("CSS", "BLTN_CAM_RecSta_OWP;BLTN_CAM_RecSta_PEV;BLTN_CAM_PEV_"
                  "Recorded;BAlarm_BglrAlrm_CurrentSta;SMK_TrmnlCtrlGrpStaBDC");

  Standard_Init();

  @panel::Switch_CGWNM = 0;

  write("=== FINISH CCS_009_1 ===");

  StopTestTimer();
  Send_Value_To_COM(44);
}

testcase CCS_009_2() {
  Send_Value_To_COM(30902);
  SetTestStep("Buoc 2 - CCS_009");
  StartTestTimer();
  @panel::Switch_CGWNM = 1;
  testStep("Step 2", "Start test-case CCS_009_2");
  write("=== START CCS_009_2 ===");

  write("=== SETTING ===");

  Set_BglrAlrm(0xA); // Default

  write("KEY ON");
  KEY_ON();
  testWaitForTimeout(3000);
  Apply_CCS_RecSettings(0x2, 0);

  write("=== TESTING ===");

  write("KEY OFF");
  KEY_OFF();

  if (WaitFor_RecSta_OWP_Recording(60000) == 1) {

    write("OWP recording is started");
    @panel::Switch_CGWNM = 1;

    Set_BglrAlrm(0x2); // Arm
    testWaitForTimeout(5000);
    Set_BglrAlrm(0xA); // Default
    testWaitForTimeout(5000);


    if (WaitFor_RecSta_PEV_Recording(60) == 1) {

      write("PEV recording is started");

      get_PEVRecorded_change = WaitFor_PEV_Recorded_Value(0x2, 10000);
    get_PEVRecorded_value = $BLTN_CAM_PEV_Recorded;
    if (get_PEVRecorded_value == 0x2) {

        write("PEV_Recorded: 0x%X << Test-case is OK >>",
              get_PEVRecorded_value);

        testStepPass("Pass", "Test-case is OK");
        passed_tests++;

      } else {

        write("PEV_Recorded: 0x%X << Test-case is NG >>",
              get_PEVRecorded_value);

        snprintf(failReason, elcount(failReason), "Fail reason: Test-case is NG (PEV_Recorded=0x%X). Cause: expected condition was not satisfied.", get_PEVRecorded_value);
        testStepFail("Fail", failReason);
        failed_tests++;
        strncat(failed_test_names, "CCS_009_2 (PEV check), ",
                elcount(failed_test_names));
      }
    } else {
      write("PEV recording hasn't started");
      snprintf(failReason, elcount(failReason), "Fail reason: PEV recording hasn\'t started (BLTN_CAM_RecSta_PEV=0x%X). Cause: expected condition was not satisfied.", $BLTN_CAM_RecSta_PEV);
      testStepFail("Fail", failReason);
      failed_tests++;
      strncat(failed_test_names, "CCS_009_2 (PEV timeout), ",
              elcount(failed_test_names));
    }
  } else {
    write("OWP recording hasn't started");
    snprintf(failReason, elcount(failReason), "Fail reason: OWP recording hasn\'t started (BLTN_CAM_RecSta_OWP=0x%X). Cause: expected condition was not satisfied.", $BLTN_CAM_RecSta_OWP);
    testStepFail("Fail", failReason);
    failed_tests++;
    strncat(failed_test_names, "CCS_009_2 (OWP timeout), ",
            elcount(failed_test_names));
  }

  total_tests++;

  write("Run CaptureGraphics()");
  CaptureGraphics("CSS", "BLTN_CAM_RecSta_OWP;BLTN_CAM_RecSta_PEV;BLTN_CAM_PEV_"
                  "Recorded;BAlarm_BglrAlrm_CurrentSta;SMK_TrmnlCtrlGrpStaBDC");

  Standard_Init();

  @panel::Switch_CGWNM = 0;

  write("=== FINISH CCS_009_2 ===");

  StopTestTimer();
  Send_Value_To_COM(44);
}

testcase CCS_009_3() {
  Send_Value_To_COM(30903);
  SetTestStep("Buoc 3 - CCS_009");
  StartTestTimer();
  @panel::Switch_CGWNM = 1;
  testStep("Step 3", "Start test-case CCS_009_3");
  write("=== START CCS_009_3 ===");

  write("=== SETTING ===");

  Set_BglrAlrm(0xC); // RESERVED

  write("KEY ON");
  KEY_ON();
  testWaitForTimeout(3000);
  Apply_CCS_RecSettings(0x2, 0);

  write("=== TESTING ===");

  write("KEY OFF");
  KEY_OFF();

  if (WaitFor_RecSta_OWP_Recording(60000) == 1) {

    write("OWP recording is started");
    @panel::Switch_CGWNM = 1;

    Set_BglrAlrm(0x2); // Arm
    testWaitForTimeout(5000);
    Set_BglrAlrm(0xC); // RESERVED
    testWaitForTimeout(5000);


    if (WaitFor_RecSta_PEV_Recording(60) == 1) {

      write("PEV recording is started");

      get_PEVRecorded_change = WaitFor_PEV_Recorded_Value(0x2, 10000);
    get_PEVRecorded_value = $BLTN_CAM_PEV_Recorded;
    if (get_PEVRecorded_value == 0x2) {

        write("PEV_Recorded: 0x%X << Test-case is OK >>",
              get_PEVRecorded_value);

        testStepPass("Pass", "Test-case is OK");
        passed_tests++;

      } else {

        write("PEV_Recorded: 0x%X << Test-case is NG >>",
              get_PEVRecorded_value);

        snprintf(failReason, elcount(failReason), "Fail reason: Test-case is NG (PEV_Recorded=0x%X). Cause: expected condition was not satisfied.", get_PEVRecorded_value);
        testStepFail("Fail", failReason);
        failed_tests++;
        strncat(failed_test_names, "CCS_009_3 (PEV check), ",
                elcount(failed_test_names));
      }
    } else {
      write("PEV recording hasn't started");
      snprintf(failReason, elcount(failReason), "Fail reason: PEV recording hasn\'t started (BLTN_CAM_RecSta_PEV=0x%X). Cause: expected condition was not satisfied.", $BLTN_CAM_RecSta_PEV);
      testStepFail("Fail", failReason);
      failed_tests++;
      strncat(failed_test_names, "CCS_009_3 (PEV timeout), ",
              elcount(failed_test_names));
    }
  } else {
    write("OWP recording hasn't started");
    snprintf(failReason, elcount(failReason), "Fail reason: OWP recording hasn\'t started (BLTN_CAM_RecSta_OWP=0x%X). Cause: expected condition was not satisfied.", $BLTN_CAM_RecSta_OWP);
    testStepFail("Fail", failReason);
    failed_tests++;
    strncat(failed_test_names, "CCS_009_3 (OWP timeout), ",
            elcount(failed_test_names));
  }

  total_tests++;

  write("Run CaptureGraphics()");
  CaptureGraphics("CSS", "BLTN_CAM_RecSta_OWP;BLTN_CAM_RecSta_PEV;BLTN_CAM_PEV_"
                  "Recorded;BAlarm_BglrAlrm_CurrentSta;SMK_TrmnlCtrlGrpStaBDC");

  Standard_Init();

  @panel::Switch_CGWNM = 0;

  write("=== FINISH CCS_009_3 ===");

  StopTestTimer();
  Send_Value_To_COM(44);
}

testcase CCS_009_4() {
  Send_Value_To_COM(30904);
  SetTestStep("Buoc 4 - CCS_009");
  StartTestTimer();
  @panel::Switch_CGWNM = 1;
  testStep("Step 4", "Start test-case CCS_009_4");
  write("=== START CCS_009_4 ===");

  write("=== SETTING ===");

  Set_BglrAlrm(0xD); // RESERVED

  write("KEY ON");
  KEY_ON();
  testWaitForTimeout(3000);
  Apply_CCS_RecSettings(0x2, 0);

  write("=== TESTING ===");

  write("KEY OFF");
  KEY_OFF();

  if (WaitFor_RecSta_OWP_Recording(60000) == 1) {

    write("OWP recording is started");
    @panel::Switch_CGWNM = 1;

    Set_BglrAlrm(0x2); // Arm
    testWaitForTimeout(5000);
    Set_BglrAlrm(0xD); // RESERVED
    testWaitForTimeout(5000);


    if (WaitFor_RecSta_PEV_Recording(60) == 1) {

      write("PEV recording is started");

      get_PEVRecorded_change = WaitFor_PEV_Recorded_Value(0x2, 10000);
    get_PEVRecorded_value = $BLTN_CAM_PEV_Recorded;
    if (get_PEVRecorded_value == 0x2) {

        write("PEV_Recorded: 0x%X << Test-case is OK >>",
              get_PEVRecorded_value);

        testStepPass("Pass", "Test-case is OK");
        passed_tests++;

      } else {

        write("PEV_Recorded: 0x%X << Test-case is NG >>",
              get_PEVRecorded_value);

        snprintf(failReason, elcount(failReason), "Fail reason: Test-case is NG (PEV_Recorded=0x%X). Cause: expected condition was not satisfied.", get_PEVRecorded_value);
        testStepFail("Fail", failReason);
        failed_tests++;
        strncat(failed_test_names, "CCS_009_4 (PEV check), ",
                elcount(failed_test_names));
      }
    } else {
      write("PEV recording hasn't started");
      snprintf(failReason, elcount(failReason), "Fail reason: PEV recording hasn\'t started (BLTN_CAM_RecSta_PEV=0x%X). Cause: expected condition was not satisfied.", $BLTN_CAM_RecSta_PEV);
      testStepFail("Fail", failReason);
      failed_tests++;
      strncat(failed_test_names, "CCS_009_4 (PEV timeout), ",
              elcount(failed_test_names));
    }
  } else {
    write("OWP recording hasn't started");
    snprintf(failReason, elcount(failReason), "Fail reason: OWP recording hasn\'t started (BLTN_CAM_RecSta_OWP=0x%X). Cause: expected condition was not satisfied.", $BLTN_CAM_RecSta_OWP);
    testStepFail("Fail", failReason);
    failed_tests++;
    strncat(failed_test_names, "CCS_009_4 (OWP timeout), ",
            elcount(failed_test_names));
  }

  total_tests++;

  write("Run CaptureGraphics()");
  CaptureGraphics("CSS", "BLTN_CAM_RecSta_OWP;BLTN_CAM_RecSta_PEV;BLTN_CAM_PEV_"
                  "Recorded;BAlarm_BglrAlrm_CurrentSta;SMK_TrmnlCtrlGrpStaBDC");

  Standard_Init();

  @panel::Switch_CGWNM = 0;

  write("=== FINISH CCS_009_4 ===");

  StopTestTimer();
  Send_Value_To_COM(44);
}

testcase CCS_009_5() {
  Send_Value_To_COM(30905);
  SetTestStep("Buoc 5 - CCS_009");
  StartTestTimer();
  @panel::Switch_CGWNM = 1;
  testStep("Step 5", "Start test-case CCS_009_5");
  write("=== START CCS_009_5 ===");

  write("=== SETTING ===");

  Set_BglrAlrm(0xE); // Not used

  write("KEY ON");
  KEY_ON();
  testWaitForTimeout(3000);
  Apply_CCS_RecSettings(0x2, 0);

  write("=== TESTING ===");

  write("KEY OFF");
  KEY_OFF();

  if (WaitFor_RecSta_OWP_Recording(60000) == 1) {

    write("OWP recording is started");
    @panel::Switch_CGWNM = 1;

    Set_BglrAlrm(0x2); // Arm
    testWaitForTimeout(5000);
    Set_BglrAlrm(0xE); // Not used
    testWaitForTimeout(5000);


    if (WaitFor_RecSta_PEV_Recording(60) == 1) {

      write("PEV recording is started");

      get_PEVRecorded_change = WaitFor_PEV_Recorded_Value(0x2, 10000);
    get_PEVRecorded_value = $BLTN_CAM_PEV_Recorded;
    if (get_PEVRecorded_value == 0x2) {

        write("PEV_Recorded: 0x%X << Test-case is OK >>",
              get_PEVRecorded_value);

        testStepPass("Pass", "Test-case is OK");
        passed_tests++;

      } else {

        write("PEV_Recorded: 0x%X << Test-case is NG >>",
              get_PEVRecorded_value);

        snprintf(failReason, elcount(failReason), "Fail reason: Test-case is NG (PEV_Recorded=0x%X). Cause: expected condition was not satisfied.", get_PEVRecorded_value);
        testStepFail("Fail", failReason);
        failed_tests++;
        strncat(failed_test_names, "CCS_009_5 (PEV check), ",
                elcount(failed_test_names));
      }
    } else {
      write("PEV recording hasn't started");
      snprintf(failReason, elcount(failReason), "Fail reason: PEV recording hasn\'t started (BLTN_CAM_RecSta_PEV=0x%X). Cause: expected condition was not satisfied.", $BLTN_CAM_RecSta_PEV);
      testStepFail("Fail", failReason);
      failed_tests++;
      strncat(failed_test_names, "CCS_009_5 (PEV timeout), ",
              elcount(failed_test_names));
    }
  } else {
    write("OWP recording hasn't started");
    snprintf(failReason, elcount(failReason), "Fail reason: OWP recording hasn\'t started (BLTN_CAM_RecSta_OWP=0x%X). Cause: expected condition was not satisfied.", $BLTN_CAM_RecSta_OWP);
    testStepFail("Fail", failReason);
    failed_tests++;
    strncat(failed_test_names, "CCS_009_5 (OWP timeout), ",
            elcount(failed_test_names));
  }

  total_tests++;

  write("Run CaptureGraphics()");
  CaptureGraphics("CSS", "BLTN_CAM_RecSta_OWP;BLTN_CAM_RecSta_PEV;BLTN_CAM_PEV_"
                  "Recorded;BAlarm_BglrAlrm_CurrentSta;SMK_TrmnlCtrlGrpStaBDC");

  Standard_Init();

  @panel::Switch_CGWNM = 0;

  write("=== FINISH CCS_009_5 ===");

  StopTestTimer();
  Send_Value_To_COM(44);
}

testcase CCS_009_6() {
  Send_Value_To_COM(30906);
  SetTestStep("Buoc 6 - CCS_009");
  StartTestTimer();
  @panel::Switch_CGWNM = 1;
  testStep("Step 6", "Start test-case CCS_009_6");
  write("=== START CCS_009_6 ===");

  write("=== SETTING ===");

  Set_BglrAlrm(0x0); // Not used

  write("KEY ON");
  KEY_ON();
  testWaitForTimeout(3000);
  Apply_CCS_RecSettings(0x2, 0);

  write("=== TESTING ===");

  write("KEY OFF");
  KEY_OFF();

  if (WaitFor_RecSta_OWP_Recording(60000) == 1) {

    write("OWP recording is started");
    @panel::Switch_CGWNM = 1;

    Set_BglrAlrm(0x1); // DisArm
    testWaitForTimeout(5000);
    Set_BglrAlrm(0xE); // Default
    testWaitForTimeout(5000);


    if (WaitFor_RecSta_PEV_Recording(60) == 1) {

      write("PEV recording is started");

      get_PEVRecorded_change = WaitFor_PEV_Recorded_Value(0x2, 10000);

      get_PEVRecorded_value = $BLTN_CAM_PEV_Recorded;

      if (get_PEVRecorded_change != 1 && get_PEVRecorded_value == 0x0) {

        write("PEV_Recorded: 0x%X << Test-case is OK >>",
              get_PEVRecorded_value);

        testStepPass("Pass", "Test-case is OK");
        passed_tests++;

      } else {

        write("PEV_Recorded: 0x%X << Test-case is NG >>",
              get_PEVRecorded_value);

        snprintf(failReason, elcount(failReason), "Fail reason: Test-case is NG (PEV_Recorded=0x%X). Cause: expected condition was not satisfied.", get_PEVRecorded_value);
        testStepFail("Fail", failReason);
        failed_tests++;
        strncat(failed_test_names, "CCS_009_6 (PEV check), ",
                elcount(failed_test_names));
      }
    } else {
      write("PEV recording hasn't started");
      snprintf(failReason, elcount(failReason), "Fail reason: PEV recording hasn\'t started (BLTN_CAM_RecSta_PEV=0x%X). Cause: expected condition was not satisfied.", $BLTN_CAM_RecSta_PEV);
      testStepFail("Fail", failReason);
      failed_tests++;
      strncat(failed_test_names, "CCS_009_6 (PEV timeout), ",
              elcount(failed_test_names));
    }
  } else {
    write("OWP recording hasn't started");
    snprintf(failReason, elcount(failReason), "Fail reason: OWP recording hasn\'t started (BLTN_CAM_RecSta_OWP=0x%X). Cause: expected condition was not satisfied.", $BLTN_CAM_RecSta_OWP);
    testStepFail("Fail", failReason);
    failed_tests++;
    strncat(failed_test_names, "CCS_009_6 (OWP timeout), ",
            elcount(failed_test_names));
  }

  total_tests++;

  write("Run CaptureGraphics()");
  CaptureGraphics("CSS", "BLTN_CAM_RecSta_OWP;BLTN_CAM_RecSta_PEV;BLTN_CAM_PEV_"
                  "Recorded;BAlarm_BglrAlrm_CurrentSta;SMK_TrmnlCtrlGrpStaBDC");

  Standard_Init();

  @panel::Switch_CGWNM = 0;

  write("=== FINISH CCS_009_6 ===");

  StopTestTimer();
  Send_Value_To_COM(44);
}


void MainTest() {

  testReportFileName("TestReports\\CCS_009 - 2.5 generation_report");

  Set_SMK_IGN();
  Click_USM_Reset();
  Click_Rec_Reset();

  CCS_009_1();
  CCS_009_2();
  CCS_009_3();
  CCS_009_4();
  CCS_009_5();
  CCS_009_6();

}






