/*@!Encoding:65001*/
/*
 * FILE OVERVIEW: OTA_012.can
 *
 * Muc tieu test:
 * - Dam bao SW version ve ban 0 (neu chua la ban 0 thi chay update_to_00.py).
 * - Chay case_12.py de kich hoat OTA flow.
 * - Khi nhan AppState = 12: thuc hien KEY ON/OFF 5 lan nhanh trong 3 giay.
 * - Sau do doi toi da 30 phut de nhan AppState ket qua:
 *   + AppState = 3 -> PASS neu Check_SWVerMinor3(1) dat.
 *   + AppState = 4 -> FAIL.
 *   + Timeout 30 phut -> FAIL.
 *
 * Ghi chu:
 * - Khong dung ret cua TestWaitForSyscall de gate pass/fail OTA.
 * - Dung Wait_AppState_3_Or_4_Changed(1800000) cho ket luan AppState.
 */
includes
{
  #include "../DeclarationFunction_Gen2.5.h"
}
variables
{
  int mainWaitCnt;
  int i;

  char gWorkingDir[256] = "D:\\project\\CANoe\\CANFD\\Auto\\OTA\\";
  char gUpdateTo00Cmd[256] = "\"python\" \"D:\\project\\CANoe\\CANFD\\Auto\\OTA\\update_to_00.py\"";
  char gCase12Cmd[256] = "\"python\" \"D:\\project\\CANoe\\CANFD\\Auto\\OTA\\case_12.py\"";
  char gSyscallCmd[256] = "\"python\" \"D:\\project\\CANoe\\CANFD\\Auto\\OTA\\case_12.py\"";

  int gAppStatePrev = -1;
  int gRunRequest = 0;
}

on sysvar_update PythonCom::AppState
{
  write("[OTA_012][EVENT] AppState cu = %d, AppState moi = %d", gAppStatePrev, @PythonCom::AppState);
  
  if (@PythonCom::AppState == 12 && gAppStatePrev != 12)
  {
    write("[OTA_012][EVENT] Nhan AppState = 12 -> trigger KEY ON/OFF 5 lan nhanh");
    gRunRequest = 1;
  }

  OTA_Update_AppStateTrigger_FromValue(gAppStatePrev, @PythonCom::AppState);

  gAppStatePrev = @PythonCom::AppState;
}

/*
 * Test case: KEY ON/OFF ngay lap tuc 5 lan
 * Quy uoc:
 *   SMK_TrmnlCtrlGrpStaBDC = 0x2 -> ON
 *   SMK_TrmnlCtrlGrpStaBDC = 0x0 -> OFF
 */
testcase BAS_KEY_ON_OFF_5X_IMMEDIATE_WHEN_APPSTATE_1()
{
  for (i = 1; i <= 5; i++)
  {
    KEY_ON();
    testWaitForTimeout(500);

    KEY_OFF();
    testWaitForTimeout(500);
  }

  write("[OTA_012] Da KEY ON/OFF 5 lan nhanh trong 3 giay.");
  testStepPass("Action", "Da KEY ON/OFF 5 lan nhanh trong 3 giay sau khi AppState=12.");
}

testcase OTA_Run_Python_Command()
{
  long result;

  write("[OTA_012][PY] WorkingDir = %s", gWorkingDir);
  write("[OTA_012][PY] Command    = %s", gSyscallCmd);
  write("[OTA_012][PY] Reset PythonCom::AppState ve 0 truoc khi goi python");
  @PythonCom::AppState = 0;

  testStep("Run", "Chay python command");
  result = TestWaitForSyscall(gWorkingDir, gSyscallCmd, 0, 30000);

  write("[OTA_012][PY] Syscall ret=%d (chi de log, khong dung de gate testcase)", result);
  testStepPass("Run", "Da goi python command, ret=%d", result);
}


void MainTest()
{
  int swVerIsZero;
  int swVerIsZeroAfterSetup;
  int setupAppStateResult;
  int appStateResult;
  int swVerIsOne;

  write("[OTA_012] ========== BAT DAU MAIN TEST ==========");
  Set_SMK_IGN();
  
  testWaitForTimeout(2000);
 
  testWaitForTimeout(2000);
  mainWaitCnt = 0;
  testReportFileName("TestReports\\OTA_012_report");

  write("[OTA_012] Buoc 1: Dam bao version hien tai la ban 0");
  testStep("Step 1", "Dam bao SW version ban 0 truoc khi chay luong chinh");
  swVerIsZero = Check_SWVerMinor3(0);
  if (swVerIsZero != 1)
  {
    write("[OTA_012][STEP1] Version hien tai khong phai ban 0 -> chay update_to_00.py");

    OTA_Reset_AppStateWaitContext();
    gAppStatePrev = gOTA_AppStateWaitStart;
    gRunRequest = 0;

    snprintf(gSyscallCmd, 256 - 1, "%s", gUpdateTo00Cmd);
    OTA_Run_Python_Command();

    setupAppStateResult = Wait_AppState_3_Or_4_Changed(1800000);
    if (setupAppStateResult == 3)
    {
      write("[OTA_012][STEP1] update_to_00.py bao AppState=3 (OK setup), tiep tuc");
    }
    else if (setupAppStateResult == 4)
    {
      write("[OTA_012][STEP1] update_to_00.py bao AppState=4 (NG setup), van tiep tuc check version");
    }
    else
    {
      write("[OTA_012][STEP1] Timeout 30 phut o setup update_to_00.py, van tiep tuc check version");
    }

    testWaitForTimeout(3000);
    swVerIsZeroAfterSetup = Check_SWVerMinor3(0);
    if (swVerIsZeroAfterSetup != 1)
    {
      write("[OTA_012][STEP1] Sau update_to_00.py version van khong phai ban 0 -> FAIL");
      CaptureGraphics("OTA", "SMK_TrmnlCtrlGrpStaBDC;BLTN_CAM_RecSta_OWD;BLTN_CAM_SWVerMinor3");
      testStepFail("Step 1", "Sau update_to_00.py version van khong phai ban 0");
      return;
    }

    testStepPass("Step 1", "Da dua SW version ve ban 0");
  }
  else
  {
    testStepPass("Step 1", "SW version da la ban 0 ngay tu dau");
  }

  write("[OTA_012] Buoc 2: Chay case_12.py");
  OTA_Reset_AppStateWaitContext();
  gAppStatePrev = gOTA_AppStateWaitStart;
  gRunRequest = 0;

  snprintf(gSyscallCmd, 256 - 1, "%s", gCase12Cmd);
  OTA_Run_Python_Command();

  write("[OTA_012] Buoc 3: Doi AppState=12 de trigger KEY ON/OFF 5 lan nhanh");
  mainWaitCnt = 0;
  while (gRunRequest == 0 && mainWaitCnt < 18000)
  {
    if (@PythonCom::AppState == 12)
    {
      gRunRequest = 1;
      break;
    }

    testWaitForTimeout(100);
    mainWaitCnt++;
  }

  if (gRunRequest != 1)
  {
    write("[OTA_012][CAPTURE] Fail trigger AppState=12");
    write("[OTA_012][CAPTURE] AppState=%d, SMK=0x%X, RecSta_OWD=0x%X, SWVerMinor3=%02d",
          @PythonCom::AppState,
          $SMK_TrmnlCtrlGrpStaBDC,
          $BLTN_CAM_RecSta_OWD,
          $BLTN_CAM_SWVerMinor3);
    CaptureGraphics("OTA", "SMK_TrmnlCtrlGrpStaBDC;BLTN_CAM_RecSta_OWD;BLTN_CAM_SWVerMinor3");
    testStepFail("Trigger", "Khong nhan duoc AppState=12 de chay KEY ON/OFF.");
    return;
  }

  write("[OTA_012] Buoc 4: Da nhan AppState=12 -> KEY ON/OFF 5 lan trong 3 giay");
  OTA_Reset_AppStateWaitContext();
  gAppStatePrev = gOTA_AppStateWaitStart;
  BAS_KEY_ON_OFF_5X_IMMEDIATE_WHEN_APPSTATE_1();

  write("[OTA_012] Buoc 5: Doi toi da 30 phut cho AppState=3/4 va xac nhan version cuoi luong");
  testStep("Step Result", "Doi AppState=3/4 toi da 30 phut, roi xac nhan version=1");
  appStateResult = Wait_AppState_3_Or_4_Changed(1800000);
  swVerIsOne = Check_SWVerMinor3(1);
  write("[OTA_012][RESULT] Check_SWVerMinor3(1) o cuoi luong = %d", swVerIsOne);

  if (appStateResult == 3)
  {
    write("[OTA_012][CAPTURE] Final AppState=3");
    write("[OTA_012][CAPTURE] AppState=%d, SMK=0x%X, RecSta_OWD=0x%X, SWVerMinor3=%02d",
          @PythonCom::AppState,
          $SMK_TrmnlCtrlGrpStaBDC,
          $BLTN_CAM_RecSta_OWD,
          $BLTN_CAM_SWVerMinor3);
    CaptureGraphics("OTA", "SMK_TrmnlCtrlGrpStaBDC;BLTN_CAM_RecSta_OWD;BLTN_CAM_SWVerMinor3");
    if (swVerIsOne == 1)
    {
      testStepPass("Result", "AppState=3 va version=1 -> PASS");
    }
    else
    {
      testStepFail("Result", "AppState=3 nhung version khong phai 1 -> FAIL");
    }
  }
  else if (appStateResult == 4)
  {
    write("[OTA_012][CAPTURE] Final AppState=4");
    write("[OTA_012][CAPTURE] AppState=%d, SMK=0x%X, RecSta_OWD=0x%X, SWVerMinor3=%02d",
          @PythonCom::AppState,
          $SMK_TrmnlCtrlGrpStaBDC,
          $BLTN_CAM_RecSta_OWD,
          $BLTN_CAM_SWVerMinor3);
    CaptureGraphics("OTA", "SMK_TrmnlCtrlGrpStaBDC;BLTN_CAM_RecSta_OWD;BLTN_CAM_SWVerMinor3");
    testStepFail("Result", "AppState=4 -> FAIL");
  }
  else
  {
    write("[OTA_012][CAPTURE] Final Timeout AppState=3/4");
    write("[OTA_012][CAPTURE] AppState=%d, SMK=0x%X, RecSta_OWD=0x%X, SWVerMinor3=%02d",
          @PythonCom::AppState,
          $SMK_TrmnlCtrlGrpStaBDC,
          $BLTN_CAM_RecSta_OWD,
          $BLTN_CAM_SWVerMinor3);
    CaptureGraphics("OTA", "SMK_TrmnlCtrlGrpStaBDC;BLTN_CAM_RecSta_OWD;BLTN_CAM_SWVerMinor3");
    testStepFail("Result", "Timeout 30 phut, khong nhan duoc AppState=3/4");
  }
  
  write("[OTA_012] ========== KET THUC MAIN TEST ==========");
}

