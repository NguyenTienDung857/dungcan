/*@!Encoding:65001*/
/*
 * FILE OVERVIEW: OTA_019.can
 *
 * Muc tieu test:
 * - Setup dieu kien OTA voi PMD ON.
 * - Kiem tra SW version co phai ban 1 khong.
 * - Neu khong phai ban 1: chay update_to_01.py de dua ve ban 1.
 * - Sau khi dam bao version = 1, chay case_019.py o luong chinh.
 * - Luon lang nghe AppState toi da 30 phut:
 *   + AppState = 3 -> tiep tuc check version 0.
 *   + AppState = 4 -> FAIL.
 * - Ket qua PASS khi AppState = 3 va SW version = 0.
 */
includes
{
  #include "../DeclarationFunction_Gen2.5.h"
}

variables
{
  char gWorkingDir[256] = "D:\\project\\CANoe\\CANFD\\Auto\\OTA\\";
  char gUpdateTo01Cmd[256] = "\"python\" \"D:\\project\\CANoe\\CANFD\\Auto\\OTA\\update_to_01.py\"";
  char gCase019Cmd[256] = "\"python\" \"D:\\project\\CANoe\\CANFD\\Auto\\OTA\\case_019.py\"";

  int gAppStatePrev = -1;
}

on sysvar_update PythonCom::AppState
{
  write("[OTA_019][EVENT] AppState cu=%d, moi=%d", gAppStatePrev, @PythonCom::AppState);

  OTA_Update_AppStateTrigger_FromValue(gAppStatePrev, @PythonCom::AppState);

  if (@PythonCom::AppState == 3 && gAppStatePrev != 3)
  {
    write("[OTA_019][EVENT] Bat duoc AppState = 3");
  }
  else if (@PythonCom::AppState == 4 && gAppStatePrev != 4)
  {
    write("[OTA_019][EVENT] Bat duoc AppState = 4");
  }

  gAppStatePrev = @PythonCom::AppState;
}

int Run_Python_Update(char cmd[], char reason[])
{
  long result;

  write("[OTA_019][PY] %s", reason);
  write("[OTA_019][PY] WorkingDir = %s", gWorkingDir);
  write("[OTA_019][PY] Command    = %s", cmd);
  write("[OTA_019][PY] Reset AppState ve 0 truoc khi goi python");
  @PythonCom::AppState = 0;

  testStep("Python", "%s", reason);
  testWaitForTimeout(10000);
  result = TestWaitForSyscall(gWorkingDir, cmd, 0, 30000);
  write("[OTA_019][PY] Syscall ret = %d", result);
  // LUU Y: Khong dung ret de ket luan luong OTA. Ket qua OTA duoc xac nhan bang AppState (3/4).

  if (result != 1)
  {
    write("[OTA_019][PY][WARN] ret=%d nhung van tiep tuc luong test", result);
  }

  testStepPass("Python", "Da goi python (%s), ret=%d", reason, result);
  return 1;
}
testcase OTA_019()
{
  int swVerIsOne;
  int swVerIsOneAfterSetup;
  int setupAppStateResult;
  int mainAppStateResult;
  int swVerIsZeroAfterMain;

  Send_Value_To_COM(11919);
  write("===========================================================");
  write("[OTA_019] Start test case OTA_019");
  write("===========================================================");

  testStep("Step 1", "KEY OFF -> KEY ON -> Set_SMK_IGN -> Click_USM_Reset -> Click_Rec_Reset -> Turn_ON_PMD");

  write("[OTA_019] KEY_OFF");
  KEY_OFF();
  testWaitForTimeout(2000);

  write("[OTA_019] KEY_ON");
  KEY_ON();
  testWaitForTimeout(2000);

  write("[OTA_019] Set_SMK_IGN");
  Set_SMK_IGN();

  write("[OTA_019] Click_USM_Reset");
  Click_USM_Reset();

  write("[OTA_019] Click_Rec_Reset");
  Click_Rec_Reset();

  write("[OTA_019] Turn_ON_PMD");
  Turn_ON_PMD();

  testStep("Step 2", "Kiem tra SW version co phai ban 1 khong");
  swVerIsOne = Check_SWVerMinor3(1);

  if (swVerIsOne != 1)
  {
    write("[OTA_019] Version khong phai ban 1 -> chay update_to_01.py de dua ve ban 1");

    OTA_Reset_AppStateWaitContext();
    gAppStatePrev = gOTA_AppStateWaitStart;
    write("[OTA_019][SETUP] AppState truoc khi chay update_to_01.py = %d", gOTA_AppStateWaitStart);

    Run_Python_Update(gUpdateTo01Cmd, "Dua version ve ban 1 - update_to_01.py");

    // O setup: luon tiep tuc luong, chi dung AppState de ghi nhan ket qua.
    setupAppStateResult = Wait_AppState_3_Or_4_Changed(1800000);
    if (setupAppStateResult == 3)
    {
      write("[OTA_019][SETUP] update_to_01.py bao AppState=3 (OK setup), tiep tuc");
    }
    else if (setupAppStateResult == 4)
    {
      write("[OTA_019][SETUP] update_to_01.py bao AppState=4 (NG setup), van tiep tuc check version");
    }
    else
    {
      write("[OTA_019][SETUP] Timeout 30 phut o buoc update_to_01.py, van tiep tuc check version");
    }

    testWaitForTimeout(3000);
    swVerIsOneAfterSetup = Check_SWVerMinor3(1);
    if (swVerIsOneAfterSetup != 1)
    {
      testStepFail("Version", "Sau update_to_01.py van chua ve ban 1");
      CaptureGraphics("OTA", "SMK_TrmnlCtrlGrpStaBDC;BLTN_CAM_SWVerMinor3;BLTN_CAM_RecSta_PMD;PythonCom::AppState");
      Send_Value_To_COM(44);
      return;
    }

    testStepPass("Version", "Da dua SW version ve ban 1");
  }
  else
  {
    testStepPass("Version", "Da la ban 1 ngay tu dau");
  }

  testStep("Step 3", "Luong chinh: chay case_019.py");
  OTA_Reset_AppStateWaitContext();
  gAppStatePrev = gOTA_AppStateWaitStart;

  write("[OTA_019] AppState truoc khi chay case_019.py = %d", gOTA_AppStateWaitStart);

  Run_Python_Update(gCase019Cmd, "Luong chinh - chay case_019.py");

  testStep("Step 4", "Lang nghe AppState toi da 30 phut, dung khi thay 3 hoac 4");
  mainAppStateResult = Wait_AppState_3_Or_4_Changed(1800000);

  if (mainAppStateResult == 3)
  {
    write("[OTA_019] AppState = 3");
    swVerIsZeroAfterMain = Check_SWVerMinor3(0);
    CaptureGraphics("OTA", "SMK_TrmnlCtrlGrpStaBDC;BLTN_CAM_SWVerMinor3;BLTN_CAM_RecSta_PMD;PythonCom::AppState");

    if (swVerIsZeroAfterMain == 1)
    {
      testStepPass("Result", "AppState=3 va SW version=0 -> PASS");
    }
    else
    {
      testStepFail("Result", "AppState=3 nhung SW version khong phai ban 0 -> FAIL");
    }
  }
  else if (mainAppStateResult == 4)
  {
    write("[OTA_019] AppState = 4 -> FAIL");
    swVerIsZeroAfterMain = Check_SWVerMinor3(0);
    CaptureGraphics("OTA", "SMK_TrmnlCtrlGrpStaBDC;BLTN_CAM_SWVerMinor3;BLTN_CAM_RecSta_PMD;PythonCom::AppState");

    if (swVerIsZeroAfterMain == 1)
    {
      testStepFail("Result", "AppState=4 -> FAIL (mac du SW version=0)");
    }
    else
    {
      testStepFail("Result", "AppState=4 va SW version khong phai ban 0 -> FAIL");
    }
  }
  else
  {
    write("[OTA_019] Timeout 30 phut, khong thay AppState doi sang 3/4");
    CaptureGraphics("OTA", "SMK_TrmnlCtrlGrpStaBDC;BLTN_CAM_SWVerMinor3;BLTN_CAM_RecSta_PMD;PythonCom::AppState");
    testStepFail("Result", "Timeout 30 phut, khong thay AppState doi sang 3/4");
  }

  write("[OTA_019] Ket thuc testcase");
  Send_Value_To_COM(44);
}

void MainTest()
{
  testReportFileName("TestReports\\OTA_019_report");
  OTA_019();
}
