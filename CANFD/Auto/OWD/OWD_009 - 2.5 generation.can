/*@!Encoding:65001*/
includes
{
  #include "../DeclarationFunction_Gen2.5.h"
}

/*
  Test Case: OWD_009
  Title: [DEV Recording Default Settings after FRS Reset]
  Verification items:
    - Check BLTN_CAM_RecSet_DEV default value after Factory->Customer mode transition
    - Check default recording setting by region after FRS reset
    - Check BLTN_CAM_SenSet_DEV default value

  Preconditions:
    - ACC and IGN and ccNC/ccIC switch OFF, AVN mode

  Step 1: Set SMK_Signal to IGN (0x2), Click USM Reset, change to Factory mode, wait 3s, change to Customer mode
          -> Check BLTN_CAM_RecSet_DEV = 0x1 (OFF)
          -> Capture screenshot

  Step 2: Log message to ask user to enter Build-in Cam screen manually
          -> Set BLTN_CAM_RecSet_DEV = 0x2 (ON)
          -> Log message to ask user to perform FRS reset
          -> Wait up to 60s with reset detection logic (monitor CF_AVN_BLTN_CAM_RecReset)
          -> Check default value and determine region:
             * Domestic/Japan/North America/Russia/Middle East: BLTN_CAM_RecSet_DEV = 0x2 (ON)
             * Europe: BLTN_CAM_RecSet_DEV = 0x1 (OFF)
          -> Capture screenshot

  Step 3: Check BLTN_CAM_SenSet_DEV = 0x3 (LV.3)
          -> Capture screenshot

  NOTE: Uses 2s delay for signal propagation after each state transition.
*/

variables
{
  long max_wait_time = 60000;  // 60 seconds max wait for reset detection

  // Result tracking variables
  int step1_passed = 0;
  int step2_passed = 0;
  int step3_passed = 0;
}

// ============================================================================
// Main Test Case
// ============================================================================

testcase OWD_009_Init()
{
  Send_Value_To_COM(10900);
  write("========================================");
  write("=== START TEST OWD_009 ===");
  write("========================================");

  // Enable CGW NM
  @panel::Switch_CGWNM = 1;
  testWaitForTimeout(3000);
  Send_Value_To_COM(44);
}

testcase OWD_009_1()
{
  int result = 0;

  //============================================================================
  // STEP 1: Set SMK IGN, Click USM Reset, Factory mode -> Customer mode, Check RecSet_DEV = 0x1 (OFF)
  //============================================================================
  Send_Value_To_COM(10901);
  SetTestStep("Bước 1 - OWD_009");
  StartTestTimer();

  write("");
  write("=================================================================");
  write("=== STEP 1: SMK IGN + USM Reset + Factory -> Customer mode ===");
  write("=== Check BLTN_CAM_RecSet_DEV = 0x1 (OFF) ===");
  write("=================================================================");
  testStep("Step1", "SMK IGN + USM Reset + Mode transition + RecSet_DEV check");

  // 1.0 Set SMK to IGN via panel
  write("[1.0] Setting SMK_Signal to IGN via panel...");
  Set_SMK_IGN();
  testWaitForTimeout(2000);  // Extra delay after SMK change

  // 1.1 Click USM Reset button
  write("[1.1] Clicking USM Reset button...");
  Click_USM_Reset();
  testWaitForTimeout(2000);  // Extra delay after USM Reset

  // 1.1b Click Rec Reset button
  write("[1.1b] Clicking Rec Reset button...");
  Click_Rec_Reset();
  testWaitForTimeout(2000);

  // 1.2 Set to Factory Mode (0x0)
  write("[1.2] Setting to Factory Mode (0x0)...");
  Set_Factory_Mode();
  testWaitForTimeout(2000);  // Extra delay after mode change

  // 1.3 Wait 3 seconds
  write("[1.3] Waiting 3 seconds...");
  testWaitForTimeout(3000);

  // 1.4 Set to Customer Mode (0x2)
  write("[1.4] Setting to Customer Mode (0x2)...");
  Set_Customer_Mode();
  testWaitForTimeout(2000);  // Extra delay after mode change

  // 1.5 Check BLTN_CAM_RecSet_DEV = 0x1 (OFF)
  write("[1.5] Checking BLTN_CAM_RecSet_DEV...");
  testWaitForTimeout(3000);  // Wait 3s for signal propagation and stabilization
  result = Check_RecSet_DEV_OFF();

  // 1.6 Capture screenshot
  write("[1.6] Capturing screenshot...");
  CaptureGraphics("OWD", "BLTN_CAM_RecSet_DEV;BLTN_CAM_SenSet_DEV;ICU_PowerAutoCutModSta;SMK_TrmnlCtrlGrpStaBDC;BLTN_CAM_HU_UI_Mode");

  if(result == 1)
  {
    step1_passed = 1;
    testStepPass("Step1", "BLTN_CAM_RecSet_DEV = 0x1 (OFF) after Factory->Customer mode - PASS");
  }
  else
  {
    step1_passed = 0;
    write(">>> FAIL REASON: BLTN_CAM_RecSet_DEV expected 0x1 (OFF) after Factory->Customer mode but got 0x%X <<<", $BLTN_CAM_RecSet_DEV);
    Log_Error_Details();
    testStepFail("Step1", "BLTN_CAM_RecSet_DEV check failed - FAIL");
  }
  StopTestTimer();
  Send_Value_To_COM(44);
}

testcase OWD_009_2()
{
  int result = 0;
  byte final_RecSet_DEV = 0;

  //============================================================================
  // STEP 2: Enter Build-in Cam, Set DEV ON, FRS Reset, Check default value by region
  //============================================================================
  Send_Value_To_COM(10902);
  SetTestStep("Bước 2 - OWD_009");
  StartTestTimer();

  write("");
  write("=================================================================");
  write("=== STEP 2: Set DEV ON + FRS Reset + Check default by region ===");
  write("=================================================================");
  testStep("Step2", "DEV ON + FRS Reset + Region check");

  // 2.1 Log message - Ask user to enter Build-in Cam screen
  write("");
  write("*************************************************************");
  write("*** ACTION REQUIRED ***");
  write("*** Please manually enter Build-in Cam screen now! ***");
  write("*** (Enter Settings - Build-in Cam on the real device) ***");
  write("*************************************************************");
  write("");

  // Wait for user to enter Build-in Cam mode
  write("[2.1] Waiting for user to enter Build-in Cam mode...");
  if(Wait_For_BLTN_CAM_Mode(max_wait_time) == 0)
  {
    write(">>> WARNING: Not in Build-in Cam mode, proceeding anyway <<<");
  }
  testWaitForTimeout(3000);  // Extra delay after entering Build-in Cam mode

  // 2.2 Set BLTN_CAM_RecSet_DEV to ON (0x2)
  write("[2.2] Setting BLTN_CAM_RecSet_DEV to ON (0x2)...");
  Turn_ON_DEV();
  testWaitForTimeout(3000);  // Extra delay after setting DEV

  // Verify DEV is ON
  if($BLTN_CAM_RecSet_DEV == 0x2)
  {
    write(">>> Confirmed: DEV is ON (0x2) <<<");
  }
  else
  {
    write(">>> WARNING: DEV may not be ON - current value: 0x%X <<<", $BLTN_CAM_RecSet_DEV);
  }

  // 2.3 Log message - Ask user to perform FRS reset
  write("");
  write("*************************************************************");
  write("*** ACTION REQUIRED ***");
  write("*** Please perform FRS reset now! ***");
  write("*** Go to: [ccNC Settings] - [General] - [Reset] ***");
  write("***        [Delete Guest Profile/Reset Entire System] ***");
  write("*** Script will automatically detect reset within 60s ***");
  write("*************************************************************");
  write("");

  // 2.4 Wait for reset detection (max 60 seconds)
  write("[2.4] Waiting for FRS reset detection (max 60 seconds)...");
  result = Wait_For_FRS_Reset(max_wait_time);

  if(result == 1)
  {
    write(">>> Reset detected successfully! <<<");

    // Wait for system to stabilize after reset
    write("Waiting 15 seconds for system to stabilize after reset...");
    testWaitForTimeout(15000);

    // 2.5 Read final value and determine region
    write("[2.5] Checking default value and determining region...");
    testWaitForTimeout(3000);  // Extra delay before reading final value
    final_RecSet_DEV = $BLTN_CAM_RecSet_DEV;

    write("");
    write("=== Region Detection Result ===");
    write("BLTN_CAM_RecSet_DEV = 0x%X after FRS reset", final_RecSet_DEV);

    if(final_RecSet_DEV == 0x2)
    {
      write("");
      write("*************************************************************");
      write("*** REGION: Domestic/Japan/North America/Russia/Middle East ***");
      write("*** BLTN_CAM_RecSet_DEV = 0x2 (ON) ***");
      write("*** The default recording setting is ON when initialized ***");
      write("*** after FRS setup operation. ***");
      write("*************************************************************");
      write("");
      step2_passed = 1;
      testStepPass("Step2", "Region: Non-Europe - RecSet_DEV = 0x2 (ON) - PASS");
    }
    else if(final_RecSet_DEV == 0x1)
    {
      write("");
      write("*************************************************************");
      write("*** REGION: Europe ***");
      write("*** BLTN_CAM_RecSet_DEV = 0x1 (OFF) ***");
      write("*** The default recording setting is OFF when initialized ***");
      write("*** after FRS setup operation. ***");
      write("*************************************************************");
      write("");
      step2_passed = 1;
      testStepPass("Step2", "Region: Europe - RecSet_DEV = 0x1 (OFF) - PASS");
    }
    else
    {
      write(">>> ERROR: Unexpected value RecSet_DEV = 0x%X <<<", final_RecSet_DEV);
      step2_passed = 0;
      write(">>> FAIL REASON: BLTN_CAM_RecSet_DEV unexpected value 0x%X after FRS reset (expected 0x1 or 0x2) <<<", final_RecSet_DEV);
      Log_Error_Details();
      testStepFail("Step2", "RecSet_DEV = 0x%X - Unexpected value - FAIL", final_RecSet_DEV);
    }
  }
  else
  {
    write(">>> Reset not detected within timeout <<<");
    step2_passed = 0;
    write(">>> FAIL REASON: FRS reset not detected within %d seconds <<<", max_wait_time / 1000);
    Log_Error_Details();
    testStepFail("Step2", "FRS reset not detected within 60 seconds - FAIL");
  }

  // 2.6 Capture screenshot
  write("[2.6] Capturing screenshot...");
  CaptureGraphics("OWD", "BLTN_CAM_RecSet_DEV;CF_AVN_BLTN_CAM_RecReset;ICU_PowerAutoCutModSta;BLTN_CAM_HU_UI_Mode");
  StopTestTimer();
  Send_Value_To_COM(44);
}

testcase OWD_009_3()
{
  int result = 0;

  //============================================================================
  // STEP 3: Check BLTN_CAM_SenSet_DEV = 0x3 (LV.3)
  //============================================================================
  Send_Value_To_COM(10903);
  SetTestStep("Bước 3 - OWD_009");
  StartTestTimer();

  write("");
  write("=================================================================");
  write("=== STEP 3: Check BLTN_CAM_SenSet_DEV = 0x3 (LV.3) ===");
  write("=================================================================");
  testStep("Step3", "SenSet_DEV = 0x3 (LV.3) check");

  // 3.1 Check BLTN_CAM_SenSet_DEV = 0x3
  write("[3.1] Checking BLTN_CAM_SenSet_DEV...");
  testWaitForTimeout(3000);  // Wait 3s for signal propagation and stabilization
  result = Check_DEV_Sensitivity(0x3);

  // 3.2 Capture screenshot
  write("[3.2] Capturing screenshot...");
  CaptureGraphics("OWD", "BLTN_CAM_SenSet_DEV;BLTN_CAM_RecSet_DEV;ICU_PowerAutoCutModSta;BLTN_CAM_HU_UI_Mode");

  if(result == 1)
  {
    step3_passed = 1;
    testStepPass("Step3", "BLTN_CAM_SenSet_DEV = 0x3 (LV.3) - PASS");
  }
  else
  {
    step3_passed = 0;
    write(">>> FAIL REASON: BLTN_CAM_SenSet_DEV expected 0x3 (LV.3) but got 0x%X <<<", $BLTN_CAM_SenSet_DEV);
    Log_Error_Details();
    testStepFail("Step3", "BLTN_CAM_SenSet_DEV check failed - FAIL");
  }
  StopTestTimer();
  Send_Value_To_COM(44);
}


void MainTest()
{
  testReportFileName("TestReports\\OWD_009 - 2.5 generation_report");
  OWD_009_Init();
  OWD_009_1();
  OWD_009_2();
  OWD_009_3();
}
