/*@!Encoding:65001*/
includes
{
  #include "../DeclarationFunction_Gen2.5.h"
}

//Preconditions: - ACC and IGN and ccNC/ccIC switch OFF, AVN mode
//               - Add signal: BLTN_CAM_RecSta_OWP, BLTN_CAM_RecSet_OWP, BLTN_CAM_Prk_Oprable_Time

/*
  Test Case: OWP_002 - 2.5 (OWP_002)
  Title: [Recording while Parking] - Continuous Recording ON/OFF and Operable Time

  Step 1: KEY ON (IGN), USM Reset, Rec Reset, Enter BLTN_CAM, Turn OFF [Recording while Parking]
          Check BLTN_CAM_RecSet_OWP = 0x1 (OFF)
  Step 2: Exit BLTN_CAM, KEY OFF, Check BLTN_CAM_RecSta_OWP = 0x0 (OFF)
  Step 3_4: Log - LED not blinking (manual check)
  Step 5: KEY ON, Enter BLTN_CAM, Turn ON [Recording while Parking]
          Check BLTN_CAM_RecSet_OWP = 0x0 (Default)
  Step 6: Turn ON [Recording while Parking], Exit BLTN_CAM, Set P-LBM SoC = 0xFF
          Check BLTN_CAM_Prk_Oprable_Time = 0x00
  Step 7: Check [Recording while Parking] = ON, KEY OFF, wait 3 min, KEY ON
          Log: check actual video (no screenshot)
  Step 8: Quickly press ACC&IGN ON/OFF 20 times, then OFF, wait a few seconds
          Check BLTN_CAM_RecSta_OWP = ON
    Step 9: KEY ON, Turn OFF [Recording while Parking], quickly press ACC&IGN ON/OFF 20 times,
      KEY OFF, wait a few seconds, Check BLTN_CAM_RecSta_OWP = OFF

  NOTE: Uses 2-5s delay for signal propagation after each state transition.
*/

variables
{
  // Result tracking
  int step1_passed = 0;
  int step2_passed = 0;
  int step3_4_passed = 0;
  int step5_passed = 0;
  int step6_passed = 0;
  int step7_passed = 0;
  int step8_passed = 0;
  int step9_passed = 0;

   // Message Declaration for CAN FD
  message HU_BLTN_CAM_02_200ms _HU_BLTN_CAM_02_200ms;
  message HU_BLTN_CAM_01_00ms _HU_BLTN_CAM_01_00ms;
  message HU_CLOCK_01_1000ms _HU_CLOCK_01_1000ms;
  message PDC_FD_11_200ms _PDC_FD_11_200ms;
}

// ============================================================================
// Test Cases
// ============================================================================

testcase OWP_002_Init(){
  Send_Value_To_COM(20200);
  write("========================================");
  write("=== START TEST OWP_002 - 2.5 ===");
  write("========================================");

  write("===SETTING BEFORE TESTING===");

 // write("Run Turn_OFF_RecSet()"); Turn_OFF_RecSet();

  write("===START TEST===");
  Send_Value_To_COM(44);
}

testcase OWP_002_1(){
  Send_Value_To_COM(20201);
  SetTestStep("Bước 1 - OWP_002");
  StartTestTimer();
  //============================================================================
  // STEP 1: KEY ON (IGN), USM Reset, Rec Reset, Enter BLTN_CAM screen transition
  //         Turn OFF [Recording while Parking], Check BLTN_CAM_RecSet_OWP = 0x1 (OFF)
  //============================================================================
  write("");
  write("=== STEP 1: KEY ON (IGN), USM/Rec Reset, Enter BLTN_CAM, Turn OFF OWP ===");
  testStep("Step1", "KEY ON (IGN) + USM Reset + Rec Reset + Enter BLTN_CAM, turn OFF OWP -> check BLTN_CAM_RecSet_OWP = 0x1 (OFF)");
// Set SMK to IGN (0x2) via panel combo box
  write("Setting SMK_Signal to IGN (0x2)...");
  KEY_ON();
  testWaitForTimeout(3000);
  write("  SMK_TrmnlCtrlGrpStaBDC = 0x%X", $SMK_TrmnlCtrlGrpStaBDC);

  // Click USM Reset
  Click_USM_Reset();

  // Click Rec Reset
  Click_Rec_Reset();
  @panel::Switch_CGWNM = 1;
  testWaitForTimeout(2000);

  

  // Enter Built-in cam screen transition
  Enter_BLTN_CAM();
  testWaitForTimeout(3000);

  // Turn Continuous Recording [Recording while Parking] set OFF
  // If OWP is currently ON (0x2), toggle it OFF
  if (getSignal(BLTN_CAM_RecSet_OWP) == 0x2){
    write("OWP is ON (0x2), toggling to OFF...");
    @panel::LED_Ctrl_SetOWP = 1;
    testWaitForTimeout(3000);
  }
  // If OWP is already OFF (0x1), no action needed
  else if (getSignal(BLTN_CAM_RecSet_OWP) == 0x1){
    write("OWP is already OFF (0x1), no toggle needed.");
  }
  // If OWP is default (0x0), toggle to set it to OFF path
  else if (getSignal(BLTN_CAM_RecSet_OWP) == 0x0){
    write("OWP is Default (0x0), need to verify after entering BLTN_CAM...");
    // Toggle once - this should turn it ON first
    @panel::LED_Ctrl_SetOWP = 1;
    testWaitForTimeout(3000);
    // If now ON, toggle once more to OFF
    if (getSignal(BLTN_CAM_RecSet_OWP) == 0x2){
      @panel::LED_Ctrl_SetOWP = 1;
      testWaitForTimeout(3000);
    }
  }

  testWaitForTimeout(2000);

  // Check BLTN_CAM_RecSet_OWP = 0x1 (OFF)
  write("BLTN_CAM_RecSet_OWP = 0x%X", $BLTN_CAM_RecSet_OWP);

  if ($BLTN_CAM_RecSet_OWP == 0x1){
    write(">>> [PASS] BLTN_CAM_RecSet_OWP = 0x1 (OFF) <<<");
    testStepPass("Step1", "BLTN_CAM_RecSet_OWP = 0x1 (OFF) - PASS");
    step1_passed = 1;
  }
  else {
    write(">>> [FAIL] BLTN_CAM_RecSet_OWP = 0x%X, expected 0x1 (OFF) <<<", $BLTN_CAM_RecSet_OWP);
    Log_Error_Details();

    testStepFail("Step1", "BLTN_CAM_RecSet_OWP = 0x%X, expected 0x1 - FAIL", $BLTN_CAM_RecSet_OWP);
    step1_passed = 0;
  }

  CaptureGraphics("OWP", "SMK_TrmnlCtrlGrpStaBDC;CF_AVN_BLTN_CAM_RecReset;BLTN_CAM_RecSet_OWP;BLTN_CAM_RecSta_OWP;BLTN_CAM_HU_UI_Mode;BLTN_CAM_State");

  write("=== FINISH STEP 1 ===");
  StopTestTimer();
  Send_Value_To_COM(44);
}

testcase OWP_002_2(){
  Send_Value_To_COM(20202);
  SetTestStep("Bước 2 - OWP_002");
  StartTestTimer();
  //============================================================================
  // STEP 2: Exit BLTN_CAM, KEY OFF, Check BLTN_CAM_RecSta_OWP = 0x0 (OFF)
  //============================================================================
  write("");
  write("=== STEP 2: Exit BLTN_CAM, KEY OFF, Check RecSta_OWP = OFF ===");
  testStep("Step2", "Exit BLTN_CAM + KEY OFF, check BLTN_CAM_RecSta_OWP = 0x0 (OFF) - OWP stops when engine off");

  // Exit BLTN_CAM screen
  Exit_BLTN_CAM();
  testWaitForTimeout(3000);

  // KEY OFF
  write("KEY OFF...");
  KEY_OFF();
  testWaitForTimeout(5000);

  // Check BLTN_CAM_RecSta_OWP = 0x0 (OFF)
  write("BLTN_CAM_RecSta_OWP = 0x%X", $BLTN_CAM_RecSta_OWP);

  if ($BLTN_CAM_RecSta_OWP == 0x0){
    write(">>> [PASS] BLTN_CAM_RecSta_OWP = 0x0 (OFF) <<<");
    testStepPass("Step2", "BLTN_CAM_RecSta_OWP = 0x0 (OFF) - PASS");
    step2_passed = 1;
  }
  else {
    write(">>> [FAIL] BLTN_CAM_RecSta_OWP = 0x%X, expected 0x0 (OFF) <<<", $BLTN_CAM_RecSta_OWP);
    Log_Error_Details();

    testStepFail("Step2", "BLTN_CAM_RecSta_OWP = 0x%X, expected 0x0 - FAIL", $BLTN_CAM_RecSta_OWP);
    step2_passed = 0;
  }

  CaptureGraphics("OWP", "SMK_TrmnlCtrlGrpStaBDC;BLTN_CAM_RecSta_OWP;BLTN_CAM_RecSet_OWP;BLTN_CAM_HU_UI_Mode;BLTN_CAM_State");

  write("=== FINISH STEP 2 ===");
  StopTestTimer();
  Send_Value_To_COM(44);
}

testcase OWP_002_3_4(){
  Send_Value_To_COM(20203);
  SetTestStep("Bước 3_4 - OWP_002");
  StartTestTimer();
  //============================================================================
  // STEP 3 & 4: Log - LED not blinking (manual check)
  //============================================================================
  write("");
  write("=== STEP 3 & 4: LED not blinking check (Manual) ===");
  testStep("Step3_4", "Log notification - LED not blinking (manual check): OWP is OFF so LED should NOT blink");

  write("*************************************************************");
  write("*** [MANUAL CHECK] LED is NOT blinking                    ***");
  write("*** OWP recording is OFF, so LED should NOT blink.        ***");
  write("*** Please visually confirm that the LED is not blinking. ***");
  write("*************************************************************");

  testStepPass("Step3_4", "Log: LED not blinking - manual check required");
  step3_4_passed = 1;

  write("=== FINISH STEP 3_4 ===");

  write("[Capture] Wait 5 seconds before screenshot");
  testWaitForTimeout(5000);
  CaptureGraphics("OWP", "BLTN_CAM_RecSet_OWP;BLTN_CAM_RecSta_OWP;BLTN_CAM_RecSta_MAR");
  StopTestTimer();
  Send_Value_To_COM(44);
}

testcase OWP_002_5(){
  Send_Value_To_COM(20205);
  SetTestStep("Bước 5 - OWP_002");
  StartTestTimer();
  //============================================================================
  // STEP 5: KEY ON, Enter BLTN_CAM, Turn ON [Recording while Parking]
  //         Check BLTN_CAM_RecSet_OWP = 0x0 (Default) => means Turn ON action confirmed
  //============================================================================
  write("");
  write("=== STEP 5: KEY ON, Enter BLTN_CAM, Turn ON OWP ===");
  testStep("Step5", "KEY ON + Enter BLTN_CAM, turn ON OWP -> check BLTN_CAM_RecSet_OWP = 0x0 (Default) or 0x2 (ON)");

  @panel::Switch_CGWNM = 1;

  // KEY ON
  write("KEY ON...");
  KEY_ON();
  testWaitForTimeout(3000);

  // Enter BLTN_CAM
  Enter_BLTN_CAM();
  testWaitForTimeout(3000);

  // Turn ON [Recording while Parking] - continuous recording
  write("Turning ON [Recording while Parking]...");
  write("  Current BLTN_CAM_RecSet_OWP = 0x%X", $BLTN_CAM_RecSet_OWP);

  if ($BLTN_CAM_RecSet_OWP == 0x1){
    // OWP is OFF, toggle to ON
    @panel::LED_Ctrl_SetOWP = 1;
    testWaitForTimeout(3000);
    write("  After toggle: BLTN_CAM_RecSet_OWP = 0x%X", $BLTN_CAM_RecSet_OWP);
  }

  // Check BLTN_CAM_RecSet_OWP should be 0x0 (Default) or 0x2 (ON)
  // According to test spec: check BLTN_CAM_RecSet_OWP = 0x0 (Default)
  write("BLTN_CAM_RecSet_OWP = 0x%X", $BLTN_CAM_RecSet_OWP);

  if ($BLTN_CAM_RecSet_OWP == 0x0){
    write(">>> [PASS] BLTN_CAM_RecSet_OWP = 0x0 (Default) <<<");
    testStepPass("Step5", "BLTN_CAM_RecSet_OWP = 0x0 (Default) - PASS");
    step5_passed = 1;
  }
  else if ($BLTN_CAM_RecSet_OWP == 0x2){
    write(">>> [PASS] BLTN_CAM_RecSet_OWP = 0x2 (ON) <<<");
    testStepPass("Step5", "BLTN_CAM_RecSet_OWP = 0x2 (ON) - PASS");
    step5_passed = 1;
  }
  else {
    write(">>> [FAIL] BLTN_CAM_RecSet_OWP = 0x%X, expected 0x0 or 0x2 <<<", $BLTN_CAM_RecSet_OWP);
    Log_Error_Details();

    testStepFail("Step5", "BLTN_CAM_RecSet_OWP = 0x%X - FAIL", $BLTN_CAM_RecSet_OWP);
    step5_passed = 0;
  }

  CaptureGraphics("OWP", "SMK_TrmnlCtrlGrpStaBDC;BLTN_CAM_RecSet_OWP;BLTN_CAM_RecSta_OWP;BLTN_CAM_HU_UI_Mode;BLTN_CAM_State");

  write("=== FINISH STEP 5 ===");
  StopTestTimer();
  Send_Value_To_COM(44);
}

testcase OWP_002_6(){
  Send_Value_To_COM(20206);
  SetTestStep("Bước 6 - OWP_002");
  StartTestTimer();
  //============================================================================
  // STEP 6: Turn ON [Recording while Parking], Exit BLTN_CAM,
  //         Set P-LBM SoC = 0xFF, Check BLTN_CAM_Prk_Oprable_Time = 0x00
  //============================================================================
  write("");
  write("=== STEP 6: OWP ON, Exit BLTN_CAM, Set SoC=0xFF, Check Prk_Oprable_Time ===");
  testStep("Step6", "OWP ON + Exit BLTN_CAM, set P-LBM SoC = 0xFF -> check BLTN_CAM_Prk_Oprable_Time = 0x00");

  // Ensure OWP is ON
  write("  Current BLTN_CAM_RecSet_OWP = 0x%X", $BLTN_CAM_RecSet_OWP);
  if ($BLTN_CAM_RecSet_OWP == 0x1){
    write("OWP is OFF, toggling to ON...");
    @panel::LED_Ctrl_SetOWP = 1;
    testWaitForTimeout(3000);
  }

  // Confirm OWP is ON
  if ($BLTN_CAM_RecSet_OWP == 0x2){
    write(">>> [OK] OWP is ON (0x2) <<<");
  }
  else {
    write(">>> [WARNING] OWP = 0x%X, trying again... <<<", $BLTN_CAM_RecSet_OWP);
    // Re-enter and try again
    Exit_BLTN_CAM();
    testWaitForTimeout(2000);
    Enter_BLTN_CAM();
    testWaitForTimeout(3000);
    @panel::LED_Ctrl_SetOWP = 1;
    testWaitForTimeout(3000);
  }

  // Exit BLTN_CAM
  Exit_BLTN_CAM();
  testWaitForTimeout(3000);

  // Set P-LBM SoC: 0xFF
  write("Setting ICU_BS2SoC = 0xFF (P-LBM SoC)...");
  _PDC_FD_11_200ms.ICU_BS2SoC = 0xFF;
  output(_PDC_FD_11_200ms);
  testWaitForTimeout(5000);

  // Check BLTN_CAM_Prk_Oprable_Time = 0x00
  // Use explicit cast to int to avoid double precision issues
  if ((int)$BLTN_CAM_Prk_Oprable_Time == 0){
    write(">>> [PASS] BLTN_CAM_Prk_Oprable_Time = 0x%X (0x00) <<<", (int)$BLTN_CAM_Prk_Oprable_Time);
    testStepPass("Step6", "BLTN_CAM_Prk_Oprable_Time = 0x00 - PASS");
    step6_passed = 1;
  }
  else {
    write(">>> [FAIL] BLTN_CAM_Prk_Oprable_Time = 0x%X, expected 0x00 <<<", (int)$BLTN_CAM_Prk_Oprable_Time);
    Log_Error_Details();

    testStepFail("Step6", "BLTN_CAM_Prk_Oprable_Time = 0x%X, expected 0x00 - FAIL", (int)$BLTN_CAM_Prk_Oprable_Time);
    step6_passed = 0;
  }

  CaptureGraphics("OWP", "ICU_BS2SoC;BLTN_CAM_Prk_Oprable_Time;BLTN_CAM_RecSet_OWP;BLTN_CAM_RecSta_OWP;BLTN_CAM_State");

  write("=== FINISH STEP 6 ===");
  StopTestTimer();
  Send_Value_To_COM(44);
}

testcase OWP_002_7(){
  Send_Value_To_COM(20207);
  SetTestStep("Bước 7 - OWP_002");
  StartTestTimer();
  //============================================================================
  // STEP 7: Check [Recording while Parking] = ON, KEY OFF, wait 3 min, KEY ON
  //         Log: check actual video (no screenshot needed)
  //============================================================================
  write("");
  write("=== STEP 7: OWP ON, KEY OFF, wait 3 min, KEY ON ===");
  testStep("Step7", "OWP ON confirmed + KEY OFF, wait 3 min (parking), KEY ON -> manual check: verify recorded video file");


  // KEY OFF
  write("KEY OFF...");
  KEY_OFF();
  WaitFor_RecSta_OWP_Recording(100000); // Wait up to 10s for OWP recording to start after KEY OFF

  // Wait 3 minutes (180 seconds)
  testWaitForTimeout(180000);

  // KEY ON
  write("KEY ON...");
  KEY_ON();
  Enter_BLTN_CAM();
  testWaitForTimeout(5000);



  testStepPass("Step7", "OWP recording during parking - manual video check required");
  step7_passed = 1;

  write("=== FINISH STEP 7 ===");

  write("[Capture] Wait 5 seconds before screenshot");
  testWaitForTimeout(5000);
  CaptureGraphics("OWP", "BLTN_CAM_RecSet_OWP;SMK_TrmnlCtrlGrpStaBDC;BLTN_CAM_RecSta_OWP;BLTN_CAM_RecSta_MAR;AIN");
  StopTestTimer();
  Send_Value_To_COM(44);
}

testcase OWP_002_8(){
  Send_Value_To_COM(20208);
  SetTestStep("Bước 8 - OWP_002");
  StartTestTimer();
  //============================================================================
  // STEP 8: Quickly press ACC&IGN ON/OFF 20 times, then turn OFF
  //         Wait a few seconds, Check BLTN_CAM_RecSta_OWP = ON
  //============================================================================
  write("");
  write("=== STEP 8: Quickly press ACC&IGN ON/OFF 20 times ===");
  testStep("Step8", "Rapid press ACC&IGN ON/OFF x20 times, KEY OFF, wait -> check BLTN_CAM_RecSta_OWP = 0x1 (ON)");

  // Ensure we start from a known state
  write("Starting rapid ACC&IGN ON/OFF cycle (20 times)...");

  {
    int cycle;
    for (cycle = 1; cycle <= 20; cycle++){
      // KEY ON (ACC&IGN)
      KEY_ON();
      testWaitForTimeout(500);

      // KEY OFF
      KEY_OFF();
      testWaitForTimeout(500);

      if (cycle % 5 == 0){
        write("  Cycle %d/20 completed", cycle);
      }
    }
  }

  // Final state: OFF
  write("Final KEY OFF after 20 cycles...");
  KEY_OFF();
  testWaitForTimeout(5000);

  // Check BLTN_CAM_RecSta_OWP = ON (0x1)
  write("BLTN_CAM_RecSta_OWP = 0x%X", $BLTN_CAM_RecSta_OWP);

  if ($BLTN_CAM_RecSta_OWP == 0x1){
    write(">>> [PASS] BLTN_CAM_RecSta_OWP = 0x1 (ON) <<<");
    testStepPass("Step8", "BLTN_CAM_RecSta_OWP = 0x1 (ON) after rapid ON/OFF - PASS");
    step8_passed = 1;
  }
  else {
    write(">>> [INFO] BLTN_CAM_RecSta_OWP = 0x%X, waiting for signal change (max 30s)...", $BLTN_CAM_RecSta_OWP);

    // Wait for OWP recording to start (polling every 1s, max 30s)
    if (WaitFor_RecSta_OWP_Recording(30000) == 1){
      write(">>> [PASS] BLTN_CAM_RecSta_OWP = 0x1 (ON) <<<");
      testStepPass("Step8", "BLTN_CAM_RecSta_OWP = 0x1 (ON) after wait - PASS");
      step8_passed = 1;
    }
    else {
      write(">>> [FAIL] Timeout waiting for BLTN_CAM_RecSta_OWP = 0x1 <<<");
      write(">>> BLTN_CAM_RecSta_OWP = 0x%X <<<", $BLTN_CAM_RecSta_OWP);
      Log_Error_Details();

      testStepFail("Step8", "BLTN_CAM_RecSta_OWP did not change to ON - FAIL");
      step8_passed = 0;
    }
  }

  CaptureGraphics("OWP", "SMK_TrmnlCtrlGrpStaBDC;BLTN_CAM_RecSta_OWP;BLTN_CAM_RecSet_OWP;BLTN_CAM_State");

  write("=== FINISH STEP 8 ===");
  StopTestTimer();
  Send_Value_To_COM(44);
}

testcase OWP_002_9(){
  Send_Value_To_COM(20209);
  SetTestStep("Bước 9 - OWP_002");
  StartTestTimer();
  //============================================================================
  // STEP 9: KEY ON, Turn_OFF_OWP, rapid KEY ON/OFF x20, KEY OFF,
  //         wait a few seconds, Check BLTN_CAM_RecSta_OWP = OFF
  //============================================================================
  write("");
  write("=== STEP 9: KEY ON, Turn_OFF_OWP, rapid ON/OFF x20, check RecSta_OWP OFF ===");
  testStep("Step9", "KEY ON + Turn_OFF_OWP + rapid ACC&IGN ON/OFF x20 + KEY OFF + wait -> check BLTN_CAM_RecSta_OWP = 0x0 (OFF)");

  // KEY ON
  write("KEY ON...");
  KEY_ON();
  testWaitForTimeout(3000);

  // Turn OFF OWP using helper function
  write("Turning OFF OWP...");
  Turn_OFF_OWP();
  testWaitForTimeout(3000);

  // Rapid KEY ON/OFF 20 cycles
  write("Starting rapid ACC&IGN ON/OFF cycle (20 times)...");
  {
    int cycle;
    for (cycle = 1; cycle <= 20; cycle++){
      KEY_ON();
      testWaitForTimeout(500);

      KEY_OFF();
      testWaitForTimeout(500);

      if (cycle % 5 == 0){
        write("  Cycle %d/20 completed", cycle);
      }
    }
  }

  // Ensure final state is KEY OFF, then wait a few seconds
  write("Final KEY OFF after 20 cycles...");
  KEY_OFF();
  testWaitForTimeout(5000);

  // Check OWP recording status should be OFF (0x0)
  write("BLTN_CAM_RecSta_OWP = 0x%X", $BLTN_CAM_RecSta_OWP);

  if ($BLTN_CAM_RecSta_OWP == 0x0){
    write(">>> [PASS] BLTN_CAM_RecSta_OWP = 0x0 (OFF) <<<");
    testStepPass("Step9", "BLTN_CAM_RecSta_OWP = 0x0 (OFF) after Turn_OFF_OWP and rapid ON/OFF - PASS");
    step9_passed = 1;
  }
  else {
    write(">>> [FAIL] BLTN_CAM_RecSta_OWP = 0x%X, expected 0x0 (OFF) <<<", $BLTN_CAM_RecSta_OWP);
    Log_Error_Details();

    testStepFail("Step9", "BLTN_CAM_RecSta_OWP = 0x%X, expected 0x0 (OFF) - FAIL", $BLTN_CAM_RecSta_OWP);
    step9_passed = 0;
  }

  CaptureGraphics("OWP", "SMK_TrmnlCtrlGrpStaBDC;BLTN_CAM_RecSet_OWP;BLTN_CAM_RecSta_OWP;BLTN_CAM_State");

  write("=== FINISH STEP 9 ===");
  StopTestTimer();
  Send_Value_To_COM(44);
}

testcase OWP_002_Summary(){
  //============================================================================
  // Overall Test Verdict
  //============================================================================
  if(step1_passed == 1 && step2_passed == 1 && step3_4_passed == 1 && step5_passed == 1 && step6_passed == 1 && step7_passed == 1 && step8_passed == 1 && step9_passed == 1)
  {
    testStepPass("Overall_Verdict", "Test OWP_002 - 2.5: PASS");
    write("=== OVERALL VERDICT: PASS ===");
  }
  else
  {
    Log_Error_Details();

    testStepFail("Overall_Verdict", "Test OWP_002 - 2.5: FAIL");
    write("=== OVERALL VERDICT: FAIL ===");
  }

  //============================================================================
  // SUMMARY
  //============================================================================
  write("");
  write("=== TEST SUMMARY ===");

  if(step1_passed == 1)
    write("Step 1: KEY ON (IGN), USM/Rec Reset, Enter BLTN_CAM, OWP OFF -> RecSet_OWP = 0x1 (OFF) [Screenshot] => PASS");
  else
    write("Step 1: KEY ON (IGN), USM/Rec Reset, Enter BLTN_CAM, OWP OFF -> RecSet_OWP = 0x1 (OFF) [Screenshot] => FAIL");

  if(step2_passed == 1)
    write("Step 2: Exit BLTN_CAM, KEY OFF -> RecSta_OWP = 0x0 (OFF) [Screenshot] => PASS");
  else
    write("Step 2: Exit BLTN_CAM, KEY OFF -> RecSta_OWP = 0x0 (OFF) [Screenshot] => FAIL");

  if(step3_4_passed == 1)
    write("Step 3_4: LED not blinking [Manual Check] => PASS");
  else
    write("Step 3_4: LED not blinking [Manual Check] => FAIL");

  if(step5_passed == 1)
    write("Step 5: KEY ON, Enter BLTN_CAM, Turn ON OWP -> RecSet_OWP = 0x0 (Default) [Screenshot] => PASS");
  else
    write("Step 5: KEY ON, Enter BLTN_CAM, Turn ON OWP -> RecSet_OWP = 0x0 (Default) [Screenshot] => FAIL");

  if(step6_passed == 1)
    write("Step 6: OWP ON, Exit BLTN_CAM, SoC=0xFF -> Prk_Oprable_Time = 0x00 [Screenshot] => PASS");
  else
    write("Step 6: OWP ON, Exit BLTN_CAM, SoC=0xFF -> Prk_Oprable_Time = 0x00 [Screenshot] => FAIL");

  if(step7_passed == 1)
    write("Step 7: OWP ON, KEY OFF 3 min, KEY ON -> Check actual video [No Screenshot] => PASS");
  else
    write("Step 7: OWP ON, KEY OFF 3 min, KEY ON -> Check actual video [No Screenshot] => FAIL");

  if(step8_passed == 1)
    write("Step 8: Rapid ACC&IGN ON/OFF x20, OFF -> RecSta_OWP = ON [Screenshot] => PASS");
  else
    write("Step 8: Rapid ACC&IGN ON/OFF x20, OFF -> RecSta_OWP = ON [Screenshot] => FAIL");

  if(step9_passed == 1)
    write("Step 9: KEY ON, Turn_OFF_OWP, Rapid ACC&IGN ON/OFF x20, KEY OFF -> RecSta_OWP = OFF [Screenshot] => PASS");
  else
    write("Step 9: KEY ON, Turn_OFF_OWP, Rapid ACC&IGN ON/OFF x20, KEY OFF -> RecSta_OWP = OFF [Screenshot] => FAIL");

  testStep("Notifications","Finish OWP_002 - 2.5");
  write("");
  write("========================================");
  write("=== FINISH OWP_002 - 2.5 ===");
  write("========================================");
}

void MainTest(){
  testReportFileName("TestReports\\OWP_002 - 2.5 generation_report");
  OWP_002_Init();

  //OWP_002_1();

  //OWP_002_2();

  //OWP_002_3_4();

 // OWP_002_5();

 // OWP_002_6();

  OWP_002_7();

 // OWP_002_8();

  //OWP_002_9();

 // OWP_002_Summary();
}
