/*@!Encoding:65001*/

includes
{
  #include "../DeclarationFunction_Gen2.5.h"
}

/*
  Test Case: OWP_025 - 2.5 generation
  Title: PMD disabled/radar-only behavior during front/rear camera detach,
         network sleep, and PEV recording.

  Step details:
    - Step 1: Attach rear/front, KEY ON, Set_SMK_IGN, USM/Rec reset,
      Turn_ON_PMD, KEY OFF, wait PMD OFF, detach front, check PMD OFF for 30s.
    - Step 2: Attach rear/front, KEY ON/OFF, wait PMD OFF, detach rear,
      check PMD OFF for 30s.
    - Step 3: Attach rear/front, KEY ON/OFF, wait PMD OFF, wait network sleep,
      detach front, check PMD OFF for 30s.
    - Step 5: Attach rear/front, KEY ON/OFF, wait PMD OFF, wait network sleep,
      detach rear, check PMD OFF for 30s.
    - Step 7: Attach rear/front, KEY ON/OFF, detach front, check PMD OFF for 30s.
    - Step 8: KEY OFF, wait PMD OFF, wait network sleep, attach front, check PMD OFF for 30s.
    - Step 10: Attach rear/front, KEY ON/OFF, detach rear, check PMD OFF for 30s.
    - Step 11: KEY OFF, wait PMD OFF, wait network sleep, attach rear, check PMD OFF for 30s.
    - Step 13: Attach rear/front, KEY ON/OFF, wait PMD OFF, check Set_PMD OFF.
    - Step 14: KEY ON/OFF, wait PMD OFF, wait network sleep, detach front.
    - Step 15: Attach rear/front, KEY ON/OFF, wait PMD OFF, wait network sleep,
      check Set_PMD OFF.
    - Step 16: Attach rear/front, KEY ON/OFF, wait PMD OFF, wait network sleep,
      detach rear.
    - Step 17: Attach rear/front, KEY ON/OFF, wait PMD OFF, wait network sleep.
    - Step 18: KEY ON/OFF, wait PMD OFF, detach front, wait PEV Recording,
      wait 12s, check RecSta_PMD=0x2 radar-only, call Check_RecSta_PMD_Recording
      for log, check PEV_Recorded=0x2, attach front.
    - Step 19: Attach rear/front, KEY ON/OFF, wait PMD OFF, wait network sleep.
    - Step 20: KEY ON/OFF, wait PMD OFF, detach rear, wait PEV Recording,
      wait 12s, check RecSta_PMD=0x2 radar-only, call Check_RecSta_PMD_Recording
      for log, check PEV_Recorded=0x2, attach rear.

  NOTE:
    - Sleep waits use WaitForNetworkSleep(480), maximum 8 minutes.
    - Signal waits use a few minutes maximum.
    - PMD wait steps use the shared WaitFor_RecSta_PMD_OFF() helper.
    - PMD OFF checks use shared Check_RecSta_PMD_OFF() after a 30s monitor.
    - Set_Detach_Front in the request maps to existing helper Set_Detach_Font().
    - Each step waits 5 seconds before the final screenshot capture.
*/

variables
{
  char failReason[512];

  long max_signal_wait_ms = 240000;
  int max_signal_wait_s = 240;
  int max_network_sleep_s = 480;
  long check_30s_ms = 30000;

  int step1_passed = 0;
  int step2_passed = 0;
  int step3_passed = 0;
  int step5_passed = 0;
  int step7_passed = 0;
  int step8_passed = 0;
  int step10_passed = 0;
  int step11_passed = 0;
  int step13_passed = 0;
  int step14_passed = 0;
  int step15_passed = 0;
  int step16_passed = 0;
  int step17_passed = 0;
  int step18_passed = 0;
  int step19_passed = 0;
  int step20_passed = 0;
}

int OWP_025_CheckPMDOffFor30s(char stepName[])
{
  int monitor_ok;
  int check_ok;

  write("[%s] Monitor BLTN_CAM_RecSta_PMD OFF for 30 seconds", stepName);
  monitor_ok = Check_Monitor_RecSta_Signal_AlwaysOFF(7, check_30s_ms);

  write("[%s] Final Check_RecSta_PMD_OFF", stepName);
  check_ok = Check_RecSta_PMD_OFF();

  if (monitor_ok == 1 && check_ok == 1)
  {
    write(">>> [%s] PASS: PMD stayed OFF for 30 seconds <<<", stepName);
    return 1;
  }

  write(">>> [%s] FAIL: PMD did not stay OFF for 30 seconds <<<", stepName);
  return 0;
}

int OWP_025_CheckPMDRadarOnly()
{
  byte val;
  val = $BLTN_CAM_RecSta_PMD;

  write("  BLTN_CAM_RecSta_PMD = 0x%X", val);
  if (val == 0x2)
  {
    write(">>> PASS: BLTN_CAM_RecSta_PMD = 0x2 (Radar only operating) <<<");
    return 1;
  }

  write(">>> FAIL: BLTN_CAM_RecSta_PMD = 0x%X, expected 0x2 <<<", val);
  return 0;
}

int OWP_025_CheckPEVRecordedParkEvent()
{
  byte val;
  val = $BLTN_CAM_PEV_Recorded;

  write("  BLTN_CAM_PEV_Recorded = 0x%X", val);
  if (val == 0x2)
  {
    write(">>> PASS: BLTN_CAM_PEV_Recorded = 0x2 (Park Event Recorded) <<<");
    return 1;
  }

  write(">>> FAIL: BLTN_CAM_PEV_Recorded = 0x%X, expected 0x2 <<<", val);
  return 0;
}

void OWP_025_Capture(char stepName[])
{
  write("[%s] Wait 5 seconds before screenshot", stepName);
  testWaitForTimeout(5000);
  CaptureGraphics("OWP", "SMK_TrmnlCtrlGrpStaBDC;BLTN_CAM_Set_PMD;BLTN_CAM_RecSta_PMD;BLTN_CAM_RecSta_PEV;BLTN_CAM_PEV_Recorded;BLTN_CAM_PMD_Count;BLTN_CAM_PEV_Count;BLTN_CAM_State");
}

testcase OWP_025_Init()
{
  Send_Value_To_COM(22500);
  write("========================================");
  write("=== START TEST OWP_025 - 2.5 ===");
  write("========================================");
  testStep("Notification", "Start test OWP_025 - 2.5");
  Send_Value_To_COM(44);
}

testcase OWP_025_1()
{
  int pmd_set_ok;
  int pmd_off_wait_ok;
  int pmd_off_check_ok;

  Send_Value_To_COM(22501);
  SetTestStep("Buoc 1 - OWP_025");
  StartTestTimer();

  write("");
  write("=================================================================");
  write("=== STEP 1: Setup PMD, detach front, PMD stays OFF             ===");
  write("=================================================================");
  testStep("Step1", "Attach rear/front -> KEY ON -> SMK IGN -> resets -> Turn_ON_PMD -> KEY OFF -> PMD OFF -> detach front -> PMD OFF 30s");

  write("[1.1] Set_Attach_Rear");
  Set_Attach_Rear();

  write("[1.2] Set_Attach_Font");
  Set_Attach_Font();

  write("[1.3] KEY ON");
  KEY_ON();
  testWaitForTimeout(5000);

  write("[1.4] Set_SMK_IGN");
  Set_SMK_IGN();
  testWaitForTimeout(3000);

  write("[1.5] Click_USM_Reset");
  Click_USM_Reset();
  testWaitForTimeout(3000);

  write("[1.6] Click_Rec_Reset");
  Click_Rec_Reset();
  testWaitForTimeout(5000);

  write("[1.7] Turn_ON_PMD");
  Turn_ON_PMD();
  testWaitForTimeout(3000);
  pmd_set_ok = Check_Set_PMD_ON();

  write("[1.8] KEY OFF before PMD wait");
  KEY_OFF();
  testWaitForTimeout(5000);

  write("[1.9] WaitFor_RecSta_PMD_OFF max 4 minutes");
  pmd_off_wait_ok = WaitFor_RecSta_PMD_OFF(max_signal_wait_ms);

  write("[1.10] Set_Detach_Font");
  Set_Detach_Font();

  write("[1.11] Check_RecSta_PMD_OFF for 30 seconds");
  pmd_off_check_ok = OWP_025_CheckPMDOffFor30s("Step1");

  OWP_025_Capture("Step1");

  if (pmd_set_ok == 1 && pmd_off_wait_ok == 1 && pmd_off_check_ok == 1)
  {
    step1_passed = 1;
    testStepPass("Step1", "Step 1 PASS");
  }
  else
  {
    step1_passed = 0;
    snprintf(failReason, elcount(failReason),
             "Step 1 FAIL: pmd_set=%d, pmd_off_wait=%d, pmd_off_30s=%d, Set_PMD=0x%X, RecSta_PMD=0x%X.",
             pmd_set_ok, pmd_off_wait_ok, pmd_off_check_ok,
             $BLTN_CAM_Set_PMD, $BLTN_CAM_RecSta_PMD);
    Log_Error_Details();
    testStepFail("Step1", failReason);
  }

  write("=== FINISH STEP 1 ===");
  StopTestTimer();
  Send_Value_To_COM(44);
}

testcase OWP_025_2()
{
  int pmd_off_wait_ok;
  int pmd_off_check_ok;

  Send_Value_To_COM(22502);
  SetTestStep("Buoc 2 - OWP_025");
  StartTestTimer();

  write("");
  write("=================================================================");
  write("=== STEP 2: Rear detach after PMD OFF                          ===");
  write("=================================================================");
  testStep("Step2", "Attach rear/front -> KEY ON/OFF -> PMD OFF -> detach rear -> PMD OFF 30s");

  write("[2.1] Set_Attach_Rear");
  Set_Attach_Rear();

  write("[2.2] Set_Attach_Font");
  Set_Attach_Font();

  write("[2.3] KEY ON");
  KEY_ON();
  testWaitForTimeout(5000);

  write("[2.4] KEY OFF");
  KEY_OFF();
  testWaitForTimeout(5000);

  write("[2.5] WaitFor_RecSta_PMD_OFF max 4 minutes");
  pmd_off_wait_ok = WaitFor_RecSta_PMD_OFF(max_signal_wait_ms);

  write("[2.6] Set_Detach_Rear");
  Set_Detach_Rear();

  write("[2.7] Check_RecSta_PMD_OFF for 30 seconds");
  pmd_off_check_ok = OWP_025_CheckPMDOffFor30s("Step2");

  OWP_025_Capture("Step2");

  if (pmd_off_wait_ok == 1 && pmd_off_check_ok == 1)
  {
    step2_passed = 1;
    testStepPass("Step2", "Step 2 PASS");
  }
  else
  {
    step2_passed = 0;
    snprintf(failReason, elcount(failReason),
             "Step 2 FAIL: pmd_off_wait=%d, pmd_off_30s=%d, RecSta_PMD=0x%X.",
             pmd_off_wait_ok, pmd_off_check_ok, $BLTN_CAM_RecSta_PMD);
    Log_Error_Details();
    testStepFail("Step2", failReason);
  }

  write("=== FINISH STEP 2 ===");
  StopTestTimer();
  Send_Value_To_COM(44);
}

testcase OWP_025_3()
{
  int pmd_off_wait_ok;
  int sleep_ok;
  int pmd_off_check_ok;

  Send_Value_To_COM(22503);
  SetTestStep("Buoc 3 - OWP_025");
  StartTestTimer();

  write("");
  write("=================================================================");
  write("=== STEP 3: Sleep then front detach, PMD stays OFF             ===");
  write("=================================================================");
  testStep("Step3", "Attach rear/front -> KEY ON/OFF -> PMD OFF -> NetworkSleep -> detach front -> PMD OFF 30s");

  write("[3.1] Set_Attach_Rear");
  Set_Attach_Rear();

  write("[3.2] Set_Attach_Font");
  Set_Attach_Font();

  write("[3.3] KEY ON");
  KEY_ON();
  testWaitForTimeout(5000);

  write("[3.4] KEY OFF");
  KEY_OFF();
  testWaitForTimeout(5000);

  write("[3.5] WaitFor_RecSta_PMD_OFF max 4 minutes");
  pmd_off_wait_ok = WaitFor_RecSta_PMD_OFF(max_signal_wait_ms);

  write("[3.6] WaitForNetworkSleep max 8 minutes");
  sleep_ok = WaitForNetworkSleep(max_network_sleep_s);

  write("[3.7] Set_Detach_Font");
  Set_Detach_Font();

  write("[3.8] Check_RecSta_PMD_OFF for 30 seconds");
  pmd_off_check_ok = OWP_025_CheckPMDOffFor30s("Step3");

  OWP_025_Capture("Step3");

  if (pmd_off_wait_ok == 1 && sleep_ok == 1 && pmd_off_check_ok == 1)
  {
    step3_passed = 1;
    testStepPass("Step3", "Step 3 PASS");
  }
  else
  {
    step3_passed = 0;
    snprintf(failReason, elcount(failReason),
             "Step 3 FAIL: pmd_off_wait=%d, sleep=%d, pmd_off_30s=%d, RecSta_PMD=0x%X.",
             pmd_off_wait_ok, sleep_ok, pmd_off_check_ok, $BLTN_CAM_RecSta_PMD);
    Log_Error_Details();
    testStepFail("Step3", failReason);
  }

  write("=== FINISH STEP 3 ===");
  StopTestTimer();
  Send_Value_To_COM(44);
}

testcase OWP_025_5()
{
  int pmd_off_wait_ok;
  int sleep_ok;
  int pmd_off_check_ok;

  Send_Value_To_COM(22505);
  SetTestStep("Buoc 5 - OWP_025");
  StartTestTimer();

  write("");
  write("=================================================================");
  write("=== STEP 5: Sleep then rear detach, PMD stays OFF              ===");
  write("=================================================================");
  testStep("Step5", "Attach rear/front -> KEY ON/OFF -> PMD OFF -> NetworkSleep -> detach rear -> PMD OFF 30s");

  write("[5.1] Set_Attach_Rear");
  Set_Attach_Rear();

  write("[5.2] Set_Attach_Font");
  Set_Attach_Font();

  write("[5.3] KEY ON");
  KEY_ON();
  testWaitForTimeout(5000);

  write("[5.4] KEY OFF");
  KEY_OFF();
  testWaitForTimeout(5000);

  write("[5.5] WaitFor_RecSta_PMD_OFF max 4 minutes");
  pmd_off_wait_ok = WaitFor_RecSta_PMD_OFF(max_signal_wait_ms);

  write("[5.6] WaitForNetworkSleep max 8 minutes");
  sleep_ok = WaitForNetworkSleep(max_network_sleep_s);

  write("[5.7] Set_Detach_Rear");
  Set_Detach_Rear();

  write("[5.8] Check_RecSta_PMD_OFF for 30 seconds");
  pmd_off_check_ok = OWP_025_CheckPMDOffFor30s("Step5");

  OWP_025_Capture("Step5");

  if (pmd_off_wait_ok == 1 && sleep_ok == 1 && pmd_off_check_ok == 1)
  {
    step5_passed = 1;
    testStepPass("Step5", "Step 5 PASS");
  }
  else
  {
    step5_passed = 0;
    snprintf(failReason, elcount(failReason),
             "Step 5 FAIL: pmd_off_wait=%d, sleep=%d, pmd_off_30s=%d, RecSta_PMD=0x%X.",
             pmd_off_wait_ok, sleep_ok, pmd_off_check_ok, $BLTN_CAM_RecSta_PMD);
    Log_Error_Details();
    testStepFail("Step5", failReason);
  }

  write("=== FINISH STEP 5 ===");
  StopTestTimer();
  Send_Value_To_COM(44);
}

testcase OWP_025_7()
{
  int pmd_off_check_ok;

  Send_Value_To_COM(22507);
  SetTestStep("Buoc 7 - OWP_025");
  StartTestTimer();

  write("");
  write("=================================================================");
  write("=== STEP 7: Front detach immediately after KEY OFF             ===");
  write("=================================================================");
  testStep("Step7", "Attach rear/front -> KEY ON/OFF -> detach front -> PMD OFF 30s");

  write("[7.1] Set_Attach_Rear");
  Set_Attach_Rear();

  write("[7.2] Set_Attach_Font");
  Set_Attach_Font();

  write("[7.3] KEY ON");
  KEY_ON();
  testWaitForTimeout(5000);

  write("[7.4] KEY OFF");
  KEY_OFF();
  testWaitForTimeout(5000);

  write("[7.5] Set_Detach_Font");
  Set_Detach_Font();

  write("[7.6] Check_RecSta_PMD_OFF for 30 seconds");
  pmd_off_check_ok = OWP_025_CheckPMDOffFor30s("Step7");

  OWP_025_Capture("Step7");

  if (pmd_off_check_ok == 1)
  {
    step7_passed = 1;
    testStepPass("Step7", "Step 7 PASS");
  }
  else
  {
    step7_passed = 0;
    snprintf(failReason, elcount(failReason),
             "Step 7 FAIL: pmd_off_30s=%d, RecSta_PMD=0x%X.",
             pmd_off_check_ok, $BLTN_CAM_RecSta_PMD);
    Log_Error_Details();
    testStepFail("Step7", failReason);
  }

  write("=== FINISH STEP 7 ===");
  StopTestTimer();
  Send_Value_To_COM(44);
}

testcase OWP_025_8()
{
  int pmd_off_wait_ok;
  int sleep_ok;
  int pmd_off_check_ok;

  Send_Value_To_COM(22508);
  SetTestStep("Buoc 8 - OWP_025");
  StartTestTimer();

  write("");
  write("=================================================================");
  write("=== STEP 8: Attach front after sleep, PMD stays OFF            ===");
  write("=================================================================");
  testStep("Step8", "KEY OFF -> PMD OFF -> NetworkSleep -> attach front -> PMD OFF 30s");

  write("[8.1] KEY OFF before PMD wait");
  KEY_OFF();
  testWaitForTimeout(5000);

  write("[8.2] WaitFor_RecSta_PMD_OFF max 4 minutes");
  pmd_off_wait_ok = WaitFor_RecSta_PMD_OFF(max_signal_wait_ms);

  write("[8.3] WaitForNetworkSleep max 8 minutes");
  sleep_ok = WaitForNetworkSleep(max_network_sleep_s);

  write("[8.4] Set_Attach_Font");
  Set_Attach_Font();

  write("[8.5] Check_RecSta_PMD_OFF for 30 seconds");
  pmd_off_check_ok = OWP_025_CheckPMDOffFor30s("Step8");

  OWP_025_Capture("Step8");

  if (pmd_off_wait_ok == 1 && sleep_ok == 1 && pmd_off_check_ok == 1)
  {
    step8_passed = 1;
    testStepPass("Step8", "Step 8 PASS");
  }
  else
  {
    step8_passed = 0;
    snprintf(failReason, elcount(failReason),
             "Step 8 FAIL: pmd_off_wait=%d, sleep=%d, pmd_off_30s=%d, RecSta_PMD=0x%X.",
             pmd_off_wait_ok, sleep_ok, pmd_off_check_ok, $BLTN_CAM_RecSta_PMD);
    Log_Error_Details();
    testStepFail("Step8", failReason);
  }

  write("=== FINISH STEP 8 ===");
  StopTestTimer();
  Send_Value_To_COM(44);
}

testcase OWP_025_10()
{
  int pmd_off_check_ok;

  Send_Value_To_COM(22510);
  SetTestStep("Buoc 10 - OWP_025");
  StartTestTimer();

  write("");
  write("=================================================================");
  write("=== STEP 10: Rear detach immediately after KEY OFF             ===");
  write("=================================================================");
  testStep("Step10", "Attach rear/front -> KEY ON/OFF -> detach rear -> PMD OFF 30s");

  write("[10.1] Set_Attach_Rear");
  Set_Attach_Rear();

  write("[10.2] Set_Attach_Font");
  Set_Attach_Font();

  write("[10.3] KEY ON");
  KEY_ON();
  testWaitForTimeout(5000);

  write("[10.4] KEY OFF");
  KEY_OFF();
  testWaitForTimeout(5000);

  write("[10.5] Set_Detach_Rear");
  Set_Detach_Rear();

  write("[10.6] Check_RecSta_PMD_OFF for 30 seconds");
  pmd_off_check_ok = OWP_025_CheckPMDOffFor30s("Step10");

  OWP_025_Capture("Step10");

  if (pmd_off_check_ok == 1)
  {
    step10_passed = 1;
    testStepPass("Step10", "Step 10 PASS");
  }
  else
  {
    step10_passed = 0;
    snprintf(failReason, elcount(failReason),
             "Step 10 FAIL: pmd_off_30s=%d, RecSta_PMD=0x%X.",
             pmd_off_check_ok, $BLTN_CAM_RecSta_PMD);
    Log_Error_Details();
    testStepFail("Step10", failReason);
  }

  write("=== FINISH STEP 10 ===");
  StopTestTimer();
  Send_Value_To_COM(44);
}

testcase OWP_025_11()
{
  int pmd_off_wait_ok;
  int sleep_ok;
  int pmd_off_check_ok;

  Send_Value_To_COM(22511);
  SetTestStep("Buoc 11 - OWP_025");
  StartTestTimer();

  write("");
  write("=================================================================");
  write("=== STEP 11: Attach rear after sleep, PMD stays OFF            ===");
  write("=================================================================");
  testStep("Step11", "KEY OFF -> PMD OFF -> NetworkSleep -> attach rear -> PMD OFF 30s");

  write("[11.1] KEY OFF before PMD wait");
  KEY_OFF();
  testWaitForTimeout(5000);

  write("[11.2] WaitFor_RecSta_PMD_OFF max 4 minutes");
  pmd_off_wait_ok = WaitFor_RecSta_PMD_OFF(max_signal_wait_ms);

  write("[11.3] WaitForNetworkSleep max 8 minutes");
  sleep_ok = WaitForNetworkSleep(max_network_sleep_s);

  write("[11.4] Set_Attach_Rear");
  Set_Attach_Rear();

  write("[11.5] Check_RecSta_PMD_OFF for 30 seconds");
  pmd_off_check_ok = OWP_025_CheckPMDOffFor30s("Step11");

  OWP_025_Capture("Step11");

  if (pmd_off_wait_ok == 1 && sleep_ok == 1 && pmd_off_check_ok == 1)
  {
    step11_passed = 1;
    testStepPass("Step11", "Step 11 PASS");
  }
  else
  {
    step11_passed = 0;
    snprintf(failReason, elcount(failReason),
             "Step 11 FAIL: pmd_off_wait=%d, sleep=%d, pmd_off_30s=%d, RecSta_PMD=0x%X.",
             pmd_off_wait_ok, sleep_ok, pmd_off_check_ok, $BLTN_CAM_RecSta_PMD);
    Log_Error_Details();
    testStepFail("Step11", failReason);
  }

  write("=== FINISH STEP 11 ===");
  StopTestTimer();
  Send_Value_To_COM(44);
}

testcase OWP_025_13()
{
  int pmd_off_wait_ok;
  int pmd_set_off_ok;

  Send_Value_To_COM(22513);
  SetTestStep("Buoc 13 - OWP_025");
  StartTestTimer();

  write("");
  write("=================================================================");
  write("=== STEP 13: Check Set_PMD OFF after PMD OFF                   ===");
  write("=================================================================");
  testStep("Step13", "Attach rear/front -> KEY ON/OFF -> PMD OFF -> Check_Set_PMD_OFF");

  write("[13.1] Set_Attach_Rear");
  Set_Attach_Rear();

  write("[13.2] Set_Attach_Font");
  Set_Attach_Font();

  write("[13.3] KEY ON");
  KEY_ON();
  testWaitForTimeout(5000);

  write("[13.4] KEY OFF");
  KEY_OFF();
  testWaitForTimeout(5000);

  write("[13.5] WaitFor_RecSta_PMD_OFF max 4 minutes");
  pmd_off_wait_ok = WaitFor_RecSta_PMD_OFF(max_signal_wait_ms);

  write("[13.6] Check_Set_PMD_OFF");
  pmd_set_off_ok = Check_Set_PMD_OFF();

  OWP_025_Capture("Step13");

  if (pmd_off_wait_ok == 1 && pmd_set_off_ok == 1)
  {
    step13_passed = 1;
    testStepPass("Step13", "Step 13 PASS");
  }
  else
  {
    step13_passed = 0;
    snprintf(failReason, elcount(failReason),
             "Step 13 FAIL: pmd_off_wait=%d, set_pmd_off=%d, Set_PMD=0x%X, RecSta_PMD=0x%X.",
             pmd_off_wait_ok, pmd_set_off_ok, $BLTN_CAM_Set_PMD, $BLTN_CAM_RecSta_PMD);
    Log_Error_Details();
    testStepFail("Step13", failReason);
  }

  write("=== FINISH STEP 13 ===");
  StopTestTimer();
  Send_Value_To_COM(44);
}

testcase OWP_025_14()
{
  int pmd_off_wait_ok;
  int sleep_ok;

  Send_Value_To_COM(22514);
  SetTestStep("Buoc 14 - OWP_025");
  StartTestTimer();

  write("");
  write("=================================================================");
  write("=== STEP 14: Sleep then detach front                           ===");
  write("=================================================================");
  testStep("Step14", "KEY ON/OFF -> PMD OFF -> NetworkSleep -> detach front");

  write("[14.1] KEY ON");
  KEY_ON();
  testWaitForTimeout(5000);

  write("[14.2] KEY OFF");
  KEY_OFF();
  testWaitForTimeout(5000);

  write("[14.3] WaitFor_RecSta_PMD_OFF max 4 minutes");
  pmd_off_wait_ok = WaitFor_RecSta_PMD_OFF(max_signal_wait_ms);

  write("[14.4] WaitForNetworkSleep max 8 minutes");
  sleep_ok = WaitForNetworkSleep(max_network_sleep_s);

  write("[14.5] Set_Detach_Font");
  Set_Detach_Font();

  OWP_025_Capture("Step14");

  if (pmd_off_wait_ok == 1 && sleep_ok == 1)
  {
    step14_passed = 1;
    testStepPass("Step14", "Step 14 PASS");
  }
  else
  {
    step14_passed = 0;
    snprintf(failReason, elcount(failReason),
             "Step 14 FAIL: pmd_off_wait=%d, sleep=%d, RecSta_PMD=0x%X.",
             pmd_off_wait_ok, sleep_ok, $BLTN_CAM_RecSta_PMD);
    Log_Error_Details();
    testStepFail("Step14", failReason);
  }

  write("=== FINISH STEP 14 ===");
  StopTestTimer();
  Send_Value_To_COM(44);
}

testcase OWP_025_15()
{
  int pmd_off_wait_ok;
  int sleep_ok;
  int pmd_set_off_ok;

  Send_Value_To_COM(22515);
  SetTestStep("Buoc 15 - OWP_025");
  StartTestTimer();

  write("");
  write("=================================================================");
  write("=== STEP 15: Check Set_PMD OFF after sleep                     ===");
  write("=================================================================");
  testStep("Step15", "Attach rear/front -> KEY ON/OFF -> PMD OFF -> NetworkSleep -> Check_Set_PMD_OFF");

  write("[15.1] Set_Attach_Rear");
  Set_Attach_Rear();

  write("[15.2] Set_Attach_Font");
  Set_Attach_Font();

  write("[15.3] KEY ON");
  KEY_ON();
  testWaitForTimeout(5000);

  write("[15.4] KEY OFF");
  KEY_OFF();
  testWaitForTimeout(5000);

  write("[15.5] WaitFor_RecSta_PMD_OFF max 4 minutes");
  pmd_off_wait_ok = WaitFor_RecSta_PMD_OFF(max_signal_wait_ms);

  write("[15.6] WaitForNetworkSleep max 8 minutes");
  sleep_ok = WaitForNetworkSleep(max_network_sleep_s);

  write("[15.7] Check_Set_PMD_OFF");
  pmd_set_off_ok = Check_Set_PMD_OFF();

  OWP_025_Capture("Step15");

  if (pmd_off_wait_ok == 1 && sleep_ok == 1 && pmd_set_off_ok == 1)
  {
    step15_passed = 1;
    testStepPass("Step15", "Step 15 PASS");
  }
  else
  {
    step15_passed = 0;
    snprintf(failReason, elcount(failReason),
             "Step 15 FAIL: pmd_off_wait=%d, sleep=%d, set_pmd_off=%d, Set_PMD=0x%X, RecSta_PMD=0x%X.",
             pmd_off_wait_ok, sleep_ok, pmd_set_off_ok,
             $BLTN_CAM_Set_PMD, $BLTN_CAM_RecSta_PMD);
    Log_Error_Details();
    testStepFail("Step15", failReason);
  }

  write("=== FINISH STEP 15 ===");
  StopTestTimer();
  Send_Value_To_COM(44);
}

testcase OWP_025_16()
{
  int pmd_off_wait_ok;
  int sleep_ok;

  Send_Value_To_COM(22516);
  SetTestStep("Buoc 16 - OWP_025");
  StartTestTimer();

  write("");
  write("=================================================================");
  write("=== STEP 16: Sleep then detach rear                            ===");
  write("=================================================================");
  testStep("Step16", "Attach rear/front -> KEY ON/OFF -> PMD OFF -> NetworkSleep -> detach rear");

  write("[16.1] Set_Attach_Rear");
  Set_Attach_Rear();

  write("[16.2] Set_Attach_Font");
  Set_Attach_Font();

  write("[16.3] KEY ON");
  KEY_ON();
  testWaitForTimeout(5000);

  write("[16.4] KEY OFF");
  KEY_OFF();
  testWaitForTimeout(5000);

  write("[16.5] WaitFor_RecSta_PMD_OFF max 4 minutes");
  pmd_off_wait_ok = WaitFor_RecSta_PMD_OFF(max_signal_wait_ms);

  write("[16.6] WaitForNetworkSleep max 8 minutes");
  sleep_ok = WaitForNetworkSleep(max_network_sleep_s);

  write("[16.7] Set_Detach_Rear");
  Set_Detach_Rear();

  OWP_025_Capture("Step16");

  if (pmd_off_wait_ok == 1 && sleep_ok == 1)
  {
    step16_passed = 1;
    testStepPass("Step16", "Step 16 PASS");
  }
  else
  {
    step16_passed = 0;
    snprintf(failReason, elcount(failReason),
             "Step 16 FAIL: pmd_off_wait=%d, sleep=%d, RecSta_PMD=0x%X.",
             pmd_off_wait_ok, sleep_ok, $BLTN_CAM_RecSta_PMD);
    Log_Error_Details();
    testStepFail("Step16", failReason);
  }

  write("=== FINISH STEP 16 ===");
  StopTestTimer();
  Send_Value_To_COM(44);
}

testcase OWP_025_17()
{
  int pmd_off_wait_ok;
  int sleep_ok;

  Send_Value_To_COM(22517);
  SetTestStep("Buoc 17 - OWP_025");
  StartTestTimer();

  write("");
  write("=================================================================");
  write("=== STEP 17: PMD OFF and network sleep                         ===");
  write("=================================================================");
  testStep("Step17", "Attach rear/front -> KEY ON/OFF -> PMD OFF -> NetworkSleep");

  write("[17.1] Set_Attach_Rear");
  Set_Attach_Rear();

  write("[17.2] Set_Attach_Font");
  Set_Attach_Font();

  write("[17.3] KEY ON");
  KEY_ON();
  testWaitForTimeout(5000);

  write("[17.4] KEY OFF");
  KEY_OFF();
  testWaitForTimeout(5000);

  write("[17.5] WaitFor_RecSta_PMD_OFF max 4 minutes");
  pmd_off_wait_ok = WaitFor_RecSta_PMD_OFF(max_signal_wait_ms);

  write("[17.6] WaitForNetworkSleep max 8 minutes");
  sleep_ok = WaitForNetworkSleep(max_network_sleep_s);

  OWP_025_Capture("Step17");

  if (pmd_off_wait_ok == 1 && sleep_ok == 1)
  {
    step17_passed = 1;
    testStepPass("Step17", "Step 17 PASS");
  }
  else
  {
    step17_passed = 0;
    snprintf(failReason, elcount(failReason),
             "Step 17 FAIL: pmd_off_wait=%d, sleep=%d, RecSta_PMD=0x%X.",
             pmd_off_wait_ok, sleep_ok, $BLTN_CAM_RecSta_PMD);
    Log_Error_Details();
    testStepFail("Step17", failReason);
  }

  write("=== FINISH STEP 17 ===");
  StopTestTimer();
  Send_Value_To_COM(44);
}

testcase OWP_025_18()
{
  int pmd_off_wait_ok;
  int pev_ok;
  int pmd_radar_ok;
  int pmd_recording_log_ok;
  int pev_recorded_ok;

  Send_Value_To_COM(22518);
  SetTestStep("Buoc 18 - OWP_025");
  StartTestTimer();

  write("");
  write("=================================================================");
  write("=== STEP 18: Front detach, PEV, PMD radar-only evidence        ===");
  write("=================================================================");
  testStep("Step18", "KEY ON/OFF -> PMD OFF -> detach front -> PEV Recording -> wait 12s -> RecSta_PMD=0x2 -> PEV_Recorded=0x2 -> attach front");

  write("[18.1] KEY ON");
  KEY_ON();
  testWaitForTimeout(5000);

  write("[18.2] KEY OFF");
  KEY_OFF();
  testWaitForTimeout(5000);

  write("[18.3] WaitFor_RecSta_PMD_OFF max 4 minutes");
  pmd_off_wait_ok = WaitFor_RecSta_PMD_OFF(max_signal_wait_ms);

  write("[18.4] Set_Detach_Font");
  Set_Detach_Font();

  write("[18.5] WaitFor_RecSta_PEV_Recording max 4 minutes");
  pev_ok = WaitFor_RecSta_PEV_Recording(max_signal_wait_s);

  write("[18.6] Wait 12 seconds");
  testWaitForTimeout(12000);

  write("[18.7] Check BLTN_CAM_RecSta_PMD = 0x2 (Radar only operating)");
  pmd_radar_ok = OWP_025_CheckPMDRadarOnly();

  write("[18.8] Check_RecSta_PMD_Recording for log");
  pmd_recording_log_ok = Check_RecSta_PMD_Recording();

  write("[18.9] Check BLTN_CAM_PEV_Recorded = 0x2 (Park Event Recorded)");
  pev_recorded_ok = OWP_025_CheckPEVRecordedParkEvent();

  write("[18.10] Set_Attach_Font");
  Set_Attach_Font();

  OWP_025_Capture("Step18");

  if (pmd_off_wait_ok == 1 && pev_ok == 1 && pmd_radar_ok == 1 && pev_recorded_ok == 1)
  {
    step18_passed = 1;
    testStepPass("Step18", "Step 18 PASS");
  }
  else
  {
    step18_passed = 0;
    snprintf(failReason, elcount(failReason),
             "Step 18 FAIL: pmd_off_wait=%d, pev=%d, radar_only=%d, pmd_recording_log=%d, pev_recorded=%d, RecSta_PMD=0x%X, PEV_Recorded=0x%X.",
             pmd_off_wait_ok, pev_ok, pmd_radar_ok, pmd_recording_log_ok, pev_recorded_ok,
             $BLTN_CAM_RecSta_PMD, $BLTN_CAM_PEV_Recorded);
    Log_Error_Details();
    testStepFail("Step18", failReason);
  }

  write("=== FINISH STEP 18 ===");
  StopTestTimer();
  Send_Value_To_COM(44);
}

testcase OWP_025_19()
{
  int pmd_off_wait_ok;
  int sleep_ok;

  Send_Value_To_COM(22519);
  SetTestStep("Buoc 19 - OWP_025");
  StartTestTimer();

  write("");
  write("=================================================================");
  write("=== STEP 19: PMD OFF and network sleep                         ===");
  write("=================================================================");
  testStep("Step19", "Attach rear/front -> KEY ON/OFF -> PMD OFF -> NetworkSleep");

  write("[19.1] Set_Attach_Rear");
  Set_Attach_Rear();

  write("[19.2] Set_Attach_Font");
  Set_Attach_Font();

  write("[19.3] KEY ON");
  KEY_ON();
  testWaitForTimeout(5000);

  write("[19.4] KEY OFF");
  KEY_OFF();
  testWaitForTimeout(5000);

  write("[19.5] WaitFor_RecSta_PMD_OFF max 4 minutes");
  pmd_off_wait_ok = WaitFor_RecSta_PMD_OFF(max_signal_wait_ms);

  write("[19.6] WaitForNetworkSleep max 8 minutes");
  sleep_ok = WaitForNetworkSleep(max_network_sleep_s);

  OWP_025_Capture("Step19");

  if (pmd_off_wait_ok == 1 && sleep_ok == 1)
  {
    step19_passed = 1;
    testStepPass("Step19", "Step 19 PASS");
  }
  else
  {
    step19_passed = 0;
    snprintf(failReason, elcount(failReason),
             "Step 19 FAIL: pmd_off_wait=%d, sleep=%d, RecSta_PMD=0x%X.",
             pmd_off_wait_ok, sleep_ok, $BLTN_CAM_RecSta_PMD);
    Log_Error_Details();
    testStepFail("Step19", failReason);
  }

  write("=== FINISH STEP 19 ===");
  StopTestTimer();
  Send_Value_To_COM(44);
}

testcase OWP_025_20()
{
  int pmd_off_wait_ok;
  int pev_ok;
  int pmd_radar_ok;
  int pmd_recording_log_ok;
  int pev_recorded_ok;

  Send_Value_To_COM(22520);
  SetTestStep("Buoc 20 - OWP_025");
  StartTestTimer();

  write("");
  write("=================================================================");
  write("=== STEP 20: Rear detach, PEV, PMD radar-only evidence         ===");
  write("=================================================================");
  testStep("Step20", "KEY ON/OFF -> PMD OFF -> detach rear -> PEV Recording -> wait 12s -> RecSta_PMD=0x2 -> PEV_Recorded=0x2 -> attach rear");

  write("[20.1] KEY ON");
  KEY_ON();
  testWaitForTimeout(5000);

  write("[20.2] KEY OFF");
  KEY_OFF();
  testWaitForTimeout(5000);

  write("[20.3] WaitFor_RecSta_PMD_OFF max 4 minutes");
  pmd_off_wait_ok = WaitFor_RecSta_PMD_OFF(max_signal_wait_ms);

  write("[20.4] Set_Detach_Rear");
  Set_Detach_Rear();

  write("[20.5] WaitFor_RecSta_PEV_Recording max 4 minutes");
  pev_ok = WaitFor_RecSta_PEV_Recording(max_signal_wait_s);

  write("[20.6] Wait 12 seconds");
  testWaitForTimeout(12000);

  write("[20.7] Check BLTN_CAM_RecSta_PMD = 0x2 (Radar only operating)");
  pmd_radar_ok = OWP_025_CheckPMDRadarOnly();

  write("[20.8] Check_RecSta_PMD_Recording for log");
  pmd_recording_log_ok = Check_RecSta_PMD_Recording();

  write("[20.9] Check BLTN_CAM_PEV_Recorded = 0x2 (Park Event Recorded)");
  pev_recorded_ok = OWP_025_CheckPEVRecordedParkEvent();

  write("[20.10] Set_Attach_Rear");
  Set_Attach_Rear();

  OWP_025_Capture("Step20");

  if (pmd_off_wait_ok == 1 && pev_ok == 1 && pmd_radar_ok == 1 && pev_recorded_ok == 1)
  {
    step20_passed = 1;
    testStepPass("Step20", "Step 20 PASS");
  }
  else
  {
    step20_passed = 0;
    snprintf(failReason, elcount(failReason),
             "Step 20 FAIL: pmd_off_wait=%d, pev=%d, radar_only=%d, pmd_recording_log=%d, pev_recorded=%d, RecSta_PMD=0x%X, PEV_Recorded=0x%X.",
             pmd_off_wait_ok, pev_ok, pmd_radar_ok, pmd_recording_log_ok, pev_recorded_ok,
             $BLTN_CAM_RecSta_PMD, $BLTN_CAM_PEV_Recorded);
    Log_Error_Details();
    testStepFail("Step20", failReason);
  }

  write("=== FINISH STEP 20 ===");
  StopTestTimer();
  Send_Value_To_COM(44);
}

void MainTest()
{
  testReportFileName("TestReports\\OWP_025 - 2.5 generation_report");

  OWP_025_Init();
  OWP_025_1();
  OWP_025_2();
  OWP_025_3();
  OWP_025_5();
  OWP_025_7();
  OWP_025_8();
  OWP_025_10();
  OWP_025_11();
  OWP_025_13();
  OWP_025_14();
  OWP_025_15();
  OWP_025_16();
  OWP_025_17();
  OWP_025_18();
  OWP_025_19();
  OWP_025_20();
}
