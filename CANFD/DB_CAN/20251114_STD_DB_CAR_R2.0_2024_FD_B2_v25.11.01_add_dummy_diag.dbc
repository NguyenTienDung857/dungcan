VERSION ""

NS_ :

BS_:

BU_: SHVU_CCS_FD ARS_FD WPC_FD WPC2_FD SCM_FD SHVU_FRNT_FD FLLR_FD vDummy_FD_B2 GW_SAU_DRV_FD ATS_FD PSB_FD GW_PSU_RR_FD SHVU_RL_FD RWPC_FD CGW_CCU OHCL_FD SHVU_REAR_FD BLTN_CAM_FD GW_PSU_DRV_FD FCS_FD GW_PSU_AST_FD GW_PSU_3RD_FD RCS_FD GW_PSU_RL_FD SHVU_3RD_FD SHVU_RR_FD RCM_FD DCM_FD SGU_FD vFD_B2

BO_ 648 CCU_OTA_01_200ms: 8 CGW_CCU
 SG_ CCU_AP_OTA_Crc1Val : 0|16@1+ (1,0) [0|0] ""  vDummy_FD_B2,vFD_B2
 SG_ CCU_AP_OTA_AlvCnt1Val : 16|8@1+ (1,0) [0|0] ""  vDummy_FD_B2,vFD_B2
 SG_ CCU_OTA_mode : 28|4@1+ (1,0) [0|0] ""  BLTN_CAM_FD,DCM_FD
 SG_ CCU_OTA_IG3On_request : 32|2@1+ (1,0) [0|0] "" Vector__XXX
 SG_ OTA_Cond_Vehicle_Pwr : 34|2@1+ (1,0) [0|0] "flag" Vector__XXX
 SG_ OTA_Cond_Gear_P : 36|2@1+ (1,0) [0|0] "flag" Vector__XXX
 SG_ OTA_Cond_Parking_Brk : 38|2@1+ (1,0) [0|0] "flag" Vector__XXX
 SG_ OTA_Cond_Ext_Lamp : 40|2@1+ (1,0) [0|0] "flag" Vector__XXX
 SG_ OTA_Cond_Hood_Closed : 42|2@1+ (1,0) [0|0] "flag" Vector__XXX
 SG_ CCU_OTA_req_power_State : 44|2@1+ (1,0) [0|0] "" Vector__XXX
 SG_ OTA_Cond_HighBatt : 46|2@1+ (1,0) [0|0] "flag" Vector__XXX
 SG_ CCU_OTA_Cond_Request : 49|2@1+ (1,0) [0|0] "" Vector__XXX
 SG_ CCU_OTA_Tele_Cranking : 51|3@1+ (1,0) [0|0] "" Vector__XXX
 SG_ OTA_UI_Ready_request : 54|2@1+ (1,0) [0|0] "" Vector__XXX
 SG_ OTA_Result : 56|2@1+ (1,0) [0|0] "flag" Vector__XXX
 SG_ CF_AVN_InterAutoLockMode_Set2_Co : 59|3@1+ (1,0) [0|0] "" Vector__XXX
 SG_ CCU_OTA_EOU : 62|2@1+ (1,0) [0|0] "" Vector__XXX

BO_ 920 CTM_FD_02_200ms: 16 CGW_CCU
 SG_ CTM_FD_Crc2Val : 0|16@1+ (1,0) [0|0] "" Vector__XXX
 SG_ ITBC_TrLampTypeSta : 125|3@1+ (1,0) [0|0] "" Vector__XXX
 SG_ CTM_FD_AlvCnt2Val : 16|8@1+ (1,0) [0|0] "" Vector__XXX
 SG_ ITBC_Brk_FaultWarnSta : 24|3@1+ (1,0) [0|0] "" Vector__XXX
 SG_ USM_TrailerTypSta : 27|3@1+ (1,0) [0|0] "" Vector__XXX
 SG_ ITBC_TrailerDisplayAppliedSta : 30|2@1+ (1,0) [0|0] "" Vector__XXX
 SG_ ITBC_Brk_FnctWarnSta : 32|3@1+ (1,0) [0|0] "" Vector__XXX
 SG_ ITBC_LampWarnSta : 35|2@1+ (1,0) [0|0] "" Vector__XXX
 SG_ ITBC_Brk_DisconnWarnSta : 37|2@1+ (1,0) [0|0] "" Vector__XXX
 SG_ ITBC_TrailerBrkOut : 40|7@1+ (1,0) [0|0] "%" Vector__XXX
 SG_ ITBC_TrailerBrkGainVal : 48|5@1+ (0.5,0) [0|0] "%" Vector__XXX
 SG_ ITBC_SysWarn : 53|3@1+ (1,0) [0|0] "" Vector__XXX
 SG_ ITBC_ResetOpSta : 56|2@1+ (1,0) [0|0] "" Vector__XXX
 SG_ ITBC_BrkWarn : 58|2@1+ (1,0) [0|0] "" Vector__XXX
 SG_ ITBC_TrnSigLmpWarn : 60|2@1+ (1,0) [0|0] "" Vector__XXX
 SG_ ITBC_StpLmpWarn : 62|2@1+ (1,0) [0|0] "" Vector__XXX
 SG_ CTM_TrailerAct : 64|2@1+ (1,0) [0|0] ""  BLTN_CAM_FD
 SG_ CTM_RearfogAct : 66|2@1+ (1,0) [0|0] "" Vector__XXX
 SG_ CTM_StpLmpOpnSta : 68|2@1+ (1,0) [0|0] "" Vector__XXX
 SG_ CTM_TrnSigLmpLftOpnSta : 70|2@1+ (1,0) [0|0] "" Vector__XXX
 SG_ CTM_TrnSigLmpRtOpnSta : 72|2@1+ (1,0) [0|0] "" Vector__XXX
 SG_ CTM_ExtTailLmpLftOpnSta : 74|2@1+ (1,0) [0|0] "" Vector__XXX
 SG_ CTM_ExtTailLmpRtOpnSta : 76|2@1+ (1,0) [0|0] "" Vector__XXX
 SG_ CTM_Exra_EbrakSta : 78|2@1+ (1,0) [0|0] "" Vector__XXX
 SG_ CTM_TrlAngl_200ms : 80|16@1+ (0.0055,-180) [0|0] "" Vector__XXX
 SG_ TCM_ResetOpSta : 96|2@1+ (1,0) [0|0] "" Vector__XXX

BO_ 918 CMS_LH_FD_01_200ms: 24 CGW_CCU
 SG_ CMS_LH_FD_Crc1Val : 0|16@1+ (1,0) [0|0] ""  GW_PSU_DRV_FD
 SG_ IMS_CMSPlayBackSta_LH : 100|4@1+ (1,0) [0|0] ""  GW_PSU_DRV_FD
 SG_ CMSFldReq : 104|2@1+ (1,0) [0|0] "" Vector__XXX
 SG_ CMS_LH_FoldingSta : 106|2@1+ (1,0) [0|0] "" Vector__XXX
 SG_ CMS_LH_UnfoldingSta : 108|2@1+ (1,0) [0|0] "" Vector__XXX
 SG_ CMS_LHVerPosVal : 112|8@1+ (0.02,0) [0|0] "V" Vector__XXX
 SG_ CMS_LHHorPosVal : 120|8@1+ (0.02,0) [0|0] "V" Vector__XXX
 SG_ CMS_LHSta : 144|2@1+ (1,0) [0|0] "" Vector__XXX
 SG_ CMS_Opt : 146|1@1+ (1,0) [0|0] ""  BLTN_CAM_FD
 SG_ CMS_LH_FD_AlvCnt1Val : 16|8@1+ (1,0) [0|0] ""  GW_PSU_DRV_FD
 SG_ Monitor_ViewPanningCmd : 72|3@1+ (1,0) [0|0] "" Vector__XXX
 SG_ DSM_LH_ResetOpSta : 82|2@1+ (1,0) [0|0] "" Vector__XXX
 SG_ USM_TurnDstLnDispSta : 84|2@1+ (1,0) [0|0] "" Vector__XXX
 SG_ USM_TurnDstLnDispStaRH : 86|2@1+ (1,0) [0|0] "" Vector__XXX
 SG_ USM_RhstaLvlEnaSta : 88|2@1+ (1,0) [0|0] "" Vector__XXX
 SG_ USM_RhstaLvlEnaStaRH : 90|2@1+ (1,0) [0|0] "" Vector__XXX
 SG_ USM_CMSDayBrgtnsLvlLHSta : 92|4@1+ (1,0) [0|0] "" Vector__XXX
 SG_ USM_CMSNgtBrgtnsLvlLHSta : 96|4@1+ (1,0) [0|0] "" Vector__XXX

BO_ 160 WHL_01_10ms: 24 CGW_CCU
 SG_ WHL_Crc1Val : 0|16@1+ (1,0) [0|0] "" Vector__XXX
 SG_ WHL_SpdRRVal : 112|14@1+ (0.03125,0) [0|0] "km^h"  BLTN_CAM_FD,GW_PSU_AST_FD,PSB_FD
 SG_ WHL_SpdCalParmtr : 136|9@1+ (0.5,200) [0|0] "mm" Vector__XXX
 SG_ WHL_AlvCnt1Val : 16|8@1+ (1,0) [0|0] "" Vector__XXX
 SG_ WHL_PlsFLVal : 24|8@1+ (0.5,0) [0|0] "pulse count" Vector__XXX
 SG_ WHL_PlsFRVal : 32|8@1+ (0.5,0) [0|0] "pulse count" Vector__XXX
 SG_ WHL_PlsRLVal : 40|8@1+ (0.5,0) [0|0] "pulse count" Vector__XXX
 SG_ WHL_PlsRRVal : 48|8@1+ (0.5,0) [0|0] "pulse count" Vector__XXX
 SG_ WHL_DirFLVal : 56|2@1+ (1,0) [0|0] "" Vector__XXX
 SG_ WHL_DirFRVal : 58|2@1+ (1,0) [0|0] "" Vector__XXX
 SG_ WHL_DirRLVal : 60|2@1+ (1,0) [0|0] "" Vector__XXX
 SG_ WHL_DirRRVal : 62|2@1+ (1,0) [0|0] "" Vector__XXX
 SG_ WHL_SpdFLVal : 64|14@1+ (0.03125,0) [0|0] "km^h"  BLTN_CAM_FD,PSB_FD
 SG_ WHL_SpdFRVal : 80|14@1+ (0.03125,0) [0|0] "km^h"  BLTN_CAM_FD,PSB_FD
 SG_ WHL_SpdRLVal : 96|14@1+ (0.03125,0) [0|0] "km^h"  BLTN_CAM_FD,GW_PSU_AST_FD,PSB_FD

BO_ 426 CLU_01_20ms: 16 CGW_CCU
 SG_ CLU_Crc1Val : 0|16@1+ (1,0) [0|0] ""  ATS_FD,GW_PSU_DRV_FD,RCM_FD,SHVU_3RD_FD,SHVU_REAR_FD
 SG_ CLU_FuelSenderRstReq : 110|2@1+ (1,0) [0|0] "" Vector__XXX
 SG_ CLU_PRKDispRdy : 112|2@1+ (1,0) [0|0] "" Vector__XXX
 SG_ CLU_XtrekPlusOnOffReq : 114|2@1+ (1,0) [0|0] "" Vector__XXX
 SG_ CLU_ISG_OFF_SoftkeySta : 116|2@1+ (1,0) [0|0] "" Vector__XXX
 SG_ CLU_AlvCnt1Val : 16|8@1+ (1,0) [0|0] ""  ATS_FD,GW_PSU_DRV_FD,RCM_FD,SHVU_3RD_FD,SHVU_REAR_FD
 SG_ CLU_DtntOutSta : 28|2@1+ (1,0) [0|0] ""  ARS_FD,ATS_FD,FCS_FD,GW_PSU_3RD_FD,GW_PSU_AST_FD,GW_PSU_DRV_FD,GW_PSU_RL_FD,GW_PSU_RR_FD,GW_SAU_DRV_FD,OHCL_FD,RCS_FD,RWPC_FD,SHVU_3RD_FD,SHVU_FRNT_FD,SHVU_REAR_FD,SHVU_RL_FD,SHVU_RR_FD,WPC2_FD,WPC_FD
 SG_ CLU_SpdUnitTyp : 30|2@1+ (1,0) [0|0] ""  BLTN_CAM_FD,GW_PSU_DRV_FD,WPC2_FD
 SG_ CLU_DisSpdDcmlVal : 32|2@1+ (0.125,0) [0|0] "" Vector__XXX
 SG_ CLU_SWRCCrsMainSwSta : 34|2@1+ (1,0) [0|0] "" Vector__XXX
 SG_ CLU_SWRCCrsSwSta : 36|3@1+ (1,0) [0|0] "" Vector__XXX
 SG_ CLU_SWRCLFASwSta : 39|2@1+ (1,0) [0|0] "" Vector__XXX
 SG_ CLU_SWRCSldMainSwSta : 41|2@1+ (1,0) [0|0] "" Vector__XXX
 SG_ CLU_RhstaLvlSta : 43|5@1+ (1,0) [0|0] ""  ARS_FD,ATS_FD,FCS_FD,GW_PSU_3RD_FD,GW_PSU_AST_FD,GW_PSU_DRV_FD,GW_PSU_RL_FD,GW_PSU_RR_FD,GW_SAU_DRV_FD,OHCL_FD,RCS_FD,RWPC_FD,SHVU_3RD_FD,SHVU_FRNT_FD,SHVU_REAR_FD,SHVU_RL_FD,SHVU_RR_FD,WPC2_FD,WPC_FD
 SG_ CLU_DisSpdVal : 48|10@1+ (0.5,0) [0|0] "km/h or MPH"  BLTN_CAM_FD,GW_PSU_AST_FD,GW_PSU_DRV_FD,WPC2_FD
 SG_ CLU_OKSwSta : 62|2@1+ (1,0) [0|0] "" Vector__XXX
 SG_ CLU_DisSpdVal_KPH : 64|9@1+ (1,0) [0|0] "km/h"  ARS_FD,ATS_FD,DCM_FD,FCS_FD,GW_PSU_3RD_FD,GW_PSU_AST_FD,GW_PSU_DRV_FD,GW_PSU_RL_FD,GW_PSU_RR_FD,GW_SAU_DRV_FD,RCM_FD,RWPC_FD,SHVU_3RD_FD,SHVU_FRNT_FD,SHVU_REAR_FD,SHVU_RL_FD,SHVU_RR_FD,WPC2_FD,WPC_FD
 SG_ CLU_PwrAutoOffResetReq_HCU : 73|2@1+ (1,0) [0|0] "" Vector__XXX
 SG_ CLU_CUSTOMSta_NEW : 75|4@1+ (1,0) [0|0] "" Vector__XXX
 SG_ CLU_AutoBrightSta : 79|8@1+ (1,0) [0|0] ""  ATS_FD,BLTN_CAM_FD,FCS_FD,GW_PSU_3RD_FD,GW_PSU_AST_FD,GW_PSU_DRV_FD,GW_PSU_RL_FD,GW_PSU_RR_FD,GW_SAU_DRV_FD,OHCL_FD,PSB_FD,RCS_FD,RWPC_FD,SHVU_3RD_FD,SHVU_FRNT_FD,SHVU_REAR_FD,SHVU_RL_FD,SHVU_RR_FD,WPC2_FD,WPC_FD
 SG_ CLU_NotMinModeBrightSta : 87|8@1+ (1,0) [0|0] "" Vector__XXX
 SG_ CLU_FuelSenderResistVal : 97|13@1+ (0.1,0) [0|0] "" Vector__XXX

BO_ 293 SAS_01_10ms: 16 CGW_CCU
 SG_ SAS_Crc1Val : 0|16@1+ (1,0) [0|0] "" Vector__XXX
 SG_ SAS_AlvCnt1Val : 16|8@1+ (1,0) [0|0] "" Vector__XXX
 SG_ SAS_AnglVal : 24|16@1- (0.1,0) [0|0] "Deg"  BLTN_CAM_FD,GW_SAU_DRV_FD,PSB_FD
 SG_ SAS_SpdVal : 40|8@1+ (4,0) [0|0] "Deg/s"  GW_SAU_DRV_FD
 SG_ SAS_IntSta : 48|8@1+ (1,0) [0|0] "" Vector__XXX

BO_ 53 VCU_01_10ms: 32 CGW_CCU
 SG_ VCU_Crc1Val : 0|16@1+ (1,0) [0|0] ""  GW_PSU_DRV_FD
 SG_ VCU_ScuKeepWakeReq : 110|2@1+ (1,0) [0|0] "flag" Vector__XXX
 SG_ VCU_MotTqCmdRearVal : 112|14@1- (0.125,0) [-1024|1023.875] "Nm" Vector__XXX
 SG_ VCU_FmcuZeroTqOfsReq : 126|2@1+ (1,0) [0|0] "flag" Vector__XXX
 SG_ VCU_EcmSeqSta : 128|8@1+ (1,0) [0|255] "" Vector__XXX
 SG_ VCU_EcmDiagSta : 136|8@1+ (1,0) [0|255] "" Vector__XXX
 SG_ VCU_CltActDiagSta : 144|8@1+ (1,0) [0|255] "" Vector__XXX
 SG_ VCU_CltActDrvCrntVal : 152|12@1- (0.025,0) [-51.2|51.175] "A" Vector__XXX
 SG_ VCU_AlvCnt1Val : 16|8@1+ (1,0) [0|0] ""  GW_PSU_DRV_FD
 SG_ VCU_CltActPosStrokeVal : 164|12@1- (0.0125,0) [-25.6|25.5875] "mm" Vector__XXX
 SG_ VCU_MainBattTypeSta : 176|2@1+ (1,0) [0|3] "" Vector__XXX
 SG_ VCU_MainBattTypeLrnSta : 178|2@1+ (1,0) [0|3] "" Vector__XXX
 SG_ VCU_WarmupCycSta : 180|2@1+ (1,0) [0|3] "" Vector__XXX
 SG_ VCU_FatcPermPwrVal : 182|10@1+ (20,0) [0|12700] "W" Vector__XXX
 SG_ VCU_GearPosStaDisp : 192|4@1+ (1,0) [0|0] ""  BLTN_CAM_FD,DCM_FD,FCS_FD
 SG_ VCU_PdlStopCtrlSta : 196|2@1+ (1,0) [0|0] "" Vector__XXX
 SG_ VCU_PdlStopReqTqNmVal : 198|16@1+ (1,0) [0|0] "" Vector__XXX
 SG_ VCU_PMPDActSta : 214|2@1+ (1,0) [0|0] "" Vector__XXX
 SG_ VCU_PMPDWarnSta : 216|2@1+ (1,0) [0|0] "" Vector__XXX
 SG_ VCU_VgsVirSoundBackFireIndex : 218|5@1+ (1,0) [0|0] "" Vector__XXX
 SG_ VCU_VgsVirEngSpdRpmVal : 224|16@1- (1,0) [0|0] ""  BLTN_CAM_FD
 SG_ VCU_RdySta : 24|2@1+ (1,0) [0|3] "" Vector__XXX
 SG_ VCU_VgsVirSoundVolume : 240|8@1+ (0.392156863,0) [0|0] "" Vector__XXX
 SG_ VCU_VgsVirGearStep : 248|4@1+ (1,0) [0|0] ""  BLTN_CAM_FD
 SG_ VCU_StandbyModSta : 252|2@1+ (1,0) [0|0] "" Vector__XXX
 SG_ VCU_HVIntLkDischrgReq : 254|2@1+ (1,0) [0|0] "" Vector__XXX
 SG_ VCU_StartKeyHoldSta : 26|2@1+ (1,0) [0|3] "" Vector__XXX
 SG_ VCU_EvDrvRdySta : 28|2@1+ (1,0) [0|3] ""  BLTN_CAM_FD,FCS_FD,GW_PSU_3RD_FD,GW_PSU_AST_FD,GW_PSU_DRV_FD,GW_PSU_RL_FD,GW_PSU_RR_FD,GW_SAU_DRV_FD,PSB_FD,RCM_FD,RWPC_FD,SCM_FD,SGU_FD,SHVU_3RD_FD,SHVU_CCS_FD,SHVU_FRNT_FD,SHVU_REAR_FD,SHVU_RL_FD,SHVU_RR_FD,WPC2_FD,WPC_FD
 SG_ VCU_MotPwrEnReq : 30|2@1+ (1,0) [0|3] "" Vector__XXX
 SG_ VCU_GearPosSta : 32|4@1+ (1,0) [0|15] ""  BLTN_CAM_FD,DCM_FD,FLLR_FD,GW_PSU_3RD_FD,GW_PSU_AST_FD,GW_PSU_DRV_FD,GW_PSU_RL_FD,GW_PSU_RR_FD,RWPC_FD,SGU_FD,WPC2_FD,WPC_FD
 SG_ VCU_LdcInhReq : 36|2@1+ (1,0) [0|3] "" Vector__XXX
 SG_ VCU_MainRlyOffReq : 38|2@1+ (1,0) [0|3] "" Vector__XXX
 SG_ VCU_AccPedDepVal : 40|8@1+ (0.3921568627,0) [0|100] "%"  BLTN_CAM_FD
 SG_ VCU_FatcOperPermSta : 48|2@1+ (1,0) [0|3] "" Vector__XXX
 SG_ VCU_DrvCycSta : 50|2@1+ (1,0) [0|3] "" Vector__XXX
 SG_ VCU_CltActOpSta : 52|4@1+ (1,0) [0|15] "" Vector__XXX
 SG_ VCU_WhlSpdSnsrAlvReq : 56|2@1+ (1,0) [0|0] "flag" Vector__XXX
 SG_ VCU_DrvModOpSta : 58|4@1+ (1,0) [0|0] "" Vector__XXX
 SG_ VCU_HydBrkFcHoldRq : 62|2@1+ (1,0) [0|0] "" Vector__XXX
 SG_ VCU_FatcPwrUseVal : 64|8@1+ (10,0) [0|2550] "W" Vector__XXX
 SG_ VCU_WhlDemTqVal : 72|16@1- (1,0) [-32768|32767] "Nm" Vector__XXX
 SG_ VCU_McuAntiJerkInhFrntSta : 88|2@1+ (1,0) [0|3] "" Vector__XXX
 SG_ VCU_McuAntiJerkInhRearSta : 90|2@1+ (1,0) [0|3] "" Vector__XXX
 SG_ VCU_McuPwrLatchHoldReq : 92|2@1+ (1,0) [0|0] "" Vector__XXX
 SG_ VCU_ScuParkReq : 94|2@1+ (1,0) [0|0] "flag" Vector__XXX
 SG_ VCU_MotTqCmdFrntVal : 96|14@1- (0.125,0) [-1024|1023.875] "Nm" Vector__XXX

BO_ 1278 BLTN_CAM_FD_DCM_00_1000ms: 32 BLTN_CAM_FD
 SG_ BLTN_CAM_FD_DCM_Crc0Val : 0|16@1+ (1,0) [0|0] "" Vector__XXX
 SG_ DCM_VideoOut_Interface_Ver_Major : 101|8@1+ (1,0) [0|0] ""  DCM_FD
 SG_ DCM_VideoOut_Interface_Ver_Minor : 109|8@1+ (1,0) [0|0] ""  DCM_FD
 SG_ BLTN_CAM_FD_DCM_AlvCnt0Val : 16|8@1+ (1,0) [0|0] "" Vector__XXX
 SG_ BLTN_CAM_HW_Platform_Ver_Major : 24|4@1+ (1,0) [0|0] ""  DCM_FD
 SG_ BLTN_CAM_HW_Platform_Ver_Minor : 28|4@1+ (1,0) [0|0] ""  DCM_FD
 SG_ RearCamera_HW_Ver_Major : 32|7@1+ (1,0) [0|0] ""  DCM_FD
 SG_ RearCamera_HW_Ver_Minor : 39|7@1+ (1,0) [0|0] ""  DCM_FD
 SG_ RearCamera_SW_Ver_Major : 46|7@1+ (1,0) [0|0] ""  DCM_FD
 SG_ RearCamera_SW_Ver_Minor : 53|7@1+ (1,0) [0|0] ""  DCM_FD
 SG_ RearCamera_ISP_Ver0 : 64|7@1+ (1,0) [0|0] ""  DCM_FD
 SG_ RearCamera_ISP_Ver1 : 71|7@1+ (1,0) [0|0] ""  DCM_FD
 SG_ RearCamera_ISP_Ver2 : 78|7@1+ (1,0) [0|0] ""  DCM_FD
 SG_ RearCamera_ISP_Ver3 : 85|7@1+ (1,0) [0|0] ""  DCM_FD
 SG_ DCM_Output_Color_Fromat : 92|3@1+ (1,0) [0|0] ""  DCM_FD
 SG_ DCM_Output_Color_bit_Num : 95|3@1+ (1,0) [0|0] ""  DCM_FD
 SG_ RearCamera_Lenz_Ver : 98|3@1+ (1,0) [0|0] ""  DCM_FD

BO_ 1279 DCM_FD_BLTN_CAM_01_1000ms: 32 DCM_FD
 SG_ DCM_HW_Ver_Major : 24|7@1+ (1,0) [0|0] ""  BLTN_CAM_FD
 SG_ DCM_HW_Ver_Minor : 31|7@1+ (1,0) [0|0] ""  BLTN_CAM_FD
 SG_ DCM_ResetOpSta : 56|2@1+ (1,0) [0|0] "" Vector__XXX
 SG_ DCM_SW_Ver_1st_Digit : 64|8@1+ (1,0) [0|0] ""  BLTN_CAM_FD
 SG_ DCM_SW_Ver_2nd_Digit : 72|8@1+ (1,0) [0|0] ""  BLTN_CAM_FD
 SG_ DCM_SW_Ver_3rd_Digit : 80|8@1+ (1,0) [0|0] ""  BLTN_CAM_FD
 SG_ DCM_SW_Ver_4th_Digit : 88|8@1+ (1,0) [0|0] ""  BLTN_CAM_FD

BO_ 1276 DCM_FD_BLTN_CAM_00_00ms: 32 DCM_FD
 SG_ DCM_Output_Reset_Req : 24|4@1+ (1,0) [0|0] ""  BLTN_CAM_FD
 SG_ Resolution_Req_Width : 28|12@1+ (1,0) [0|0] ""  BLTN_CAM_FD
 SG_ Resolution_Req_Height : 40|12@1+ (1,0) [0|0] ""  BLTN_CAM_FD
 SG_ Center_offset_Width_set : 52|12@1+ (1,0) [0|0] ""  BLTN_CAM_FD
 SG_ Center_offset_Height_set : 64|12@1+ (1,0) [0|0] ""  BLTN_CAM_FD
 SG_ DCM_FPS_Change : 76|7@1+ (1,0) [0|0] ""  BLTN_CAM_FD

BO_ 1277 BLTN_CAM_FD_DCM_01_500ms: 32 BLTN_CAM_FD
 SG_ BLTN_CAM_FD_DCM_Crc1Val : 0|16@1+ (1,0) [0|0] "" Vector__XXX
 SG_ RearCamera_EmbeddedData0 : 102|8@1+ (1,0) [0|0] ""  DCM_FD
 SG_ RearCamera_EmbeddedData1 : 110|8@1+ (1,0) [0|0] ""  DCM_FD
 SG_ RearCamera_EmbeddedData2 : 118|8@1+ (1,0) [0|0] ""  DCM_FD
 SG_ RearCamera_EmbeddedData3 : 128|8@1+ (1,0) [0|0] ""  DCM_FD
 SG_ BLTN_CAM_FD_DCM_AlvCnt1Val : 16|8@1+ (1,0) [0|0] "" Vector__XXX
 SG_ BLTN_CAM_DCM_Status : 24|4@1+ (1,0) [0|0] ""  DCM_FD
 SG_ RearCamera_Input_Status : 28|4@1+ (1,0) [0|0] ""  DCM_FD
 SG_ DCM_Output_Resolution_Width : 32|12@1+ (1,0) [0|0] ""  DCM_FD
 SG_ DCM_Output_Resolution_Height : 44|12@1+ (1,0) [0|0] ""  DCM_FD
 SG_ BLTN_CAM_DCM_SER_I2C_Master : 56|2@1+ (1,0) [0|0] ""  DCM_FD
 SG_ Center_offset_Width : 64|12@1+ (1,0) [0|0] ""  DCM_FD
 SG_ Center_offset_Height : 76|12@1+ (1,0) [0|0] ""  DCM_FD
 SG_ FPS_RearCamera : 88|7@1+ (1,0) [0|0] ""  DCM_FD
 SG_ FPS_DCM_Output : 95|7@1+ (1,0) [0|0] ""  DCM_FD

BO_ 69 HTCU_04_10ms: 24 CGW_CCU
 SG_ HTCU_Crc4Val : 0|16@1+ (1,0) [0|0] "" Vector__XXX
 SG_ HTCU_CtrlablSta : 101|2@1+ (1,0) [0|0] "" Vector__XXX
 SG_ HTCU_PrgrmSta : 104|6@1+ (1,0) [0|0] "" Vector__XXX
 SG_ HTCU_FsCltchLmphmActvSta : 110|2@1+ (1,0) [0|0] "" Vector__XXX
 SG_ HTCU_FsIdleTrgtRpmVal : 112|8@1+ (10,0) [0|0] "rpm" Vector__XXX
 SG_ HTCU_FsAddtnlTqLssPcVal : 120|8@1+ (0.390625,0) [0|0] "%" Vector__XXX
 SG_ HTCU_FsEngTqRdctnPcVal : 128|8@1+ (0.390625,0) [0|0] "%" Vector__XXX
 SG_ HTCU_LnPrsBarVal : 136|8@1+ (0.1,0) [0|0] "Bar" Vector__XXX
 SG_ HTCU_RapidKDReq : 144|2@1+ (1,0) [0|0] "" Vector__XXX
 SG_ HTCU_CurrGearSta : 146|4@1+ (1,0) [0|0] "" Vector__XXX
 SG_ HTCU_GearShftUpDisGSI : 150|2@1+ (1,0) [0|0] "" Vector__XXX
 SG_ HTCU_GearShftDnDisGSI : 152|2@1+ (1,0) [0|0] "" Vector__XXX
 SG_ HTCU_TrgtGearStaGSI : 154|4@1+ (1,0) [0|0] "" Vector__XXX
 SG_ HTCU_SolBSta : 158|2@1+ (1,0) [0|0] "" Vector__XXX
 SG_ HTCU_AlvCnt4Val : 16|8@1+ (1,0) [0|0] "" Vector__XXX
 SG_ HTCU_TqRdctnNegativePcVal : 160|10@1- (0.390625,0) [0|0] "rpm" Vector__XXX
 SG_ HTCU_PddlShftMdSlctSta : 170|2@1+ (1,0) [0|0] "" Vector__XXX
 SG_ HTCU_PrkReleaseReq : 172|2@1+ (1,0) [0|0] "" Vector__XXX
 SG_ HTCU_TrgtGearSta : 24|4@1+ (1,0) [0|0] "" Vector__XXX
 SG_ HTCU_RdySta : 28|2@1+ (1,0) [0|0] "" Vector__XXX
 SG_ HTCU_GearChgSta : 30|2@1+ (1,0) [0|0] "" Vector__XXX
 SG_ HTCU_TqRdctnPcVal : 32|9@1+ (0.390625,0) [0|0] "%" Vector__XXX
 SG_ HTCU_FltSta : 41|3@1+ (1,0) [0|0] "" Vector__XXX
 SG_ HTCU_GearSlctrDis : 44|4@1+ (1,0) [0|0] ""  BLTN_CAM_FD,DCM_FD,FCS_FD,GW_PSU_3RD_FD,GW_PSU_AST_FD,GW_PSU_RL_FD,GW_PSU_RR_FD,SHVU_RL_FD,SHVU_RR_FD
 SG_ HTCU_SlwTqRdctnPcVal : 48|9@1+ (0.390625,0) [0|0] "%" Vector__XXX
 SG_ HTCU_PddlShftUpDn : 57|2@1+ (1,0) [0|0] "" Vector__XXX
 SG_ HTCU_FanCtrlReq : 62|2@1+ (1,0) [0|0] "" Vector__XXX
 SG_ HTCU_VehSpdKphVal : 64|8@1+ (1,0) [0|0] "kph" Vector__XXX
 SG_ HTCU_VehSpdDcmlKphVal : 72|8@1+ (0.0078125,0) [0|0] "kph" Vector__XXX
 SG_ HTCU_HvOpuSpdCmdRpmVal : 80|8@1+ (20,0) [0|0] "rpm" Vector__XXX
 SG_ HTCU_TrgtShftClsCCanSta : 96|5@1+ (1,0) [0|0] "" Vector__XXX

CM_ BO_ 648 "[PE] Periodic and On Event";
CM_ SG_ 648 CCU_AP_OTA_Crc1Val "CCU_AP_OTA_CyclicRedundancyCheck1Value";
CM_ SG_ 648 CCU_AP_OTA_AlvCnt1Val "CCU_AP_OTA_AliveCounter1Value";
CM_ SG_ 648 CCU_OTA_mode "OTA_mode";
CM_ SG_ 648 CCU_OTA_IG3On_request "IG3 Rly ON request";
CM_ SG_ 648 CCU_OTA_Cond_Request "CCU_OTA_CondRequest";
CM_ SG_ 648 CCU_OTA_Tele_Cranking "Vehicle cranking request signfal for OTA Update";
CM_ SG_ 648 OTA_UI_Ready_request "OTA UI Ready";
CM_ SG_ 648 OTA_Result "업데이트 결과";
CM_ SG_ 648 CF_AVN_InterAutoLockMode_Set2_Co "USM Request for Charing Connector Locking Mode (Auto/Lock/Unlock)";
CM_ BO_ 920 "[PE] Periodic and On Event";
CM_ SG_ 920 CTM_FD_Crc2Val "CTM_FD_CyclicRedundancyCheck2Value";
CM_ SG_ 920 ITBC_TrLampTypeSta "Trailer turn signal lamp type";
CM_ SG_ 920 CTM_FD_AlvCnt2Val "CTM_FD_AliveCounter2Value";
CM_ SG_ 920 ITBC_Brk_FaultWarnSta "Request for cluster to provide audible warning & pop up on Trailer Brake out Fail situation (conditions TBD eg fault).";
CM_ SG_ 920 USM_TrailerTypSta "Trailer type status";
CM_ SG_ 920 ITBC_TrailerDisplayAppliedSta "Determination of ITBC application";
CM_ SG_ 920 ITBC_Brk_FnctWarnSta "Auto Disabled (Autobrake disable 발생 시)/ Manual Disabled (Manual brake disable 발생 시) / All Disabled(Auto/Manual brake disable 발생 시)";
CM_ SG_ 920 ITBC_LampWarnSta "TailLamp, RearFog, BackupLamp의 고장 상태 알림";
CM_ SG_ 920 ITBC_Brk_DisconnWarnSta "Occurs when the Trailer is not connected and the ITBC switch is operated";
CM_ SG_ 920 ITBC_TrailerBrkOut "Trailer Brake Output sent to cluster. PWM duty cycle 0 - 100%.";
CM_ SG_ 920 ITBC_TrailerBrkGainVal "Gain setting 0 - 10 in steps of 0.5 on cluster.";
CM_ SG_ 920 ITBC_SysWarn "Request for cluster to provide audible warning & pop up (conditions TBD eg fault).";
CM_ SG_ 920 ITBC_ResetOpSta "This signal indicates whether the reset operation has been completed or not";
CM_ SG_ 920 ITBC_BrkWarn "Request for cluster to provide audible warning & pop up on Trailer Brake out Fail situation(conditions TBD eg fault).";
CM_ SG_ 920 ITBC_TrnSigLmpWarn "Request for cluster to provide audible warning & pop up about Trailer Trun Signal Error(conditions TBD eg fault).";
CM_ SG_ 920 ITBC_StpLmpWarn "Request for cluster to provide audible warning & pop up about Trailer Stop Lamp ERROR(conditions TBD eg fault).";
CM_ SG_ 920 CTM_TrailerAct "This signal is used for control the Trailer Act function.";
CM_ SG_ 920 CTM_RearfogAct "This signal is used for display the rear fog lamp mounted on the trailer.";
CM_ SG_ 920 CTM_StpLmpOpnSta "Trailer Stop Lamp OpenStatus";
CM_ SG_ 920 CTM_TrnSigLmpLftOpnSta "Trailer T/SIG Lamp Left OpenStatus";
CM_ SG_ 920 CTM_TrnSigLmpRtOpnSta "Trailer T/SIG Lamp Right OpenStatus";
CM_ SG_ 920 CTM_ExtTailLmpLftOpnSta "Trailer Exterior Tail Lamp Left OpenStatus";
CM_ SG_ 920 CTM_ExtTailLmpRtOpnSta "Trailer Exterior Tail Lamp Right OpenStatus";
CM_ SG_ 920 CTM_Exra_EbrakSta "Trailer Exterior Ebrake Out OnOffStatus";
CM_ SG_ 920 CTM_TrlAngl_200ms "CTM_TrailerAngle_200ms";
CM_ SG_ 920 TCM_ResetOpSta "This signal indicates whether the reset operation has been completed or not";
CM_ BO_ 918 "[PE] Periodic and On Event";
CM_ SG_ 918 CMS_LH_FD_Crc1Val "CMS_LH_FD_CyclicRedundancyCheck1Value";
CM_ SG_ 918 CMS_LHVerPosVal "LH Outside Mirror Vertical Position sensor value";
CM_ SG_ 918 CMS_LHHorPosVal "LH Outside Mirror Horizontal Position Sensor Voltage";
CM_ SG_ 918 CMS_LHSta "CMS_LH Status";
CM_ SG_ 918 CMS_Opt "CMS option information";
CM_ SG_ 918 CMS_LH_FD_AlvCnt1Val "CMS_LH_FD_AliveCounter1Value";
CM_ SG_ 918 Monitor_ViewPanningCmd "Monitor_ViewPanningCommand";
CM_ SG_ 918 DSM_LH_ResetOpSta "This signal indicates whether the reset operation has been completed or not";
CM_ BO_ 160 "[P] Periodic";
CM_ SG_ 160 WHL_Crc1Val "WHL_CyclicRedundancyCheck1Value";
CM_ SG_ 160 WHL_SpdRRVal "WHL_SpeedRearRightValue ##2G##ESC - WHL_SPD11 - WHL_SPD_RR";
CM_ SG_ 160 WHL_SpdCalParmtr "WHL_SpeedCalculationParameter";
CM_ SG_ 160 WHL_AlvCnt1Val "WHL_AliveCounter1Value";
CM_ SG_ 160 WHL_PlsFLVal "WHL_PulseFrontLeftValue ##2G##ESC - WHL_PUL11 - WHL_PUL_FL";
CM_ SG_ 160 WHL_PlsFRVal "WHL_PulseFrontRightValue ##2G##ESC - WHL_PUL11 - WHL_PUL_FR";
CM_ SG_ 160 WHL_PlsRLVal "WHL_PulseRearLeftValue ##2G##ESC - WHL_PUL11 - WHL_PUL_RL";
CM_ SG_ 160 WHL_PlsRRVal "WHL_PulseRearRightValue ##2G##ESC - WHL_PUL11 - WHL_PUL_RR";
CM_ SG_ 160 WHL_DirFLVal "WHL_DirectionFrontLeftValue ##2G##ESC - WHL_PUL11 - WHL_DIR_FL";
CM_ SG_ 160 WHL_DirFRVal "WHL_DirectionFrontRightValue ##2G##ESC - WHL_PUL11 - WHL_DIR_FR";
CM_ SG_ 160 WHL_DirRLVal "WHL_DirectionRearLeftValue ##2G##ESC - WHL_PUL11 - WHL_DIR_RL";
CM_ SG_ 160 WHL_DirRRVal "WHL_DirectionRearRightValue ##2G##ESC - WHL_PUL11 - WHL_DIR_RR";
CM_ SG_ 160 WHL_SpdFLVal "WHL_SpeedFrontLeftValue ##2G##ESC - WHL_SPD11 - WHL_SPD_FL";
CM_ SG_ 160 WHL_SpdFRVal "WHL_SpeedFrontRightValue ##2G##ESC - WHL_SPD11 - WHL_SPD_FR";
CM_ SG_ 160 WHL_SpdRLVal "WHL_SpeedRearLeftValue ##2G##ESC - WHL_SPD11 - WHL_SPD_RL";
CM_ BO_ 426 "[P] Periodic";
CM_ SG_ 426 CLU_Crc1Val "CLU_CyclicRedundancyCheck1Value";
CM_ SG_ 426 CLU_FuelSenderRstReq "Reset request signal for ICV fuel-sender";
CM_ SG_ 426 CLU_PRKDispRdy "To inform the steady state of the cluster";
CM_ SG_ 426 CLU_XtrekPlusOnOffReq "X-trek+ Control Request from Connect platform S1 area";
CM_ SG_ 426 CLU_AlvCnt1Val "CLU_AliveCounter1Value";
CM_ SG_ 426 CLU_DtntOutSta "CLU_DetentOutStatus";
CM_ SG_ 426 CLU_SpdUnitTyp "CLU_SpeedUnitType";
CM_ SG_ 426 CLU_DisSpdDcmlVal "CLU_DisplaySpeedDecimalValue";
CM_ SG_ 426 CLU_SWRCCrsMainSwSta "CLU_SWRCCrsMainSwSta";
CM_ SG_ 426 CLU_SWRCCrsSwSta "CLU_SWRCCrsSwSta";
CM_ SG_ 426 CLU_SWRCLFASwSta "SWRC_LFASwitchStatus";
CM_ SG_ 426 CLU_SWRCSldMainSwSta "SWRC_SpeedLimiterMainSwitchStatus";
CM_ SG_ 426 CLU_RhstaLvlSta "CLU_RheostatLevelStatus";
CM_ SG_ 426 CLU_DisSpdVal "CLU_DisplaySpeedValue";
CM_ SG_ 426 CLU_OKSwSta "OK Switch On/Off State";
CM_ SG_ 426 CLU_DisSpdVal_KPH "CLU_DisplaySpeedValue_KPH";
CM_ SG_ 426 CLU_PwrAutoOffResetReq_HCU "reset power auto off time";
CM_ SG_ 426 CLU_AutoBrightSta "CLU_AutoBrightStatus";
CM_ SG_ 426 CLU_NotMinModeBrightSta "CLU_NotMinimumModeBrightStaus";
CM_ SG_ 426 CLU_FuelSenderResistVal "This is the resistance data come from fuel sender.";
CM_ BO_ 293 "[P] Periodic";
CM_ SG_ 293 SAS_Crc1Val "SAS_CyclicRedundancyCheck1Value";
CM_ SG_ 293 SAS_AlvCnt1Val "SAS_AliveCounter1Value";
CM_ SG_ 293 SAS_AnglVal "SAS_AngleValue";
CM_ SG_ 293 SAS_SpdVal "SAS_SpeedValue";
CM_ SG_ 293 SAS_IntSta "SAS_InternalStatus";
CM_ BO_ 53 "[P] Periodic";
CM_ SG_ 53 VCU_Crc1Val "VCU_CyclicRedundancyCheck1Value";
CM_ SG_ 53 VCU_ScuKeepWakeReq "VCU_ScuKeepWakeRequest ##2G##VCU - VCU12 - CF_Vcu_SSD";
CM_ SG_ 53 VCU_MotTqCmdRearVal "VCU_MotorTorqueCommandRearValue";
CM_ SG_ 53 VCU_FmcuZeroTqOfsReq "VCU_FmcuZeroTorqueOffsetRequest";
CM_ SG_ 53 VCU_EcmSeqSta "VCU_EcmSequenceStatus ##2G##VCU - VCU1 - CF_Vcu_IGONStatus";
CM_ SG_ 53 VCU_EcmDiagSta "VCU_EcmDiagnosisStatus";
CM_ SG_ 53 VCU_CltActDiagSta "VCU_ClutchActuatorDiagnosisStatus";
CM_ SG_ 53 VCU_CltActDrvCrntVal "VCU_ClutchActuatorDriveCurrentValue";
CM_ SG_ 53 VCU_AlvCnt1Val "VCU_AliveCounter1Value";
CM_ SG_ 53 VCU_CltActPosStrokeVal "VCU_ClutchActuatorPositionStrokeValue";
CM_ SG_ 53 VCU_MainBattTypeSta "VCU_MainBatteryTypeStatus ##2G##VCU - VCU18 - CF_Vcu_MainBattType";
CM_ SG_ 53 VCU_MainBattTypeLrnSta "VCU_MainBatteryTypeLearnStatus ##2G##VCU - VCU18 - CF_Vcu_MainBattTypeLrnSts";
CM_ SG_ 53 VCU_WarmupCycSta "VCU_WarmupCycleStatus ##2G##VCU - VCU1 - CF_Vcu_WarmupCyc";
CM_ SG_ 53 VCU_FatcPermPwrVal "VCU_FatcPermissionPowerValue ##2G##VCU - VCU5 - CR_Vcu_ClimatePerm_W";
CM_ SG_ 53 VCU_GearPosStaDisp "VCU_GearPositionStatusDisp";
CM_ SG_ 53 VCU_PdlStopCtrlSta "Cooperative control state of VCU for stop assist control with IEB";
CM_ SG_ 53 VCU_PdlStopReqTqNmVal "Requested brake torque for cooperative stop assist control";
CM_ SG_ 53 VCU_PMPDActSta "PMPD Function Active State";
CM_ SG_ 53 VCU_PMPDWarnSta "PMPD Function Warning State";
CM_ SG_ 53 VCU_VgsVirSoundBackFireIndex "Virtual sound back fire noise index for VGS mode";
CM_ SG_ 53 VCU_VgsVirEngSpdRpmVal "Virtual engine speed for VGS mode";
CM_ SG_ 53 VCU_RdySta "VCU_ReadyStatus ##2G##VCU - VCU1 - CF_Vcu_Rdy";
CM_ SG_ 53 VCU_VgsVirSoundVolume "Virtual engine sound volume for VGS mode[%]";
CM_ SG_ 53 VCU_VgsVirGearStep "Shift gear when entering VGS mode";
CM_ SG_ 53 VCU_StandbyModSta "Stand by Mode Status";
CM_ SG_ 53 VCU_HVIntLkDischrgReq "VCU_HighVoltageInterlockDischargeRequest";
CM_ SG_ 53 VCU_StartKeyHoldSta "VCU_StartKeyHoldStatus ##2G##VCU - VCU1 - CF_Vcu_Key_ST";
CM_ SG_ 53 VCU_EvDrvRdySta "VCU_EvDriveReadyStatus ##2G##VCU - VCU1 - CF_Vcu_EvRdy";
CM_ SG_ 53 VCU_MotPwrEnReq "VCU_MotorPowerEnableRequest ##2G##VCU - VCU3 - CF_Vcu_MotPwrEna";
CM_ SG_ 53 VCU_GearPosSta "VCU_GearPositionStatus ##2G##VCU - VCU1 - CF_Vcu_GarSelDisp";
CM_ SG_ 53 VCU_LdcInhReq "VCU_LdcInhibitRequest ##2G##VCU - VCU5 - CF_Vcu_LdcInh";
CM_ SG_ 53 VCU_MainRlyOffReq "VCU_MainRelayCutOffRequest ##2G##VCU - VCU1 - CF_Vcu_RelayOffReq";
CM_ SG_ 53 VCU_AccPedDepVal "VCU_AcceleratorPedalDepthValue ##2G##VCU - VCU1 - CR_Vcu_AccPedDep_Pc";
CM_ SG_ 53 VCU_FatcOperPermSta "VCU_FatcOperatingPermissionStatus ##2G##VCU - VCU20 - CF_Vcu_ClimateOperPerm";
CM_ SG_ 53 VCU_DrvCycSta "VCU_DrivingCycleStatus ##2G##VCU - VCU1 - CF_Vcu_Veh_DC";
CM_ SG_ 53 VCU_CltActOpSta "VCU_ClutchActuatorOperatingStatus";
CM_ SG_ 53 VCU_WhlSpdSnsrAlvReq "VCU_WheelSpeedSensorAliveRequest";
CM_ SG_ 53 VCU_DrvModOpSta "VCU's operating drive mode according to CLU and DMIC signals";
CM_ SG_ 53 VCU_HydBrkFcHoldRq "Hydraulic brake force holding request from VCU";
CM_ SG_ 53 VCU_FatcPwrUseVal "VCU_FatcPowerUseValue ##2G##VCU - VCU5 - CR_Vcu_FatcCst";
CM_ SG_ 53 VCU_WhlDemTqVal "VCU_WheelDemandTorqueValue ##2G##VCU - VCU2 - CR_Vcu_WhlDemTq_Nm";
CM_ SG_ 53 VCU_McuAntiJerkInhFrntSta "VCU_McuAntiJerkInhibitionFrontStatus";
CM_ SG_ 53 VCU_McuAntiJerkInhRearSta "VCU_McuAntiJerkInhibitionRearStatus ##2G##VCU - VCU3 - CF_Vcu_MCUAntiJerkInh";
CM_ SG_ 53 VCU_McuPwrLatchHoldReq "VCU_McuPowerLatchHoldRequest ##2G##VCU - VCU20 - CF_Vcu_McuPwrLatchHoldReq";
CM_ SG_ 53 VCU_ScuParkReq "VCU_ScuParkingRequest ##2G##VCU - VCU12 - CF_Vcu_PARKCMD";
CM_ SG_ 53 VCU_MotTqCmdFrntVal "VCU_MotorTorqueCommandFrontValue";
CM_ BO_ 1278 "[PE] Periodic and On Event";
CM_ SG_ 1278 BLTN_CAM_FD_DCM_Crc0Val "BLTN_CAM_FD_DCM_CyclicRedundancyCheck0Value";
CM_ SG_ 1278 DCM_VideoOut_Interface_Ver_Major "DCM video output interface major version ASCII Code Value (HEX)";
CM_ SG_ 1278 DCM_VideoOut_Interface_Ver_Minor "DCM video output interface minor version ASCII Code Value (HEX)";
CM_ SG_ 1278 BLTN_CAM_FD_DCM_AlvCnt0Val "BLTN_CAM_FD_DCM_AliveCounter0Value";
CM_ SG_ 1278 BLTN_CAM_HW_Platform_Ver_Major "0x0~0xD:Minor version, 0~13 dec , 0xE : Default(the information is not checked yet.) ,   0xF : Invalid";
CM_ SG_ 1278 BLTN_CAM_HW_Platform_Ver_Minor "0x0~0xD:Minor version, 0~13 dec , 0xE : Default(the information is not checked yet.) ,   0xF : Invalid";
CM_ SG_ 1278 RearCamera_HW_Ver_Major "0x0~0x0D: Major version, ASCII Code Value (HEX)";
CM_ SG_ 1278 RearCamera_HW_Ver_Minor "0x0~0x63:Minor version, 0~99 dec";
CM_ SG_ 1278 RearCamera_SW_Ver_Major "0x0~0x0D: Major version, ASCII Code Value (HEX)";
CM_ SG_ 1278 RearCamera_SW_Ver_Minor "0x0~0x63:Minor version, 0~99 dec";
CM_ SG_ 1278 RearCamera_ISP_Ver0 "0x0~0x63: Version0, 0~99 dec /0x64~0x7E:Reserved/0x7F:Invalid";
CM_ SG_ 1278 RearCamera_ISP_Ver1 "0x0~0x63: Version1, 0~99 dec /0x64~0x7E:Reserved/0x7F:Invalid";
CM_ SG_ 1278 RearCamera_ISP_Ver2 "0x0~0x63:Version2, 0~99 dec /0x64~0x7E:Reserved/0x7F:Invalid";
CM_ SG_ 1278 RearCamera_ISP_Ver3 "0x0~0x63:Version3, 0~99 dec /0x64~0x7E:Reserved/0x7F:Invalid";
CM_ SG_ 1278 DCM_Output_Color_Fromat "0x0 : Default/ 0x1 : YUV422/0x2 : RGB888/0x3 ~ 0x6 : Reserved/0x7: Invalid";
CM_ SG_ 1278 DCM_Output_Color_bit_Num "0x0 : Default/0x1 : 8bit/0x2 : 16bit/0x3 : 24bit/0x4 : 32bit/0x5 ~ 0x6 : Reserved/0x7: Invalif";
CM_ SG_ 1278 RearCamera_Lenz_Ver "0x0 : Initial Version, 0x1 : Improvement - First, 0x2 : Improvement - Second, 0x3 : Improvement - Third, 0x4 ~0x5 : Reserved, 0x6 : Default(The lenz information is not checked yet.), 0x7 : Invalid";
CM_ BO_ 1279 "[PE] Periodic and On Event";
CM_ SG_ 1279 DCM_HW_Ver_Major "DCM_HW_Ver_Major";
CM_ SG_ 1279 DCM_HW_Ver_Minor "DCM_HW_Ver_Minor";
CM_ SG_ 1279 DCM_ResetOpSta "This signal indicates whether the reset operation has been completed or not";
CM_ SG_ 1279 DCM_SW_Ver_1st_Digit "0x0~0xFF: Software version 1st Digit, ASCII Code Value (HEX)";
CM_ SG_ 1279 DCM_SW_Ver_2nd_Digit "Software version 2nd Digit, ASCII Code Value (HEX)";
CM_ SG_ 1279 DCM_SW_Ver_3rd_Digit "Software version 3rd Digit, ASCII Code Value (HEX)";
CM_ SG_ 1279 DCM_SW_Ver_4th_Digit "Software version 4th Digit, ASCII Code Value (HEX)";
CM_ BO_ 1276 "[EC] On Event and On Change";
CM_ SG_ 1276 DCM_Output_Reset_Req "DCM_Output_Reset_Req";
CM_ SG_ 1276 Resolution_Req_Width "Built-in Cam DCM Output Request Resolution Width";
CM_ SG_ 1276 Resolution_Req_Height "Built-in Cam DCM Output Request Resolution Height";
CM_ SG_ 1276 Center_offset_Width_set "Built-in Cam DCM Output Request Width pixel offset from Center";
CM_ SG_ 1276 Center_offset_Height_set "Built-in Cam DCM Output Request Height pixel offset from Center";
CM_ SG_ 1276 DCM_FPS_Change "Requested Rear Camera FPS";
CM_ BO_ 1277 "[PE] Periodic and On Event";
CM_ SG_ 1277 BLTN_CAM_FD_DCM_Crc1Val "BLTN_CAM_FD_DCM_CyclicRedundancyCheck1Value";
CM_ SG_ 1277 RearCamera_EmbeddedData0 "RearCamera_EmbeddedData0";
CM_ SG_ 1277 RearCamera_EmbeddedData1 "RearCamera_EmbeddedData1";
CM_ SG_ 1277 RearCamera_EmbeddedData2 "RearCamera_EmbeddedData2";
CM_ SG_ 1277 RearCamera_EmbeddedData3 "RearCamera_EmbeddedData3";
CM_ SG_ 1277 BLTN_CAM_FD_DCM_AlvCnt1Val "BLTN_CAM_FD_DCM_AliveCounter1Value";
CM_ SG_ 1277 BLTN_CAM_DCM_Status "DCM display output state of the built-in cam.";
CM_ SG_ 1277 RearCamera_Input_Status "Built-in Camera Rear Camera Input Status";
CM_ SG_ 1277 DCM_Output_Resolution_Width "Built-in Cam DCM Output Resolution Width";
CM_ SG_ 1277 DCM_Output_Resolution_Height "Built-in Cam DCM Output Resolution Height";
CM_ SG_ 1277 Center_offset_Width "0x000~0x800: 0~2048 dec/0x801~0xFFD: -1~ -2046  :  ( -1 * (Req_Center_Width - 0x800))/0xFFF:Invalid";
CM_ SG_ 1277 Center_offset_Height "0x000~0x800: 0~2048 dec/0x801~0xFFE: -1~ -2047 dec  :  ( -1 * (Req_Center_Height - 0x800))/0xFFF:Invalid";
CM_ SG_ 1277 FPS_RearCamera "FPS_RearCamera";
CM_ SG_ 1277 FPS_DCM_Output "DCM output FPS";
CM_ BO_ 69 "[P] Periodic";
CM_ SG_ 69 HTCU_Crc4Val "HTCU_CyclicRedundancyCheck4Value";
CM_ SG_ 69 HTCU_PrgrmSta "HTCU_ProgramStatus";
CM_ SG_ 69 HTCU_FsCltchLmphmActvSta "HTCU_FsClutchLimphomeActivationStatus";
CM_ SG_ 69 HTCU_FsIdleTrgtRpmVal "HTCU_FsIdleTargetRpmValue";
CM_ SG_ 69 HTCU_FsAddtnlTqLssPcVal "HTCU_FsAdditionalTorqueLossPcValue";
CM_ SG_ 69 HTCU_FsEngTqRdctnPcVal "HTCU_FsEngineTorqueReductionPcValue";
CM_ SG_ 69 HTCU_LnPrsBarVal "HTCU_LinePressureBarValue";
CM_ SG_ 69 HTCU_RapidKDReq "HTCU_RapidKDRequest";
CM_ SG_ 69 HTCU_CurrGearSta "HTCU_CurrentGearStatus";
CM_ SG_ 69 HTCU_GearShftUpDisGSI "HTCU_GearShiftUpDisplayGSI";
CM_ SG_ 69 HTCU_GearShftDnDisGSI "HTCU_GearShiftDownDisplayGSI";
CM_ SG_ 69 HTCU_TrgtGearStaGSI "HTCU_TargetGearStatusGSI";
CM_ SG_ 69 HTCU_SolBSta "HTCU_SolenoidBStatus";
CM_ SG_ 69 HTCU_AlvCnt4Val "HTCU_AliveCounter4Value";
CM_ SG_ 69 HTCU_TqRdctnNegativePcVal "HTCU_TorqueReductionNegativePcValue";
CM_ SG_ 69 HTCU_PddlShftMdSlctSta "When the user uses a paddle shifter, this signal shows the selected mode (Paddle Step Control / Manual Shift) by USM (TMED HEV AT only)";
CM_ SG_ 69 HTCU_PrkReleaseReq "HTCU_ParkReleaseRequest";
CM_ SG_ 69 HTCU_TrgtGearSta "HTCU_TargetGearStatus";
CM_ SG_ 69 HTCU_RdySta "HTCU_ReadyStatus";
CM_ SG_ 69 HTCU_GearChgSta "HTCU_GearChangeStatus";
CM_ SG_ 69 HTCU_TqRdctnPcVal "HTCU_TorqueReductionPcValue";
CM_ SG_ 69 HTCU_FltSta "HTCU_FaultStatus";
CM_ SG_ 69 HTCU_GearSlctrDis "HTCU_GearSelectDisplay";
CM_ SG_ 69 HTCU_SlwTqRdctnPcVal "HTCU_SlowTorqueReductionPcValue";
CM_ SG_ 69 HTCU_PddlShftUpDn "Paddle Shift Up(Plus)/Dn(Minus)";
CM_ SG_ 69 HTCU_FanCtrlReq "Fan control request by OPU";
CM_ SG_ 69 HTCU_VehSpdKphVal "HTCU_VehicleSpeedKphValue";
CM_ SG_ 69 HTCU_VehSpdDcmlKphVal "HTCU_VehicleSpeedDecimalKphValue";
CM_ SG_ 69 HTCU_HvOpuSpdCmdRpmVal "HTCU_HvOpuSpeedCommandRpmValue";
CM_ SG_ 69 HTCU_TrgtShftClsCCanSta "HTCU_TargetShiftClassCCanStatus";
BA_DEF_ BO_  "GenMsgEVName" STRING ;
BA_DEF_ BO_  "NmAsrMessage" ENUM  "No","Yes";
BA_DEF_ BO_  "DiagState" ENUM  "No","Yes";
BA_DEF_ BO_  "DiagRequest" ENUM  "No","Yes";
BA_DEF_ BO_  "TpMessage" ENUM  "No","Yes";
BA_DEF_ BO_  "UsrMsgIDSforwardDeviation" INT 0 100;
BA_DEF_ BO_  "UsrMsgIDSbackwardDeviation" INT 50 1000;
BA_DEF_ BO_  "GenMsgCycleTime" INT 0 2000;
BA_DEF_ BO_  "GenMsgStartDelayTime" INT 0 2000;
BA_DEF_ BO_  "GenMsgSendType" ENUM  "Cyclic","NoMsgSendType";
BA_DEF_ BO_  "GenMsgCycleTimeFast" INT 0 500;
BA_DEF_ BO_  "GenMsgDelayTime" INT 0 20;
BA_DEF_ BO_  "GenMsgILSupport" ENUM  "No","Yes";
BA_DEF_ BO_  "GenMsgNrOfRepetition" INT 0 3;
BA_DEF_ BO_  "VFrameFormat" ENUM  "StandardCAN","ExtendedCAN","reserved","reserved","reserved","reserved","reserved","reserved","reserved","reserved","reserved","reserved","reserved","reserved","StandardCAN_FD","ExtendedCAN_FD";
BA_DEF_ SG_  "UserSigValidity" ENUM  "B+","ACC","IG","IG1","IG2","IG3","IG1 or IG2","IG1 or IG3","Undef";
BA_DEF_ SG_  "TimeoutValue" STRING ;
BA_DEF_ SG_  "UsrSigPurpose" ENUM  "Undef","FN","DIAG","DIAG(Req)","DIAG(Res)","DIAG(Func)","DEV","CCP","NM","TP";
BA_DEF_ SG_  "GenSigStartValue" INT 0 1215752192;
BA_DEF_ SG_  "NetworkRequest" ENUM  "Yes","No";
BA_DEF_ SG_  "NetworkRequestHoldingTime" INT 0 65535;
BA_DEF_ SG_  "Description" STRING ;
BA_DEF_ SG_  "Version" STRING ;
BA_DEF_ SG_  "GenSigEnvVarType" ENUM  "Int","Float","Undef";
BA_DEF_ SG_  "GenSigSendType" ENUM  "Cyclic","OnWrite","OnWriteWithRepetition","OnChange","OnChangeWithRepetition","IfActive","IfActiveWithRepetition","NoSigSendType","OnChangeAndIfActive","OnChangeAndIfActiveWithRepetition";
BA_DEF_ SG_  "GwSigLatencyTime" INT 0 65536;
BA_DEF_ SG_  "GwSigMissingSourceType" ENUM  "Undef","OldValue","DefaultValue","InitialValue";
BA_DEF_ SG_  "NWM-WakeupAllowed" ENUM  "<n.a.>";
BA_DEF_ SG_  "RoutingFactor" INT 1 1215752192;
BA_DEF_ SG_  "SystemSignalLongSymbol" STRING ;
BA_DEF_REL_ BU_SG_REL_  "GenSigTimeoutTime" INT 0 7000;
BA_DEF_DEF_  "GenMsgEVName" "@Signame";
BA_DEF_DEF_  "NmAsrMessage" "No";
BA_DEF_DEF_  "DiagState" "No";
BA_DEF_DEF_  "DiagRequest" "No";
BA_DEF_DEF_  "TpMessage" "No";
BA_DEF_DEF_  "UsrMsgIDSforwardDeviation" 10;
BA_DEF_DEF_  "UsrMsgIDSbackwardDeviation" 100;
BA_DEF_DEF_  "GenMsgCycleTime" 200;
BA_DEF_DEF_  "GenMsgStartDelayTime" 0;
BA_DEF_DEF_  "GenMsgSendType" "NoMsgSendType";
BA_DEF_DEF_  "GenMsgCycleTimeFast" 40;
BA_DEF_DEF_  "GenMsgDelayTime" 20;
BA_DEF_DEF_  "GenMsgILSupport" "Yes";
BA_DEF_DEF_  "GenMsgNrOfRepetition" 3;
BA_DEF_DEF_  "VFrameFormat" "StandardCAN";
BA_DEF_DEF_  "UserSigValidity" "IG";
BA_DEF_DEF_  "TimeoutValue" "";
BA_DEF_DEF_  "UsrSigPurpose" "FN";
BA_DEF_DEF_  "GenSigStartValue" 0;
BA_DEF_DEF_  "NetworkRequest" "No";
BA_DEF_DEF_  "NetworkRequestHoldingTime" 0;
BA_DEF_DEF_  "Description" "";
BA_DEF_DEF_  "Version" "";
BA_DEF_DEF_  "GenSigEnvVarType" "Undef";
BA_DEF_DEF_  "GenSigSendType" "NoSigSendType";
BA_DEF_DEF_  "GwSigLatencyTime" 40;
BA_DEF_DEF_  "GwSigMissingSourceType" "Undef";
BA_DEF_DEF_  "NWM-WakeupAllowed" "<n.a.>";
BA_DEF_DEF_  "RoutingFactor" 1;
BA_DEF_DEF_REL_ "GenSigTimeoutTime" 500;
BA_DEF_DEF_  "SystemSignalLongSymbol" "";
BA_ "GenMsgSendType" BO_ 648 0;
BA_ "VFrameFormat" BO_ 648 14;
BA_ "GenMsgSendType" BO_ 920 0;
BA_ "VFrameFormat" BO_ 920 14;
BA_ "GenMsgSendType" BO_ 918 0;
BA_ "VFrameFormat" BO_ 918 14;
BA_ "GenMsgSendType" BO_ 160 0;
BA_ "GenMsgCycleTime" BO_ 160 50;
BA_ "GenMsgCycleTimeFast" BO_ 160 0;
BA_ "GenMsgNrOfRepetition" BO_ 160 0;
BA_ "VFrameFormat" BO_ 160 14;
BA_ "GenMsgSendType" BO_ 426 0;
BA_ "GenMsgCycleTime" BO_ 426 100;
BA_ "GenMsgCycleTimeFast" BO_ 426 0;
BA_ "GenMsgNrOfRepetition" BO_ 426 0;
BA_ "VFrameFormat" BO_ 426 14;
BA_ "GenMsgSendType" BO_ 293 0;
BA_ "GenMsgCycleTime" BO_ 293 50;
BA_ "GenMsgCycleTimeFast" BO_ 293 0;
BA_ "GenMsgNrOfRepetition" BO_ 293 0;
BA_ "VFrameFormat" BO_ 293 14;
BA_ "GenMsgSendType" BO_ 53 0;
BA_ "GenMsgCycleTime" BO_ 53 50;
BA_ "GenMsgCycleTimeFast" BO_ 53 0;
BA_ "GenMsgNrOfRepetition" BO_ 53 0;
BA_ "VFrameFormat" BO_ 53 14;
BA_ "GenMsgSendType" BO_ 1278 0;
BA_ "GenMsgCycleTime" BO_ 1278 1000;
BA_ "VFrameFormat" BO_ 1278 14;
BA_ "GenMsgSendType" BO_ 1279 0;
BA_ "GenMsgCycleTime" BO_ 1279 1000;
BA_ "VFrameFormat" BO_ 1279 14;
BA_ "GenMsgCycleTime" BO_ 1276 0;
BA_ "VFrameFormat" BO_ 1276 14;
BA_ "GenMsgSendType" BO_ 1277 0;
BA_ "GenMsgCycleTime" BO_ 1277 500;
BA_ "VFrameFormat" BO_ 1277 14;
BA_ "GenMsgSendType" BO_ 69 0;
BA_ "GenMsgCycleTime" BO_ 69 50;
BA_ "GenMsgCycleTimeFast" BO_ 69 0;
BA_ "GenMsgNrOfRepetition" BO_ 69 0;
BA_ "VFrameFormat" BO_ 69 14;
BA_ "Description" SG_ 648 CCU_AP_OTA_Crc1Val "The data area for CRC calculation is based on the data length (DLC) of the message DB.

The CRC shall be calculated over the entire data block (excluding the CRC bytes) including the user data, alive counter and Data ID



- CRC Polynomial (0x1021) , Ini";
BA_ "GenSigSendType" SG_ 648 CCU_AP_OTA_Crc1Val 4;
BA_ "GenSigStartValue" SG_ 648 CCU_AP_OTA_Crc1Val 65535;
BA_ "UserSigValidity" SG_ 648 CCU_AP_OTA_Crc1Val 3;
BA_ "Version" SG_ 648 CCU_AP_OTA_Crc1Val "21.09.03";
BA_ "Description" SG_ 648 CCU_AP_OTA_AlvCnt1Val "For the first transmission request for a data element the counter shall be initialized with 0 and shall be incremented by 1 for every subsequent send request. 

When the counter reaches the maximum value(0xFF), then it shall restart with 0 for the next s";
BA_ "GenSigSendType" SG_ 648 CCU_AP_OTA_AlvCnt1Val 4;
BA_ "UserSigValidity" SG_ 648 CCU_AP_OTA_AlvCnt1Val 3;
BA_ "Version" SG_ 648 CCU_AP_OTA_AlvCnt1Val "21.09.03";
BA_ "GenSigSendType" SG_ 648 CCU_OTA_mode 4;
BA_ "UserSigValidity" SG_ 648 CCU_OTA_mode 0;
BA_ "Version" SG_ 648 CCU_OTA_mode "20.01.01";
BA_ "GenSigSendType" SG_ 648 CCU_OTA_IG3On_request 4;
BA_ "UserSigValidity" SG_ 648 CCU_OTA_IG3On_request 0;
BA_ "Version" SG_ 648 CCU_OTA_IG3On_request "20.01.02";
BA_ "GenSigSendType" SG_ 648 OTA_Cond_Vehicle_Pwr 4;
BA_ "GenSigStartValue" SG_ 648 OTA_Cond_Vehicle_Pwr 1;
BA_ "UserSigValidity" SG_ 648 OTA_Cond_Vehicle_Pwr 0;
BA_ "Version" SG_ 648 OTA_Cond_Vehicle_Pwr "20.11.03";
BA_ "GenSigSendType" SG_ 648 OTA_Cond_Gear_P 4;
BA_ "GenSigStartValue" SG_ 648 OTA_Cond_Gear_P 1;
BA_ "UserSigValidity" SG_ 648 OTA_Cond_Gear_P 0;
BA_ "Version" SG_ 648 OTA_Cond_Gear_P "20.11.03";
BA_ "GenSigSendType" SG_ 648 OTA_Cond_Parking_Brk 4;
BA_ "GenSigStartValue" SG_ 648 OTA_Cond_Parking_Brk 1;
BA_ "UserSigValidity" SG_ 648 OTA_Cond_Parking_Brk 0;
BA_ "Version" SG_ 648 OTA_Cond_Parking_Brk "20.11.03";
BA_ "GenSigSendType" SG_ 648 OTA_Cond_Ext_Lamp 4;
BA_ "GenSigStartValue" SG_ 648 OTA_Cond_Ext_Lamp 1;
BA_ "UserSigValidity" SG_ 648 OTA_Cond_Ext_Lamp 0;
BA_ "Version" SG_ 648 OTA_Cond_Ext_Lamp "20.11.03";
BA_ "GenSigSendType" SG_ 648 OTA_Cond_Hood_Closed 4;
BA_ "GenSigStartValue" SG_ 648 OTA_Cond_Hood_Closed 1;
BA_ "UserSigValidity" SG_ 648 OTA_Cond_Hood_Closed 0;
BA_ "Version" SG_ 648 OTA_Cond_Hood_Closed "20.11.03";
BA_ "Description" SG_ 648 CCU_OTA_req_power_State "Signal for power control during update in electric vehicle power system";
BA_ "GenSigSendType" SG_ 648 CCU_OTA_req_power_State 4;
BA_ "UserSigValidity" SG_ 648 CCU_OTA_req_power_State 0;
BA_ "Version" SG_ 648 CCU_OTA_req_power_State "24.04.06";
BA_ "GenSigSendType" SG_ 648 OTA_Cond_HighBatt 4;
BA_ "GenSigStartValue" SG_ 648 OTA_Cond_HighBatt 1;
BA_ "UserSigValidity" SG_ 648 OTA_Cond_HighBatt 0;
BA_ "Version" SG_ 648 OTA_Cond_HighBatt "25.10.01";
BA_ "Description" SG_ 648 CCU_OTA_Cond_Request "Request for OTA Condition (to EPB, extLamp)";
BA_ "GenSigSendType" SG_ 648 CCU_OTA_Cond_Request 4;
BA_ "UserSigValidity" SG_ 648 CCU_OTA_Cond_Request 0;
BA_ "Version" SG_ 648 CCU_OTA_Cond_Request "22.08.01";
BA_ "GenSigSendType" SG_ 648 CCU_OTA_Tele_Cranking 4;
BA_ "UserSigValidity" SG_ 648 CCU_OTA_Tele_Cranking 0;
BA_ "NetworkRequest" SG_ 648 CCU_OTA_Tele_Cranking 0;
BA_ "NetworkRequestHoldingTime" SG_ 648 CCU_OTA_Tele_Cranking 2000;
BA_ "Version" SG_ 648 CCU_OTA_Tele_Cranking "22.02.02";
BA_ "Description" SG_ 648 OTA_UI_Ready_request "OTA User Approval Popup Request Signal (to ccIC)";
BA_ "GenSigSendType" SG_ 648 OTA_UI_Ready_request 4;
BA_ "UserSigValidity" SG_ 648 OTA_UI_Ready_request 0;
BA_ "Version" SG_ 648 OTA_UI_Ready_request "21.04.00";
BA_ "GenSigSendType" SG_ 648 OTA_Result 4;
BA_ "UserSigValidity" SG_ 648 OTA_Result 0;
BA_ "Version" SG_ 648 OTA_Result "21.02.02";
BA_ "GenSigSendType" SG_ 648 CF_AVN_InterAutoLockMode_Set2_Co 4;
BA_ "UserSigValidity" SG_ 648 CF_AVN_InterAutoLockMode_Set2_Co 3;
BA_ "Version" SG_ 648 CF_AVN_InterAutoLockMode_Set2_Co "20.09.00";
BA_ "SystemSignalLongSymbol" SG_ 648 CF_AVN_InterAutoLockMode_Set2_Co "CF_AVN_InterAutoLockMode_Set2_Copy_1";
BA_ "GenSigSendType" SG_ 648 CCU_OTA_EOU 4;
BA_ "UserSigValidity" SG_ 648 CCU_OTA_EOU 0;
BA_ "Version" SG_ 648 CCU_OTA_EOU "20.09.00";
BA_ "Description" SG_ 920 CTM_FD_Crc2Val "The data area for CRC calculation is based on the data length (DLC) of the message DB.

The CRC shall be calculated over the entire data block (excluding the CRC bytes) including the user data, alive counter and Data ID



- CRC Polynomial (0x1021) , Ini";
BA_ "GenSigSendType" SG_ 920 CTM_FD_Crc2Val 4;
BA_ "GenSigStartValue" SG_ 920 CTM_FD_Crc2Val 65535;
BA_ "UserSigValidity" SG_ 920 CTM_FD_Crc2Val 3;
BA_ "RoutingFactor" SG_ 920 CTM_FD_Crc2Val 0;
BA_ "Version" SG_ 920 CTM_FD_Crc2Val "22.10.21";
BA_ "Description" SG_ 920 ITBC_TrLampTypeSta "Trailer turn signal lamp type

-Separate: turn signal lamp and brake lamp are separate

-Combined: turn signal lamp and brake lamp use same lamp";
BA_ "GenSigSendType" SG_ 920 ITBC_TrLampTypeSta 4;
BA_ "UserSigValidity" SG_ 920 ITBC_TrLampTypeSta 3;
BA_ "RoutingFactor" SG_ 920 ITBC_TrLampTypeSta 0;
BA_ "Version" SG_ 920 ITBC_TrLampTypeSta "25.07.01";
BA_ "Description" SG_ 920 CTM_FD_AlvCnt2Val "For the first transmission request for a data element the counter shall be initialized with 0 and shall be incremented by 1 for every subsequent send request. 

When the counter reaches the maximum value(0xFF), then it shall restart with 0 for the next s";
BA_ "GenSigSendType" SG_ 920 CTM_FD_AlvCnt2Val 4;
BA_ "UserSigValidity" SG_ 920 CTM_FD_AlvCnt2Val 3;
BA_ "RoutingFactor" SG_ 920 CTM_FD_AlvCnt2Val 0;
BA_ "Version" SG_ 920 CTM_FD_AlvCnt2Val "22.10.21";
BA_ "Description" SG_ 920 ITBC_Brk_FaultWarnSta "Request for cluster to provide audible warning & pop up on Trailer Brake out Fail situation(conditions TBD eg fault).

Wiring Fault : Brake malfunction due to trailer brake output Wiring abnormality

Module Fault : Brake malfunction due to ITBC controlle";
BA_ "GenSigSendType" SG_ 920 ITBC_Brk_FaultWarnSta 4;
BA_ "UserSigValidity" SG_ 920 ITBC_Brk_FaultWarnSta 3;
BA_ "RoutingFactor" SG_ 920 ITBC_Brk_FaultWarnSta 0;
BA_ "Version" SG_ 920 ITBC_Brk_FaultWarnSta "24.07.06";
BA_ "Description" SG_ 920 USM_TrailerTypSta "Trailer type status";
BA_ "GenSigSendType" SG_ 920 USM_TrailerTypSta 4;
BA_ "UserSigValidity" SG_ 920 USM_TrailerTypSta 3;
BA_ "RoutingFactor" SG_ 920 USM_TrailerTypSta 0;
BA_ "Version" SG_ 920 USM_TrailerTypSta "24.02.00";
BA_ "Description" SG_ 920 ITBC_TrailerDisplayAppliedSta "ITBC_TrailerDisplayAppliedSta == 0x1 Determines whether to apply ITBC content based on input.

==0x2 Determines whether to apply TCM content based on input.

- Display related information only when the signal is valid (TBC page and pop-up display)";
BA_ "GenSigSendType" SG_ 920 ITBC_TrailerDisplayAppliedSta 4;
BA_ "UserSigValidity" SG_ 920 ITBC_TrailerDisplayAppliedSta 3;
BA_ "RoutingFactor" SG_ 920 ITBC_TrailerDisplayAppliedSta 0;
BA_ "Version" SG_ 920 ITBC_TrailerDisplayAppliedSta "24.10.03";
BA_ "Description" SG_ 920 ITBC_Brk_FnctWarnSta "Request for cluster to provide audible warning & pop up on Trailer Brake out Fail situation (conditions TBD eg fault)";
BA_ "GenSigSendType" SG_ 920 ITBC_Brk_FnctWarnSta 4;
BA_ "UserSigValidity" SG_ 920 ITBC_Brk_FnctWarnSta 3;
BA_ "RoutingFactor" SG_ 920 ITBC_Brk_FnctWarnSta 0;
BA_ "Version" SG_ 920 ITBC_Brk_FnctWarnSta "24.07.06";
BA_ "Description" SG_ 920 ITBC_LampWarnSta "Request for cluster to provide audible warning & pop up on Trailer Lamp Fail situation (conditions TBD eg fault).";
BA_ "GenSigSendType" SG_ 920 ITBC_LampWarnSta 4;
BA_ "UserSigValidity" SG_ 920 ITBC_LampWarnSta 3;
BA_ "RoutingFactor" SG_ 920 ITBC_LampWarnSta 0;
BA_ "Version" SG_ 920 ITBC_LampWarnSta "24.07.06";
BA_ "Description" SG_ 920 ITBC_Brk_DisconnWarnSta "Occurs when the Trailer is not connected and the ITBC switch is operated";
BA_ "GenSigSendType" SG_ 920 ITBC_Brk_DisconnWarnSta 4;
BA_ "UserSigValidity" SG_ 920 ITBC_Brk_DisconnWarnSta 3;
BA_ "RoutingFactor" SG_ 920 ITBC_Brk_DisconnWarnSta 0;
BA_ "Version" SG_ 920 ITBC_Brk_DisconnWarnSta "24.07.06";
BA_ "Description" SG_ 920 ITBC_TrailerBrkOut "Trailer Brake Output sent to cluster. PWM duty cycle 0 - 100%.";
BA_ "GenSigSendType" SG_ 920 ITBC_TrailerBrkOut 4;
BA_ "UserSigValidity" SG_ 920 ITBC_TrailerBrkOut 3;
BA_ "RoutingFactor" SG_ 920 ITBC_TrailerBrkOut 0;
BA_ "Version" SG_ 920 ITBC_TrailerBrkOut "24.07.06";
BA_ "Description" SG_ 920 ITBC_TrailerBrkGainVal "Gain setting 0 - 10 in steps of 0.5 on cluster.";
BA_ "GenSigSendType" SG_ 920 ITBC_TrailerBrkGainVal 4;
BA_ "UserSigValidity" SG_ 920 ITBC_TrailerBrkGainVal 3;
BA_ "RoutingFactor" SG_ 920 ITBC_TrailerBrkGainVal 0;
BA_ "Version" SG_ 920 ITBC_TrailerBrkGainVal "24.02.00";
BA_ "Description" SG_ 920 ITBC_SysWarn "Request for cluster to provide audible warning & pop up (conditions TBD eg fault).";
BA_ "GenSigSendType" SG_ 920 ITBC_SysWarn 4;
BA_ "UserSigValidity" SG_ 920 ITBC_SysWarn 3;
BA_ "RoutingFactor" SG_ 920 ITBC_SysWarn 0;
BA_ "Version" SG_ 920 ITBC_SysWarn "24.04.06";
BA_ "Description" SG_ 920 ITBC_ResetOpSta "This signal indicates whether the reset operation has been completed or not";
BA_ "GenSigSendType" SG_ 920 ITBC_ResetOpSta 4;
BA_ "UserSigValidity" SG_ 920 ITBC_ResetOpSta 0;
BA_ "RoutingFactor" SG_ 920 ITBC_ResetOpSta 0;
BA_ "Version" SG_ 920 ITBC_ResetOpSta "24.05.02";
BA_ "Description" SG_ 920 ITBC_BrkWarn "Request for cluster to provide audible warning & pop up on Trailer Brake out Fail situation (conditions TBD eg fault).";
BA_ "GenSigSendType" SG_ 920 ITBC_BrkWarn 4;
BA_ "UserSigValidity" SG_ 920 ITBC_BrkWarn 3;
BA_ "RoutingFactor" SG_ 920 ITBC_BrkWarn 0;
BA_ "Version" SG_ 920 ITBC_BrkWarn "24.04.06";
BA_ "Description" SG_ 920 ITBC_TrnSigLmpWarn "Request for cluster to provide audible warning & pop up about Trailer Trun Signal Error (conditions TBD eg fault).";
BA_ "GenSigSendType" SG_ 920 ITBC_TrnSigLmpWarn 4;
BA_ "UserSigValidity" SG_ 920 ITBC_TrnSigLmpWarn 3;
BA_ "RoutingFactor" SG_ 920 ITBC_TrnSigLmpWarn 0;
BA_ "Version" SG_ 920 ITBC_TrnSigLmpWarn "24.08.00";
BA_ "Description" SG_ 920 ITBC_StpLmpWarn "Request for cluster to provide audible warning & pop up about Trailer Stop Lamp ERROR(conditions TBD eg fault).";
BA_ "GenSigSendType" SG_ 920 ITBC_StpLmpWarn 4;
BA_ "UserSigValidity" SG_ 920 ITBC_StpLmpWarn 3;
BA_ "RoutingFactor" SG_ 920 ITBC_StpLmpWarn 0;
BA_ "Version" SG_ 920 ITBC_StpLmpWarn "24.04.06";
BA_ "Description" SG_ 920 CTM_TrailerAct "This signal is used for control the Trailer Act function.";
BA_ "GenSigSendType" SG_ 920 CTM_TrailerAct 4;
BA_ "UserSigValidity" SG_ 920 CTM_TrailerAct 3;
BA_ "RoutingFactor" SG_ 920 CTM_TrailerAct 0;
BA_ "Version" SG_ 920 CTM_TrailerAct "24.04.07";
BA_ "Description" SG_ 920 CTM_RearfogAct "This signal is used for display the rear fog lamp mounted on the trailer.";
BA_ "GenSigSendType" SG_ 920 CTM_RearfogAct 4;
BA_ "UserSigValidity" SG_ 920 CTM_RearfogAct 3;
BA_ "NetworkRequest" SG_ 920 CTM_RearfogAct 0;
BA_ "RoutingFactor" SG_ 920 CTM_RearfogAct 0;
BA_ "Version" SG_ 920 CTM_RearfogAct "18.10.07";
BA_ "Description" SG_ 920 CTM_StpLmpOpnSta "Trailer Stop Lamp OpenStatus";
BA_ "GenSigSendType" SG_ 920 CTM_StpLmpOpnSta 4;
BA_ "UserSigValidity" SG_ 920 CTM_StpLmpOpnSta 3;
BA_ "NetworkRequest" SG_ 920 CTM_StpLmpOpnSta 0;
BA_ "RoutingFactor" SG_ 920 CTM_StpLmpOpnSta 0;
BA_ "Version" SG_ 920 CTM_StpLmpOpnSta "18.10.07";
BA_ "Description" SG_ 920 CTM_TrnSigLmpLftOpnSta "Trailer T/SIG Lamp Left OpenStatus";
BA_ "GenSigSendType" SG_ 920 CTM_TrnSigLmpLftOpnSta 4;
BA_ "UserSigValidity" SG_ 920 CTM_TrnSigLmpLftOpnSta 3;
BA_ "NetworkRequest" SG_ 920 CTM_TrnSigLmpLftOpnSta 0;
BA_ "RoutingFactor" SG_ 920 CTM_TrnSigLmpLftOpnSta 0;
BA_ "Version" SG_ 920 CTM_TrnSigLmpLftOpnSta "18.10.07";
BA_ "Description" SG_ 920 CTM_TrnSigLmpRtOpnSta "Trailer T/SIG Lamp Right OpenStatus";
BA_ "GenSigSendType" SG_ 920 CTM_TrnSigLmpRtOpnSta 4;
BA_ "UserSigValidity" SG_ 920 CTM_TrnSigLmpRtOpnSta 3;
BA_ "NetworkRequest" SG_ 920 CTM_TrnSigLmpRtOpnSta 0;
BA_ "RoutingFactor" SG_ 920 CTM_TrnSigLmpRtOpnSta 0;
BA_ "Version" SG_ 920 CTM_TrnSigLmpRtOpnSta "18.10.07";
BA_ "Description" SG_ 920 CTM_ExtTailLmpLftOpnSta "Trailer Exterior Tail Lamp Left OpenStatus";
BA_ "GenSigSendType" SG_ 920 CTM_ExtTailLmpLftOpnSta 4;
BA_ "UserSigValidity" SG_ 920 CTM_ExtTailLmpLftOpnSta 3;
BA_ "NetworkRequest" SG_ 920 CTM_ExtTailLmpLftOpnSta 0;
BA_ "RoutingFactor" SG_ 920 CTM_ExtTailLmpLftOpnSta 0;
BA_ "Version" SG_ 920 CTM_ExtTailLmpLftOpnSta "18.10.07";
BA_ "Description" SG_ 920 CTM_ExtTailLmpRtOpnSta "Trailer Exterior Tail Lamp Right OpenStatus";
BA_ "GenSigSendType" SG_ 920 CTM_ExtTailLmpRtOpnSta 4;
BA_ "UserSigValidity" SG_ 920 CTM_ExtTailLmpRtOpnSta 3;
BA_ "NetworkRequest" SG_ 920 CTM_ExtTailLmpRtOpnSta 0;
BA_ "RoutingFactor" SG_ 920 CTM_ExtTailLmpRtOpnSta 0;
BA_ "Version" SG_ 920 CTM_ExtTailLmpRtOpnSta "18.10.07";
BA_ "Description" SG_ 920 CTM_Exra_EbrakSta "Trailer Ebrake Controller ActiveStatus";
BA_ "GenSigSendType" SG_ 920 CTM_Exra_EbrakSta 4;
BA_ "UserSigValidity" SG_ 920 CTM_Exra_EbrakSta 0;
BA_ "RoutingFactor" SG_ 920 CTM_Exra_EbrakSta 0;
BA_ "Version" SG_ 920 CTM_Exra_EbrakSta "21.06.10";
BA_ "Description" SG_ 920 CTM_TrlAngl_200ms "This signal is used to provide the Trailer Angle(Kink Angle) between vehicle and trailer(200ms).";
BA_ "GenSigSendType" SG_ 920 CTM_TrlAngl_200ms 4;
BA_ "UserSigValidity" SG_ 920 CTM_TrlAngl_200ms 3;
BA_ "RoutingFactor" SG_ 920 CTM_TrlAngl_200ms 0;
BA_ "Version" SG_ 920 CTM_TrlAngl_200ms "22.07.06";
BA_ "Description" SG_ 920 TCM_ResetOpSta "This signal indicates whether the reset operation has been completed or not";
BA_ "GenSigSendType" SG_ 920 TCM_ResetOpSta 4;
BA_ "UserSigValidity" SG_ 920 TCM_ResetOpSta 0;
BA_ "RoutingFactor" SG_ 920 TCM_ResetOpSta 0;
BA_ "Version" SG_ 920 TCM_ResetOpSta "25.01.02";
BA_ "Description" SG_ 918 CMS_LH_FD_Crc1Val "The data area for CRC calculation is based on the data length (DLC) of the message DB.

The CRC shall be calculated over the entire data block (excluding the CRC bytes) including the user data, alive counter and Data ID



- CRC Polynomial (0x1021) , Ini";
BA_ "GenSigSendType" SG_ 918 CMS_LH_FD_Crc1Val 4;
BA_ "GenSigStartValue" SG_ 918 CMS_LH_FD_Crc1Val 65535;
BA_ "UserSigValidity" SG_ 918 CMS_LH_FD_Crc1Val 3;
BA_ "RoutingFactor" SG_ 918 CMS_LH_FD_Crc1Val 0;
BA_ "Version" SG_ 918 CMS_LH_FD_Crc1Val "22.10.20";
BA_ "Description" SG_ 918 IMS_CMSPlayBackSta_LH "Applied from standard DB 2.0";
BA_ "GenSigSendType" SG_ 918 IMS_CMSPlayBackSta_LH 4;
BA_ "UserSigValidity" SG_ 918 IMS_CMSPlayBackSta_LH 0;
BA_ "NetworkRequest" SG_ 918 IMS_CMSPlayBackSta_LH 0;
BA_ "NetworkRequestHoldingTime" SG_ 918 IMS_CMSPlayBackSta_LH 5000;
BA_ "RoutingFactor" SG_ 918 IMS_CMSPlayBackSta_LH 0;
BA_ "Version" SG_ 918 IMS_CMSPlayBackSta_LH "23.02.06";
BA_ "GenSigSendType" SG_ 918 CMSFldReq 4;
BA_ "UserSigValidity" SG_ 918 CMSFldReq 0;
BA_ "NetworkRequest" SG_ 918 CMSFldReq 0;
BA_ "NetworkRequestHoldingTime" SG_ 918 CMSFldReq 5000;
BA_ "RoutingFactor" SG_ 918 CMSFldReq 0;
BA_ "Version" SG_ 918 CMSFldReq "21.08.01";
BA_ "GenSigSendType" SG_ 918 CMS_LH_FoldingSta 4;
BA_ "UserSigValidity" SG_ 918 CMS_LH_FoldingSta 0;
BA_ "NetworkRequest" SG_ 918 CMS_LH_FoldingSta 0;
BA_ "NetworkRequestHoldingTime" SG_ 918 CMS_LH_FoldingSta 5000;
BA_ "RoutingFactor" SG_ 918 CMS_LH_FoldingSta 0;
BA_ "Version" SG_ 918 CMS_LH_FoldingSta "21.08.01";
BA_ "GenSigSendType" SG_ 918 CMS_LH_UnfoldingSta 4;
BA_ "UserSigValidity" SG_ 918 CMS_LH_UnfoldingSta 0;
BA_ "NetworkRequest" SG_ 918 CMS_LH_UnfoldingSta 0;
BA_ "NetworkRequestHoldingTime" SG_ 918 CMS_LH_UnfoldingSta 5000;
BA_ "RoutingFactor" SG_ 918 CMS_LH_UnfoldingSta 0;
BA_ "Version" SG_ 918 CMS_LH_UnfoldingSta "21.08.01";
BA_ "Description" SG_ 918 CMS_LHVerPosVal "This signal indicates LH Outside Mirror Vertical Position Sensor Voltage";
BA_ "GenSigSendType" SG_ 918 CMS_LHVerPosVal 4;
BA_ "UserSigValidity" SG_ 918 CMS_LHVerPosVal 0;
BA_ "NetworkRequest" SG_ 918 CMS_LHVerPosVal 0;
BA_ "NetworkRequestHoldingTime" SG_ 918 CMS_LHVerPosVal 5000;
BA_ "RoutingFactor" SG_ 918 CMS_LHVerPosVal 0;
BA_ "Version" SG_ 918 CMS_LHVerPosVal "21.08.01";
BA_ "Description" SG_ 918 CMS_LHHorPosVal "This signal indicates LH Outside Mirror Horizontal Position Sensor Voltage";
BA_ "GenSigSendType" SG_ 918 CMS_LHHorPosVal 4;
BA_ "UserSigValidity" SG_ 918 CMS_LHHorPosVal 0;
BA_ "NetworkRequest" SG_ 918 CMS_LHHorPosVal 0;
BA_ "NetworkRequestHoldingTime" SG_ 918 CMS_LHHorPosVal 5000;
BA_ "RoutingFactor" SG_ 918 CMS_LHHorPosVal 0;
BA_ "Version" SG_ 918 CMS_LHHorPosVal "21.08.01";
BA_ "Description" SG_ 918 CMS_LHSta "CMS_LH Status";
BA_ "GenSigSendType" SG_ 918 CMS_LHSta 4;
BA_ "UserSigValidity" SG_ 918 CMS_LHSta 0;
BA_ "RoutingFactor" SG_ 918 CMS_LHSta 0;
BA_ "Version" SG_ 918 CMS_LHSta "21.08.01";
BA_ "Description" SG_ 918 CMS_Opt "CMS option information";
BA_ "GenSigSendType" SG_ 918 CMS_Opt 4;
BA_ "UserSigValidity" SG_ 918 CMS_Opt 0;
BA_ "RoutingFactor" SG_ 918 CMS_Opt 0;
BA_ "Version" SG_ 918 CMS_Opt "21.08.01";
BA_ "Description" SG_ 918 CMS_LH_FD_AlvCnt1Val "For the first transmission request for a data element the counter shall be initialized with 0 and shall be incremented by 1 for every subsequent send request. 

When the counter reaches the maximum value(0xFF), then it shall restart with 0 for the next s";
BA_ "GenSigSendType" SG_ 918 CMS_LH_FD_AlvCnt1Val 4;
BA_ "UserSigValidity" SG_ 918 CMS_LH_FD_AlvCnt1Val 3;
BA_ "RoutingFactor" SG_ 918 CMS_LH_FD_AlvCnt1Val 0;
BA_ "Version" SG_ 918 CMS_LH_FD_AlvCnt1Val "22.10.20";
BA_ "GenSigSendType" SG_ 918 Monitor_ViewPanningCmd 4;
BA_ "UserSigValidity" SG_ 918 Monitor_ViewPanningCmd 0;
BA_ "NetworkRequest" SG_ 918 Monitor_ViewPanningCmd 0;
BA_ "NetworkRequestHoldingTime" SG_ 918 Monitor_ViewPanningCmd 5000;
BA_ "RoutingFactor" SG_ 918 Monitor_ViewPanningCmd 0;
BA_ "Version" SG_ 918 Monitor_ViewPanningCmd "21.08.01";
BA_ "Description" SG_ 918 DSM_LH_ResetOpSta "This signal indicates whether the reset operation has been completed or not";
BA_ "GenSigSendType" SG_ 918 DSM_LH_ResetOpSta 4;
BA_ "UserSigValidity" SG_ 918 DSM_LH_ResetOpSta 0;
BA_ "RoutingFactor" SG_ 918 DSM_LH_ResetOpSta 0;
BA_ "Version" SG_ 918 DSM_LH_ResetOpSta "24.05.01";
BA_ "GenSigSendType" SG_ 918 USM_TurnDstLnDispSta 4;
BA_ "UserSigValidity" SG_ 918 USM_TurnDstLnDispSta 0;
BA_ "NetworkRequest" SG_ 918 USM_TurnDstLnDispSta 0;
BA_ "NetworkRequestHoldingTime" SG_ 918 USM_TurnDstLnDispSta 5000;
BA_ "RoutingFactor" SG_ 918 USM_TurnDstLnDispSta 0;
BA_ "Version" SG_ 918 USM_TurnDstLnDispSta "21.08.01";
BA_ "GenSigSendType" SG_ 918 USM_TurnDstLnDispStaRH 4;
BA_ "UserSigValidity" SG_ 918 USM_TurnDstLnDispStaRH 0;
BA_ "NetworkRequest" SG_ 918 USM_TurnDstLnDispStaRH 0;
BA_ "NetworkRequestHoldingTime" SG_ 918 USM_TurnDstLnDispStaRH 5000;
BA_ "RoutingFactor" SG_ 918 USM_TurnDstLnDispStaRH 0;
BA_ "Version" SG_ 918 USM_TurnDstLnDispStaRH "21.08.01";
BA_ "GenSigSendType" SG_ 918 USM_RhstaLvlEnaSta 4;
BA_ "UserSigValidity" SG_ 918 USM_RhstaLvlEnaSta 0;
BA_ "NetworkRequest" SG_ 918 USM_RhstaLvlEnaSta 0;
BA_ "NetworkRequestHoldingTime" SG_ 918 USM_RhstaLvlEnaSta 5000;
BA_ "RoutingFactor" SG_ 918 USM_RhstaLvlEnaSta 0;
BA_ "Version" SG_ 918 USM_RhstaLvlEnaSta "21.08.01";
BA_ "GenSigSendType" SG_ 918 USM_RhstaLvlEnaStaRH 4;
BA_ "UserSigValidity" SG_ 918 USM_RhstaLvlEnaStaRH 0;
BA_ "NetworkRequest" SG_ 918 USM_RhstaLvlEnaStaRH 0;
BA_ "NetworkRequestHoldingTime" SG_ 918 USM_RhstaLvlEnaStaRH 5000;
BA_ "RoutingFactor" SG_ 918 USM_RhstaLvlEnaStaRH 0;
BA_ "Version" SG_ 918 USM_RhstaLvlEnaStaRH "21.08.01";
BA_ "GenSigSendType" SG_ 918 USM_CMSDayBrgtnsLvlLHSta 4;
BA_ "GenSigStartValue" SG_ 918 USM_CMSDayBrgtnsLvlLHSta 5;
BA_ "UserSigValidity" SG_ 918 USM_CMSDayBrgtnsLvlLHSta 0;
BA_ "NetworkRequest" SG_ 918 USM_CMSDayBrgtnsLvlLHSta 0;
BA_ "NetworkRequestHoldingTime" SG_ 918 USM_CMSDayBrgtnsLvlLHSta 5000;
BA_ "RoutingFactor" SG_ 918 USM_CMSDayBrgtnsLvlLHSta 0;
BA_ "Version" SG_ 918 USM_CMSDayBrgtnsLvlLHSta "21.08.01";
BA_ "GenSigSendType" SG_ 918 USM_CMSNgtBrgtnsLvlLHSta 4;
BA_ "GenSigStartValue" SG_ 918 USM_CMSNgtBrgtnsLvlLHSta 5;
BA_ "UserSigValidity" SG_ 918 USM_CMSNgtBrgtnsLvlLHSta 0;
BA_ "NetworkRequest" SG_ 918 USM_CMSNgtBrgtnsLvlLHSta 0;
BA_ "NetworkRequestHoldingTime" SG_ 918 USM_CMSNgtBrgtnsLvlLHSta 5000;
BA_ "RoutingFactor" SG_ 918 USM_CMSNgtBrgtnsLvlLHSta 0;
BA_ "Version" SG_ 918 USM_CMSNgtBrgtnsLvlLHSta "21.08.01";
BA_ "Description" SG_ 160 WHL_Crc1Val "The data area for CRC calculation is based on the data length (DLC) of the message DB.

The CRC shall be calculated over the entire data block (excluding the CRC bytes) including the user data, alive counter and Data ID



- CRC Polynomial (0x1021) , Ini";
BA_ "GenSigStartValue" SG_ 160 WHL_Crc1Val 65535;
BA_ "UserSigValidity" SG_ 160 WHL_Crc1Val 3;
BA_ "RoutingFactor" SG_ 160 WHL_Crc1Val 5;
BA_ "Version" SG_ 160 WHL_Crc1Val "21.09.03";
BA_ "Description" SG_ 160 WHL_SpdRRVal "This signal provides the wheel velocity of each wheel and have 14 bits length and a resolution of 0.03125 km^h.(This resolution is higher than that of signal in TCS5).

In case of failure of one wheel speed sensor, the value 3FFFH is used as error identi";
BA_ "UserSigValidity" SG_ 160 WHL_SpdRRVal 3;
BA_ "RoutingFactor" SG_ 160 WHL_SpdRRVal 5;
BA_ "Version" SG_ 160 WHL_SpdRRVal "17.12.00";
BA_ "Description" SG_ 160 WHL_SpdCalParmtr "이 신호는 ABS/ESC 내부에서 휠 펄스 값을 휠 스피드로 변환하는데 사용하는 ESC 내부 파라미터를 의미함.

본 신호는 실제 타이어 동반경과 다를 수 있으며, ABS/ESC의 제어를 위한 차속 추정을 위해 개발 과정 중에 임의로 변경이 가능한 Calibration Value 임.

신호 사�";
BA_ "UserSigValidity" SG_ 160 WHL_SpdCalParmtr 3;
BA_ "RoutingFactor" SG_ 160 WHL_SpdCalParmtr 5;
BA_ "Version" SG_ 160 WHL_SpdCalParmtr "19.05.02";
BA_ "Description" SG_ 160 WHL_AlvCnt1Val "For the first transmission request for a data element the counter shall be initialized with 0 and shall be incremented by 1 for every subsequent send request. 

When the counter reaches the maximum value(0xFF), then it shall restart with 0 for the next s";
BA_ "UserSigValidity" SG_ 160 WHL_AlvCnt1Val 3;
BA_ "RoutingFactor" SG_ 160 WHL_AlvCnt1Val 5;
BA_ "Version" SG_ 160 WHL_AlvCnt1Val "21.09.03";
BA_ "Description" SG_ 160 WHL_PlsFLVal "This signal indicates accumulated pulse counter of ABS^ESC wheel speed sensor (FL^FR^RL^RR)

Receiver unit uses this signal for calculation of vehicle movement distance.

Requested resolution of this signal is 0.5 pulses and refer to below (wheel sensor ";
BA_ "UserSigValidity" SG_ 160 WHL_PlsFLVal 3;
BA_ "RoutingFactor" SG_ 160 WHL_PlsFLVal 5;
BA_ "Version" SG_ 160 WHL_PlsFLVal "17.12.00";
BA_ "Description" SG_ 160 WHL_PlsFRVal "This signal indicates accumulated pulse counter of ABS^ESC wheel speed sensor (FL^FR^RL^RR)

Receiver unit uses this signal for calculation of vehicle movement distance.

Requested resolution of this signal is 0.5 pulses and refer to below (wheel sensor ";
BA_ "UserSigValidity" SG_ 160 WHL_PlsFRVal 3;
BA_ "RoutingFactor" SG_ 160 WHL_PlsFRVal 5;
BA_ "Version" SG_ 160 WHL_PlsFRVal "17.12.00";
BA_ "Description" SG_ 160 WHL_PlsRLVal "This signal indicates accumulated pulse counter of ABS^ESC wheel speed sensor (FL^FR^RL^RR)

Receiver unit uses this signal for calculation of vehicle movement distance.

Requested resolution of this signal is 0.5 pulses and refer to below (wheel sensor ";
BA_ "UserSigValidity" SG_ 160 WHL_PlsRLVal 3;
BA_ "RoutingFactor" SG_ 160 WHL_PlsRLVal 5;
BA_ "Version" SG_ 160 WHL_PlsRLVal "17.12.00";
BA_ "Description" SG_ 160 WHL_PlsRRVal "This signal indicates accumulated pulse counter of ABS^ESC wheel speed sensor (FL^FR^RL^RR)

Receiver unit uses this signal for calculation of vehicle movement distance.

Requested resolution of this signal is 0.5 pulses and refer to below (wheel sensor ";
BA_ "UserSigValidity" SG_ 160 WHL_PlsRRVal 3;
BA_ "RoutingFactor" SG_ 160 WHL_PlsRRVal 5;
BA_ "Version" SG_ 160 WHL_PlsRRVal "17.12.00";
BA_ "Description" SG_ 160 WHL_DirFLVal "This signal is used to check the moving direction of WHL_PUL_FL signal.";
BA_ "UserSigValidity" SG_ 160 WHL_DirFLVal 3;
BA_ "RoutingFactor" SG_ 160 WHL_DirFLVal 5;
BA_ "Version" SG_ 160 WHL_DirFLVal "17.12.00";
BA_ "Description" SG_ 160 WHL_DirFRVal "This signal is used to check the moving direction of WHL_PUL_FR signal.";
BA_ "UserSigValidity" SG_ 160 WHL_DirFRVal 3;
BA_ "RoutingFactor" SG_ 160 WHL_DirFRVal 5;
BA_ "Version" SG_ 160 WHL_DirFRVal "17.12.00";
BA_ "Description" SG_ 160 WHL_DirRLVal "This signal is used to check the moving direction of WHL_PUL_RL signal.";
BA_ "UserSigValidity" SG_ 160 WHL_DirRLVal 3;
BA_ "RoutingFactor" SG_ 160 WHL_DirRLVal 5;
BA_ "Version" SG_ 160 WHL_DirRLVal "17.12.00";
BA_ "Description" SG_ 160 WHL_DirRRVal "This signal is used to check the moving direction of WHL_PUL_RR signal.";
BA_ "UserSigValidity" SG_ 160 WHL_DirRRVal 3;
BA_ "RoutingFactor" SG_ 160 WHL_DirRRVal 5;
BA_ "Version" SG_ 160 WHL_DirRRVal "17.12.00";
BA_ "Description" SG_ 160 WHL_SpdFLVal "This signal provides the wheel velocity of each wheel and have 14 bits length and a resolution of 0.03125 km^h.(This resolution is higher than that of signal in TCS5).

In case of failure of one wheel speed sensor, the value 3FFFH is used as error identi";
BA_ "UserSigValidity" SG_ 160 WHL_SpdFLVal 3;
BA_ "RoutingFactor" SG_ 160 WHL_SpdFLVal 5;
BA_ "Version" SG_ 160 WHL_SpdFLVal "17.12.00";
BA_ "Description" SG_ 160 WHL_SpdFRVal "This signal provides the wheel velocity of each wheel and have 14 bits length and a resolution of 0.03125 km^h.(This resolution is higher than that of signal in TCS5).

In case of failure of one wheel speed sensor, the value 3FFFH is used as error identi";
BA_ "UserSigValidity" SG_ 160 WHL_SpdFRVal 3;
BA_ "RoutingFactor" SG_ 160 WHL_SpdFRVal 5;
BA_ "Version" SG_ 160 WHL_SpdFRVal "17.12.00";
BA_ "Description" SG_ 160 WHL_SpdRLVal "This signal provides the wheel velocity of each wheel and have 14 bits length and a resolution of 0.03125 km^h.(This resolution is higher than that of signal in TCS5).

In case of failure of one wheel speed sensor, the value 3FFFH is used as error identi";
BA_ "UserSigValidity" SG_ 160 WHL_SpdRLVal 3;
BA_ "RoutingFactor" SG_ 160 WHL_SpdRLVal 5;
BA_ "Version" SG_ 160 WHL_SpdRLVal "17.12.00";
BA_ "Description" SG_ 426 CLU_Crc1Val "The data area for CRC calculation is based on the data length (DLC) of the message DB.

The CRC shall be calculated over the entire data block (excluding the CRC bytes) including the user data, alive counter and Data ID



- CRC Polynomial (0x1021) , Ini";
BA_ "GenSigStartValue" SG_ 426 CLU_Crc1Val 65535;
BA_ "UserSigValidity" SG_ 426 CLU_Crc1Val 3;
BA_ "RoutingFactor" SG_ 426 CLU_Crc1Val 0;
BA_ "Version" SG_ 426 CLU_Crc1Val "21.09.03";
BA_ "Description" SG_ 426 CLU_FuelSenderRstReq "This signal is transmitted when initailzing request occur";
BA_ "UserSigValidity" SG_ 426 CLU_FuelSenderRstReq 0;
BA_ "RoutingFactor" SG_ 426 CLU_FuelSenderRstReq 0;
BA_ "Version" SG_ 426 CLU_FuelSenderRstReq "23.05.05";
BA_ "Description" SG_ 426 CLU_PRKDispRdy "If the cluster is not operating normally, 'Impossible to display' signal(0x1) is transmitted to ADAS_PRK";
BA_ "UserSigValidity" SG_ 426 CLU_PRKDispRdy 3;
BA_ "RoutingFactor" SG_ 426 CLU_PRKDispRdy 0;
BA_ "Version" SG_ 426 CLU_PRKDispRdy "25.01.00";
BA_ "Description" SG_ 426 CLU_XtrekPlusOnOffReq "This is the signal for operating X-TREK+ Soft key of S1 field in Connect platform.

when X-TREK+ on/off soft key is pressed, this signal will be sent.

when X-TREK+ is off and driver press the button on S1, X-TREK+ on request will be sent

when X-TREK+ i";
BA_ "UserSigValidity" SG_ 426 CLU_XtrekPlusOnOffReq 3;
BA_ "RoutingFactor" SG_ 426 CLU_XtrekPlusOnOffReq 0;
BA_ "Version" SG_ 426 CLU_XtrekPlusOnOffReq "25.05.06";
BA_ "Description" SG_ 426 CLU_ISG_OFF_SoftkeySta "This is the signal for operating Soft key of S1 field in Connect platform. Transmits whether a softkey is pressed";
BA_ "UserSigValidity" SG_ 426 CLU_ISG_OFF_SoftkeySta 3;
BA_ "RoutingFactor" SG_ 426 CLU_ISG_OFF_SoftkeySta 0;
BA_ "Version" SG_ 426 CLU_ISG_OFF_SoftkeySta "25.10.01";
BA_ "Description" SG_ 426 CLU_AlvCnt1Val "For the first transmission request for a data element the counter shall be initialized with 0 and shall be incremented by 1 for every subsequent send request. 

When the counter reaches the maximum value(0xFF), then it shall restart with 0 for the next s";
BA_ "UserSigValidity" SG_ 426 CLU_AlvCnt1Val 3;
BA_ "RoutingFactor" SG_ 426 CLU_AlvCnt1Val 0;
BA_ "Version" SG_ 426 CLU_AlvCnt1Val "21.09.03";
BA_ "Description" SG_ 426 CLU_DtntOutSta "This signal indicates the status of detent illumination. Cluster sends the detent information for a Unified Illumination system.";
BA_ "UserSigValidity" SG_ 426 CLU_DtntOutSta 0;
BA_ "RoutingFactor" SG_ 426 CLU_DtntOutSta 0;
BA_ "Version" SG_ 426 CLU_DtntOutSta "17.11.00";
BA_ "Description" SG_ 426 CLU_SpdUnitTyp "This signal indicates the unit of the speed displayed in the speedometer.";
BA_ "UserSigValidity" SG_ 426 CLU_SpdUnitTyp 3;
BA_ "RoutingFactor" SG_ 426 CLU_SpdUnitTyp 0;
BA_ "Version" SG_ 426 CLU_SpdUnitTyp "17.11.00";
BA_ "Description" SG_ 426 CLU_DisSpdDcmlVal "The signal 'CF_Clu_VanzDecimal' means the extra value of the signal 'CF_Clu_Vanz' (vehicle speed which is indicated in the speedometer)

Also, This signal should be sent in km/h or MPH according to the 'CF_Clu_SPEED_UNIT' signal.

CF_Clu_SPEED_UNIT = 0 :";
BA_ "UserSigValidity" SG_ 426 CLU_DisSpdDcmlVal 3;
BA_ "RoutingFactor" SG_ 426 CLU_DisSpdDcmlVal 0;
BA_ "Version" SG_ 426 CLU_DisSpdDcmlVal "17.11.00";
BA_ "Description" SG_ 426 CLU_SWRCCrsMainSwSta "Cruise on/off switch";
BA_ "UserSigValidity" SG_ 426 CLU_SWRCCrsMainSwSta 3;
BA_ "RoutingFactor" SG_ 426 CLU_SWRCCrsMainSwSta 0;
BA_ "Version" SG_ 426 CLU_SWRCCrsMainSwSta "18.04.00";
BA_ "Description" SG_ 426 CLU_SWRCCrsSwSta "Depending on whether One-touch logic is applied, the meaning of each signal value is divided into two cases as shown below



Case1) Not applied

0x0:Idle Position

0x1:Resume/Plus

0x2:Set/Minus

0x3:Time gap (Distance, SCC only)

0x4:ACC/SCC cancel



";
BA_ "UserSigValidity" SG_ 426 CLU_SWRCCrsSwSta 3;
BA_ "RoutingFactor" SG_ 426 CLU_SWRCCrsSwSta 0;
BA_ "Version" SG_ 426 CLU_SWRCCrsSwSta "18.07.01";
BA_ "Description" SG_ 426 CLU_SWRCLFASwSta "LFA/HDA on/off switch";
BA_ "UserSigValidity" SG_ 426 CLU_SWRCLFASwSta 3;
BA_ "RoutingFactor" SG_ 426 CLU_SWRCLFASwSta 0;
BA_ "Version" SG_ 426 CLU_SWRCLFASwSta "18.04.00";
BA_ "Description" SG_ 426 CLU_SWRCSldMainSwSta "Speedlimiter on/off switch";
BA_ "UserSigValidity" SG_ 426 CLU_SWRCSldMainSwSta 3;
BA_ "RoutingFactor" SG_ 426 CLU_SWRCSldMainSwSta 0;
BA_ "Version" SG_ 426 CLU_SWRCSldMainSwSta "18.04.00";
BA_ "Description" SG_ 426 CLU_RhstaLvlSta "This signal is used for a rheostat level of CLUSTER from 1 to 21 level (21 level : Detent) for a Unified Illumination system.



※ Start Value : Current value";
BA_ "UserSigValidity" SG_ 426 CLU_RhstaLvlSta 0;
BA_ "RoutingFactor" SG_ 426 CLU_RhstaLvlSta 0;
BA_ "Version" SG_ 426 CLU_RhstaLvlSta "17.11.00";
BA_ "Description" SG_ 426 CLU_DisSpdVal "The vehicle speed which is indicated in the speedmeter has to be sent to SCC. This value is used for evalution of SCC command values instead of the vehicle velocity in order to avoid significant difference between the speedmeter indicator and the set spe";
BA_ "UserSigValidity" SG_ 426 CLU_DisSpdVal 3;
BA_ "RoutingFactor" SG_ 426 CLU_DisSpdVal 0;
BA_ "Version" SG_ 426 CLU_DisSpdVal "17.12.03";
BA_ "Description" SG_ 426 CLU_OKSwSta "This signal represents operating status of Ok Switch in Steering Wheel. Default value of this signal is 0 and the value is set to 1 only while a driver is pressing the OK Switch.";
BA_ "UserSigValidity" SG_ 426 CLU_OKSwSta 3;
BA_ "RoutingFactor" SG_ 426 CLU_OKSwSta 0;
BA_ "Version" SG_ 426 CLU_OKSwSta "19.03.06";
BA_ "Description" SG_ 426 CLU_DisSpdVal_KPH "The vehicle speed which is indicated in the speedmeter.

This signal should be sent in km/h only.";
BA_ "UserSigValidity" SG_ 426 CLU_DisSpdVal_KPH 3;
BA_ "RoutingFactor" SG_ 426 CLU_DisSpdVal_KPH 0;
BA_ "Version" SG_ 426 CLU_DisSpdVal_KPH "17.12.09";
BA_ "Description" SG_ 426 CLU_PwrAutoOffResetReq_HCU "This signal is used for a request to reset power auto off time

when OK sw on, this signal 0x1 for 3 period times,and send 0x0 

It is signal for HCU";
BA_ "UserSigValidity" SG_ 426 CLU_PwrAutoOffResetReq_HCU 3;
BA_ "RoutingFactor" SG_ 426 CLU_PwrAutoOffResetReq_HCU 0;
BA_ "Version" SG_ 426 CLU_PwrAutoOffResetReq_HCU "19.10.03";
BA_ "Description" SG_ 426 CLU_CUSTOMSta_NEW "This is a signal for New concept CUSTOM mode in AVN USM

This is a confirm signal for selecting CUSTOM mode in AVN USM

And Other units refer this signal when CUSTOM mode (CLU_DrvngModSwSta=0x6

). Other unit decided the Detailed CUSTOM Mode with this si";
BA_ "UserSigValidity" SG_ 426 CLU_CUSTOMSta_NEW 3;
BA_ "RoutingFactor" SG_ 426 CLU_CUSTOMSta_NEW 0;
BA_ "Version" SG_ 426 CLU_CUSTOMSta_NEW "20.08.07";
BA_ "Description" SG_ 426 CLU_AutoBrightSta "This signal is used for a auto bright level of CLUSTER from 1step to 200step for a Unified Illumination system.



※ Start Value : Current value";
BA_ "UserSigValidity" SG_ 426 CLU_AutoBrightSta 0;
BA_ "RoutingFactor" SG_ 426 CLU_AutoBrightSta 0;
BA_ "Version" SG_ 426 CLU_AutoBrightSta "20.12.05";
BA_ "Description" SG_ 426 CLU_NotMinModeBrightSta "This signal is used for a Cluster brightness level when not in minimum brightness mode.



※ Start Value : Current value";
BA_ "UserSigValidity" SG_ 426 CLU_NotMinModeBrightSta 0;
BA_ "RoutingFactor" SG_ 426 CLU_NotMinModeBrightSta 0;
BA_ "Version" SG_ 426 CLU_NotMinModeBrightSta "22.07.06";
BA_ "Description" SG_ 426 CLU_FuelSenderResistVal "This is the resistance data come from fuel sender.

If fuel sender is open,short condition, Invalid value will be transmitted.

data is valid after cluser waked-up";
BA_ "UserSigValidity" SG_ 426 CLU_FuelSenderResistVal 0;
BA_ "RoutingFactor" SG_ 426 CLU_FuelSenderResistVal 0;
BA_ "Version" SG_ 426 CLU_FuelSenderResistVal "23.06.00";
BA_ "Description" SG_ 293 SAS_Crc1Val "The data area for CRC calculation is based on the data length (DLC) of the message DB.

The CRC shall be calculated over the entire data block (excluding the CRC bytes) including the user data, alive counter and Data ID

 

- CRC Polynomial (0x1021) , In";
BA_ "GenSigStartValue" SG_ 293 SAS_Crc1Val 65535;
BA_ "UserSigValidity" SG_ 293 SAS_Crc1Val 3;
BA_ "RoutingFactor" SG_ 293 SAS_Crc1Val 5;
BA_ "Version" SG_ 293 SAS_Crc1Val "18.11.08";
BA_ "Description" SG_ 293 SAS_AlvCnt1Val "For the first transmission request for a data element the counter shall be initialized with 0 and shall be incremented by 1 for every subsequent send request. 

When the counter reaches the maximum value(0xFF), then it shall restart with 0 for the next s";
BA_ "UserSigValidity" SG_ 293 SAS_AlvCnt1Val 3;
BA_ "RoutingFactor" SG_ 293 SAS_AlvCnt1Val 5;
BA_ "Version" SG_ 293 SAS_AlvCnt1Val "18.11.08";
BA_ "Description" SG_ 293 SAS_AnglVal "Information regarding the steering wheel angle.  (PH) = (HEX) * 0.1 (0 <  HEX < 7FFFH) or (PH) = (HEX - 65536) * 0.1 (HEX > 7FFFH)



this signal has direction information.

'+' Value means Counter clock wise rotation.

'-' value means Clock wise rotatio";
BA_ "GenSigStartValue" SG_ 293 SAS_AnglVal 32767;
BA_ "UserSigValidity" SG_ 293 SAS_AnglVal 3;
BA_ "RoutingFactor" SG_ 293 SAS_AnglVal 5;
BA_ "Version" SG_ 293 SAS_AnglVal "21.07.05";
BA_ "Description" SG_ 293 SAS_SpdVal "Information regarding the steering wheel rotation speed 

(PH) = (HEX) * 4 (0 ≤ HEX < 254)";
BA_ "GenSigStartValue" SG_ 293 SAS_SpdVal 255;
BA_ "UserSigValidity" SG_ 293 SAS_SpdVal 3;
BA_ "RoutingFactor" SG_ 293 SAS_SpdVal 5;
BA_ "Version" SG_ 293 SAS_SpdVal "21.07.05";
BA_ "Description" SG_ 293 SAS_IntSta "Information regarding the steering angle sensor’s internal state. If SAS_AnglVal value is O.K., SAS_OK flag is set and otherwise SAS_OK flag is cleared. If steering angle sensor has been calibrated, SAS_CAL flag is set and otherwise cleared.

SF1 - SF5 ";
BA_ "GenSigStartValue" SG_ 293 SAS_IntSta 14;
BA_ "UserSigValidity" SG_ 293 SAS_IntSta 3;
BA_ "RoutingFactor" SG_ 293 SAS_IntSta 5;
BA_ "Version" SG_ 293 SAS_IntSta "21.07.05";
BA_ "Description" SG_ 53 VCU_Crc1Val "The data area for CRC calculation is based on the data length (DLC) of the message DB.

The CRC shall be calculated over the entire data block (excluding the CRC bytes) including the user data, alive counter and Data ID



- CRC Polynomial (0x1021) , Ini";
BA_ "GenSigStartValue" SG_ 53 VCU_Crc1Val 65535;
BA_ "UserSigValidity" SG_ 53 VCU_Crc1Val 7;
BA_ "RoutingFactor" SG_ 53 VCU_Crc1Val 5;
BA_ "Version" SG_ 53 VCU_Crc1Val "21.09.03";
BA_ "Description" SG_ 53 VCU_ScuKeepWakeReq "SCU Keep Wake Request";
BA_ "UserSigValidity" SG_ 53 VCU_ScuKeepWakeReq 7;
BA_ "RoutingFactor" SG_ 53 VCU_ScuKeepWakeReq 5;
BA_ "Version" SG_ 53 VCU_ScuKeepWakeReq "20.04.05";
BA_ "Description" SG_ 53 VCU_MotTqCmdRearVal "Torque Command for Rear Motor";
BA_ "UserSigValidity" SG_ 53 VCU_MotTqCmdRearVal 7;
BA_ "RoutingFactor" SG_ 53 VCU_MotTqCmdRearVal 5;
BA_ "Version" SG_ 53 VCU_MotTqCmdRearVal "20.04.05";
BA_ "Description" SG_ 53 VCU_FmcuZeroTqOfsReq "Fmcu Zero Torque Offset Request";
BA_ "UserSigValidity" SG_ 53 VCU_FmcuZeroTqOfsReq 7;
BA_ "RoutingFactor" SG_ 53 VCU_FmcuZeroTqOfsReq 5;
BA_ "Version" SG_ 53 VCU_FmcuZeroTqOfsReq "20.04.05";
BA_ "Description" SG_ 53 VCU_EcmSeqSta "This signal is VCU System Status Information.";
BA_ "UserSigValidity" SG_ 53 VCU_EcmSeqSta 7;
BA_ "RoutingFactor" SG_ 53 VCU_EcmSeqSta 5;
BA_ "Version" SG_ 53 VCU_EcmSeqSta "20.04.05";
BA_ "UserSigValidity" SG_ 53 VCU_EcmDiagSta 7;
BA_ "RoutingFactor" SG_ 53 VCU_EcmDiagSta 5;
BA_ "Version" SG_ 53 VCU_EcmDiagSta "20.04.05";
BA_ "Description" SG_ 53 VCU_CltActDiagSta "Clutch Actuator Diag Code";
BA_ "UserSigValidity" SG_ 53 VCU_CltActDiagSta 7;
BA_ "RoutingFactor" SG_ 53 VCU_CltActDiagSta 5;
BA_ "Version" SG_ 53 VCU_CltActDiagSta "20.04.05";
BA_ "Description" SG_ 53 VCU_CltActDrvCrntVal "Clutch Actuator Drive Current";
BA_ "UserSigValidity" SG_ 53 VCU_CltActDrvCrntVal 7;
BA_ "RoutingFactor" SG_ 53 VCU_CltActDrvCrntVal 5;
BA_ "Version" SG_ 53 VCU_CltActDrvCrntVal "20.04.05";
BA_ "Description" SG_ 53 VCU_AlvCnt1Val "For the first transmission request for a data element the counter shall be initialized with 0 and shall be incremented by 1 for every subsequent send request. 

When the counter reaches the maximum value(0xFF), then it shall restart with 0 for the next s";
BA_ "UserSigValidity" SG_ 53 VCU_AlvCnt1Val 7;
BA_ "RoutingFactor" SG_ 53 VCU_AlvCnt1Val 5;
BA_ "Version" SG_ 53 VCU_AlvCnt1Val "21.09.03";
BA_ "Description" SG_ 53 VCU_CltActPosStrokeVal "Clutch Actuator Position Stroke";
BA_ "UserSigValidity" SG_ 53 VCU_CltActPosStrokeVal 7;
BA_ "RoutingFactor" SG_ 53 VCU_CltActPosStrokeVal 5;
BA_ "Version" SG_ 53 VCU_CltActPosStrokeVal "20.04.05";
BA_ "Description" SG_ 53 VCU_MainBattTypeSta "Main Battery Type";
BA_ "UserSigValidity" SG_ 53 VCU_MainBattTypeSta 7;
BA_ "RoutingFactor" SG_ 53 VCU_MainBattTypeSta 5;
BA_ "Version" SG_ 53 VCU_MainBattTypeSta "20.08.07";
BA_ "Description" SG_ 53 VCU_MainBattTypeLrnSta "Learn Status of Main Batt. Type";
BA_ "UserSigValidity" SG_ 53 VCU_MainBattTypeLrnSta 7;
BA_ "RoutingFactor" SG_ 53 VCU_MainBattTypeLrnSta 5;
BA_ "Version" SG_ 53 VCU_MainBattTypeLrnSta "20.04.05";
BA_ "Description" SG_ 53 VCU_WarmupCycSta "Warm-up Cycle Status Flag for FRF output to other ECU's";
BA_ "UserSigValidity" SG_ 53 VCU_WarmupCycSta 7;
BA_ "RoutingFactor" SG_ 53 VCU_WarmupCycSta 5;
BA_ "Version" SG_ 53 VCU_WarmupCycSta "20.04.05";
BA_ "Description" SG_ 53 VCU_FatcPermPwrVal "Climate Permission Power";
BA_ "UserSigValidity" SG_ 53 VCU_FatcPermPwrVal 7;
BA_ "RoutingFactor" SG_ 53 VCU_FatcPermPwrVal 5;
BA_ "Version" SG_ 53 VCU_FatcPermPwrVal "20.04.05";
BA_ "Description" SG_ 53 VCU_GearPosStaDisp "Gear Position Status for CLU display";
BA_ "GenSigStartValue" SG_ 53 VCU_GearPosStaDisp 9;
BA_ "UserSigValidity" SG_ 53 VCU_GearPosStaDisp 7;
BA_ "RoutingFactor" SG_ 53 VCU_GearPosStaDisp 5;
BA_ "Version" SG_ 53 VCU_GearPosStaDisp "25.04.01";
BA_ "Description" SG_ 53 VCU_PdlStopCtrlSta "Cooperative control state of VCU for stop assist control with IEB";
BA_ "UserSigValidity" SG_ 53 VCU_PdlStopCtrlSta 7;
BA_ "RoutingFactor" SG_ 53 VCU_PdlStopCtrlSta 5;
BA_ "Version" SG_ 53 VCU_PdlStopCtrlSta "21.08.08";
BA_ "Description" SG_ 53 VCU_PdlStopReqTqNmVal "Requested brake torque for cooperative stop assist control";
BA_ "UserSigValidity" SG_ 53 VCU_PdlStopReqTqNmVal 7;
BA_ "RoutingFactor" SG_ 53 VCU_PdlStopReqTqNmVal 5;
BA_ "Version" SG_ 53 VCU_PdlStopReqTqNmVal "21.08.08";
BA_ "Description" SG_ 53 VCU_PMPDActSta "PMPD Function Active State";
BA_ "UserSigValidity" SG_ 53 VCU_PMPDActSta 7;
BA_ "RoutingFactor" SG_ 53 VCU_PMPDActSta 5;
BA_ "Version" SG_ 53 VCU_PMPDActSta "23.06.01";
BA_ "Description" SG_ 53 VCU_PMPDWarnSta "PMPD Function Warning State";
BA_ "UserSigValidity" SG_ 53 VCU_PMPDWarnSta 7;
BA_ "RoutingFactor" SG_ 53 VCU_PMPDWarnSta 5;
BA_ "Version" SG_ 53 VCU_PMPDWarnSta "24.09.01";
BA_ "Description" SG_ 53 VCU_VgsVirSoundBackFireIndex "Virtual sound back fire noise index for VGS mode";
BA_ "UserSigValidity" SG_ 53 VCU_VgsVirSoundBackFireIndex 7;
BA_ "RoutingFactor" SG_ 53 VCU_VgsVirSoundBackFireIndex 5;
BA_ "Version" SG_ 53 VCU_VgsVirSoundBackFireIndex "21.12.02";
BA_ "Description" SG_ 53 VCU_VgsVirEngSpdRpmVal "Virtual engine speed for VGS mode";
BA_ "UserSigValidity" SG_ 53 VCU_VgsVirEngSpdRpmVal 7;
BA_ "RoutingFactor" SG_ 53 VCU_VgsVirEngSpdRpmVal 5;
BA_ "Version" SG_ 53 VCU_VgsVirEngSpdRpmVal "21.12.02";
BA_ "Description" SG_ 53 VCU_RdySta "VCU Ready";
BA_ "UserSigValidity" SG_ 53 VCU_RdySta 7;
BA_ "RoutingFactor" SG_ 53 VCU_RdySta 5;
BA_ "Version" SG_ 53 VCU_RdySta "20.04.05";
BA_ "Description" SG_ 53 VCU_VgsVirSoundVolume "Virtual engine sound volume for VGS mode[%]";
BA_ "UserSigValidity" SG_ 53 VCU_VgsVirSoundVolume 7;
BA_ "RoutingFactor" SG_ 53 VCU_VgsVirSoundVolume 5;
BA_ "Version" SG_ 53 VCU_VgsVirSoundVolume "21.12.02";
BA_ "Description" SG_ 53 VCU_VgsVirGearStep "Shift gear when entering VGS mode";
BA_ "UserSigValidity" SG_ 53 VCU_VgsVirGearStep 7;
BA_ "RoutingFactor" SG_ 53 VCU_VgsVirGearStep 5;
BA_ "Version" SG_ 53 VCU_VgsVirGearStep "21.12.02";
BA_ "Description" SG_ 53 VCU_StandbyModSta "Stand by Mode Status";
BA_ "UserSigValidity" SG_ 53 VCU_StandbyModSta 7;
BA_ "RoutingFactor" SG_ 53 VCU_StandbyModSta 5;
BA_ "Version" SG_ 53 VCU_StandbyModSta "22.05.04";
BA_ "Description" SG_ 53 VCU_HVIntLkDischrgReq "High Voltage Parts Discharge Request from VCU";
BA_ "UserSigValidity" SG_ 53 VCU_HVIntLkDischrgReq 7;
BA_ "RoutingFactor" SG_ 53 VCU_HVIntLkDischrgReq 5;
BA_ "Version" SG_ 53 VCU_HVIntLkDischrgReq "22.11.02";
BA_ "Description" SG_ 53 VCU_StartKeyHoldSta "Start Key Hold Signal";
BA_ "UserSigValidity" SG_ 53 VCU_StartKeyHoldSta 7;
BA_ "RoutingFactor" SG_ 53 VCU_StartKeyHoldSta 5;
BA_ "Version" SG_ 53 VCU_StartKeyHoldSta "20.04.05";
BA_ "Description" SG_ 53 VCU_EvDrvRdySta "EV Ready";
BA_ "UserSigValidity" SG_ 53 VCU_EvDrvRdySta 7;
BA_ "RoutingFactor" SG_ 53 VCU_EvDrvRdySta 5;
BA_ "Version" SG_ 53 VCU_EvDrvRdySta "20.04.05";
BA_ "Description" SG_ 53 VCU_MotPwrEnReq "Motor Power Enable";
BA_ "UserSigValidity" SG_ 53 VCU_MotPwrEnReq 7;
BA_ "RoutingFactor" SG_ 53 VCU_MotPwrEnReq 5;
BA_ "Version" SG_ 53 VCU_MotPwrEnReq "20.04.05";
BA_ "Description" SG_ 53 VCU_GearPosSta "Gear Position Status";
BA_ "GenSigStartValue" SG_ 53 VCU_GearPosSta 9;
BA_ "UserSigValidity" SG_ 53 VCU_GearPosSta 7;
BA_ "RoutingFactor" SG_ 53 VCU_GearPosSta 5;
BA_ "Version" SG_ 53 VCU_GearPosSta "25.04.01";
BA_ "Description" SG_ 53 VCU_LdcInhReq "LDC Output Inhibit Request";
BA_ "GenSigStartValue" SG_ 53 VCU_LdcInhReq 1;
BA_ "UserSigValidity" SG_ 53 VCU_LdcInhReq 7;
BA_ "RoutingFactor" SG_ 53 VCU_LdcInhReq 5;
BA_ "Version" SG_ 53 VCU_LdcInhReq "20.04.05";
BA_ "Description" SG_ 53 VCU_MainRlyOffReq "Main Relay Cut off Request";
BA_ "UserSigValidity" SG_ 53 VCU_MainRlyOffReq 7;
BA_ "RoutingFactor" SG_ 53 VCU_MainRlyOffReq 5;
BA_ "Version" SG_ 53 VCU_MainRlyOffReq "20.04.05";
BA_ "Description" SG_ 53 VCU_AccPedDepVal "Accelerator Pedal Depth Value";
BA_ "UserSigValidity" SG_ 53 VCU_AccPedDepVal 7;
BA_ "RoutingFactor" SG_ 53 VCU_AccPedDepVal 5;
BA_ "Version" SG_ 53 VCU_AccPedDepVal "20.04.05";
BA_ "Description" SG_ 53 VCU_FatcOperPermSta "Climate Operating Permission";
BA_ "UserSigValidity" SG_ 53 VCU_FatcOperPermSta 7;
BA_ "RoutingFactor" SG_ 53 VCU_FatcOperPermSta 5;
BA_ "Version" SG_ 53 VCU_FatcOperPermSta "20.04.05";
BA_ "Description" SG_ 53 VCU_DrvCycSta "Driving Cycle Status";
BA_ "UserSigValidity" SG_ 53 VCU_DrvCycSta 7;
BA_ "RoutingFactor" SG_ 53 VCU_DrvCycSta 5;
BA_ "Version" SG_ 53 VCU_DrvCycSta "20.04.05";
BA_ "Description" SG_ 53 VCU_CltActOpSta "Clutch Actuator Operating Status";
BA_ "UserSigValidity" SG_ 53 VCU_CltActOpSta 7;
BA_ "RoutingFactor" SG_ 53 VCU_CltActOpSta 5;
BA_ "Version" SG_ 53 VCU_CltActOpSta "20.04.05";
BA_ "Description" SG_ 53 VCU_WhlSpdSnsrAlvReq "Alive Request for Wheel Speed Sensors";
BA_ "UserSigValidity" SG_ 53 VCU_WhlSpdSnsrAlvReq 7;
BA_ "RoutingFactor" SG_ 53 VCU_WhlSpdSnsrAlvReq 5;
BA_ "Version" SG_ 53 VCU_WhlSpdSnsrAlvReq "20.04.05";
BA_ "Description" SG_ 53 VCU_DrvModOpSta "VCU's operating drive mode according to CLU and DMIC signals";
BA_ "UserSigValidity" SG_ 53 VCU_DrvModOpSta 7;
BA_ "RoutingFactor" SG_ 53 VCU_DrvModOpSta 5;
BA_ "Version" SG_ 53 VCU_DrvModOpSta "24.10.03";
BA_ "Description" SG_ 53 VCU_HydBrkFcHoldRq "Hydraulic brake force holding request from VCU";
BA_ "UserSigValidity" SG_ 53 VCU_HydBrkFcHoldRq 7;
BA_ "RoutingFactor" SG_ 53 VCU_HydBrkFcHoldRq 5;
BA_ "Version" SG_ 53 VCU_HydBrkFcHoldRq "22.03.02";
BA_ "Description" SG_ 53 VCU_FatcPwrUseVal "Predicted HVAC Power Consumption";
BA_ "UserSigValidity" SG_ 53 VCU_FatcPwrUseVal 7;
BA_ "RoutingFactor" SG_ 53 VCU_FatcPwrUseVal 5;
BA_ "Version" SG_ 53 VCU_FatcPwrUseVal "20.04.05";
BA_ "Description" SG_ 53 VCU_WhlDemTqVal "Driver's Demand Torque Restricted by Battery Limit and HHT Temperature";
BA_ "UserSigValidity" SG_ 53 VCU_WhlDemTqVal 7;
BA_ "RoutingFactor" SG_ 53 VCU_WhlDemTqVal 5;
BA_ "Version" SG_ 53 VCU_WhlDemTqVal "20.04.05";
BA_ "Description" SG_ 53 VCU_McuAntiJerkInhFrntSta "Anti-jerk Inhibition";
BA_ "GenSigStartValue" SG_ 53 VCU_McuAntiJerkInhFrntSta 1;
BA_ "UserSigValidity" SG_ 53 VCU_McuAntiJerkInhFrntSta 7;
BA_ "RoutingFactor" SG_ 53 VCU_McuAntiJerkInhFrntSta 5;
BA_ "Version" SG_ 53 VCU_McuAntiJerkInhFrntSta "20.04.05";
BA_ "Description" SG_ 53 VCU_McuAntiJerkInhRearSta "Anti-jerk Inhibition";
BA_ "GenSigStartValue" SG_ 53 VCU_McuAntiJerkInhRearSta 1;
BA_ "UserSigValidity" SG_ 53 VCU_McuAntiJerkInhRearSta 7;
BA_ "RoutingFactor" SG_ 53 VCU_McuAntiJerkInhRearSta 5;
BA_ "Version" SG_ 53 VCU_McuAntiJerkInhRearSta "20.04.05";
BA_ "Description" SG_ 53 VCU_McuPwrLatchHoldReq "Mcu Power Latch Hold Request";
BA_ "UserSigValidity" SG_ 53 VCU_McuPwrLatchHoldReq 7;
BA_ "RoutingFactor" SG_ 53 VCU_McuPwrLatchHoldReq 5;
BA_ "Version" SG_ 53 VCU_McuPwrLatchHoldReq "20.04.05";
BA_ "Description" SG_ 53 VCU_ScuParkReq "Parking Command Request";
BA_ "UserSigValidity" SG_ 53 VCU_ScuParkReq 7;
BA_ "RoutingFactor" SG_ 53 VCU_ScuParkReq 5;
BA_ "Version" SG_ 53 VCU_ScuParkReq "20.04.05";
BA_ "Description" SG_ 53 VCU_MotTqCmdFrntVal "Torque Command for Front Motor";
BA_ "UserSigValidity" SG_ 53 VCU_MotTqCmdFrntVal 7;
BA_ "RoutingFactor" SG_ 53 VCU_MotTqCmdFrntVal 5;
BA_ "Version" SG_ 53 VCU_MotTqCmdFrntVal "20.04.05";
BA_ "Description" SG_ 1278 BLTN_CAM_FD_DCM_Crc0Val "The data area for CRC calculation is based on the data length (DLC) of the message DB.

The CRC shall be calculated over the entire data block (excluding the CRC bytes) including the user data, alive counter and Data ID



- CRC Polynomial (0x1021) , Ini";
BA_ "GenSigSendType" SG_ 1278 BLTN_CAM_FD_DCM_Crc0Val 4;
BA_ "GenSigStartValue" SG_ 1278 BLTN_CAM_FD_DCM_Crc0Val 65535;
BA_ "UserSigValidity" SG_ 1278 BLTN_CAM_FD_DCM_Crc0Val 3;
BA_ "Version" SG_ 1278 BLTN_CAM_FD_DCM_Crc0Val "24.10.04";
BA_ "Description" SG_ 1278 DCM_VideoOut_Interface_Ver_Major "The built-in cam DCM video output interface version has 2 digits.

The notations Major and Minor are separated by ‘.’

Example 

 DCM_VideoOut_Interface_Ver_Major : 0x31 (HEX) -> ASCII CODE : ‘1’  

 DCM_VideoOut_Interface_Ver_Minor : 0x30 (HEX) -> �";
BA_ "GenSigSendType" SG_ 1278 DCM_VideoOut_Interface_Ver_Major 4;
BA_ "GenSigStartValue" SG_ 1278 DCM_VideoOut_Interface_Ver_Major 254;
BA_ "UserSigValidity" SG_ 1278 DCM_VideoOut_Interface_Ver_Major 0;
BA_ "Version" SG_ 1278 DCM_VideoOut_Interface_Ver_Major "25.10.00";
BA_ "Description" SG_ 1278 DCM_VideoOut_Interface_Ver_Minor "The built-in cam DCM video output interface version has 2 digits.

The notations Major and Minor are separated by ‘.’

Example 

 DCM_VideoOut_Interface_Ver_Major : 0x31 (HEX) -> ASCII CODE : ‘1’  

 DCM_VideoOut_Interface_Ver_Minor : 0x30 (HEX) -> �";
BA_ "GenSigSendType" SG_ 1278 DCM_VideoOut_Interface_Ver_Minor 4;
BA_ "GenSigStartValue" SG_ 1278 DCM_VideoOut_Interface_Ver_Minor 254;
BA_ "UserSigValidity" SG_ 1278 DCM_VideoOut_Interface_Ver_Minor 0;
BA_ "Version" SG_ 1278 DCM_VideoOut_Interface_Ver_Minor "25.10.00";
BA_ "Description" SG_ 1278 BLTN_CAM_FD_DCM_AlvCnt0Val "For the first transmission request for a data element the counter shall be initialized with 0 and shall be incremented by 1 for every subsequent send request. 

When the counter reaches the maximum value(0xFF), then it shall restart with 0 for the next s";
BA_ "GenSigSendType" SG_ 1278 BLTN_CAM_FD_DCM_AlvCnt0Val 4;
BA_ "UserSigValidity" SG_ 1278 BLTN_CAM_FD_DCM_AlvCnt0Val 3;
BA_ "Version" SG_ 1278 BLTN_CAM_FD_DCM_AlvCnt0Val "24.10.04";
BA_ "Description" SG_ 1278 BLTN_CAM_HW_Platform_Ver_Major "The built-in cam Hardware platform version has 2 digits.

The notations Major and Minor are separated by ‘.’

Example 

 BLTN_CAM_HW_Platform_Ver_Major : 0x2 (HEX) -> 2 

 BLTN_CAM_HW_Platform_Ver_Minor : 0x6 (HEX) -> 6

=> BLTN_CAM Hardware Platform V";
BA_ "GenSigSendType" SG_ 1278 BLTN_CAM_HW_Platform_Ver_Major 4;
BA_ "GenSigStartValue" SG_ 1278 BLTN_CAM_HW_Platform_Ver_Major 14;
BA_ "UserSigValidity" SG_ 1278 BLTN_CAM_HW_Platform_Ver_Major 0;
BA_ "Version" SG_ 1278 BLTN_CAM_HW_Platform_Ver_Major "25.10.02";
BA_ "Description" SG_ 1278 BLTN_CAM_HW_Platform_Ver_Minor "The built-in cam Hardware platform version has 2 digits.

The notations Major and Minor are separated by ‘.’

Example 

 BLTN_CAM_HW_Platform_Ver_Major : 0x2 (HEX) -> 2 

 BLTN_CAM_HW_Platform_Ver_Minor : 0x06 (HEX) -> 6

=> BLTN_CAM Hardware Platform ";
BA_ "GenSigSendType" SG_ 1278 BLTN_CAM_HW_Platform_Ver_Minor 4;
BA_ "GenSigStartValue" SG_ 1278 BLTN_CAM_HW_Platform_Ver_Minor 14;
BA_ "UserSigValidity" SG_ 1278 BLTN_CAM_HW_Platform_Ver_Minor 0;
BA_ "Version" SG_ 1278 BLTN_CAM_HW_Platform_Ver_Minor "25.10.02";
BA_ "Description" SG_ 1278 RearCamera_HW_Ver_Major "The built-in cam Rear Camera Hardware version has 3 digits.

The notations Major and Minor are separated by ‘.’

Example 

 RearCamera_HW_Ver_Major : 0x41 (HEX) -> ASCII CODE : ‘A’  

 RearCamera_HW_Ver_Minor : 0x00 (HEX) -> ’00’

=> BLTN_CAM Rear ";
BA_ "GenSigSendType" SG_ 1278 RearCamera_HW_Ver_Major 4;
BA_ "GenSigStartValue" SG_ 1278 RearCamera_HW_Ver_Major 126;
BA_ "UserSigValidity" SG_ 1278 RearCamera_HW_Ver_Major 0;
BA_ "Version" SG_ 1278 RearCamera_HW_Ver_Major "25.10.02";
BA_ "Description" SG_ 1278 RearCamera_HW_Ver_Minor "The built-in cam Rear Camera Hardware version has 3 digits.

The notations Major and Minor are separated by ‘.’

Example 

 RearCamera_HW_Ver_Major : 0x41 (HEX) -> ASCII CODE : ‘A’  

 RearCamera_HW_Ver_Minor : 0x00 (HEX) -> ’00’

=> BLTN_CAM Rear ";
BA_ "GenSigSendType" SG_ 1278 RearCamera_HW_Ver_Minor 4;
BA_ "GenSigStartValue" SG_ 1278 RearCamera_HW_Ver_Minor 126;
BA_ "UserSigValidity" SG_ 1278 RearCamera_HW_Ver_Minor 0;
BA_ "Version" SG_ 1278 RearCamera_HW_Ver_Minor "25.10.02";
BA_ "Description" SG_ 1278 RearCamera_SW_Ver_Major "The built-in cam Rear Camera Software version has 3 digits.

The notations Major and Minor are separated by ‘.’

Example 

 RearCamera_SW_Ver_Major : 0x41 (HEX) -> ASCII CODE : ‘A’  

 RearCamera_SW_Ver_Minor : 0x00 (HEX) -> ’00’

=> BLTN_CAM Rear ";
BA_ "GenSigSendType" SG_ 1278 RearCamera_SW_Ver_Major 4;
BA_ "GenSigStartValue" SG_ 1278 RearCamera_SW_Ver_Major 126;
BA_ "UserSigValidity" SG_ 1278 RearCamera_SW_Ver_Major 0;
BA_ "Version" SG_ 1278 RearCamera_SW_Ver_Major "25.10.02";
BA_ "Description" SG_ 1278 RearCamera_SW_Ver_Minor "The built-in cam Rear Camera Software version has 3 digits.

The notations Major and Minor are separated by ‘.’

Example 

 RearCamera_SW_Ver_Major : 0x41 (HEX) -> ASCII CODE : ‘A’  

 RearCamera_SW_Ver_Minor : 0x00 (HEX) -> ’00’

=> BLTN_CAM Rear ";
BA_ "GenSigSendType" SG_ 1278 RearCamera_SW_Ver_Minor 4;
BA_ "GenSigStartValue" SG_ 1278 RearCamera_SW_Ver_Minor 126;
BA_ "UserSigValidity" SG_ 1278 RearCamera_SW_Ver_Minor 0;
BA_ "Version" SG_ 1278 RearCamera_SW_Ver_Minor "25.10.02";
BA_ "Description" SG_ 1278 RearCamera_ISP_Ver0 "The built-in cam Rear Camera ISP version has 8 digits.

Example 

 RearCamera_ISP_Ver0 : 0x18 (HEX) ->unsigned int ‘24’  

 RearCamera_ISP_Ver1 : 0x04 (HEX) ->unsigned int ‘04’  

 RearCamera_ISP_Ver2 : 0x09 (HEX) ->unsigned int ‘09’  

 RearCamera";
BA_ "GenSigSendType" SG_ 1278 RearCamera_ISP_Ver0 4;
BA_ "UserSigValidity" SG_ 1278 RearCamera_ISP_Ver0 0;
BA_ "Version" SG_ 1278 RearCamera_ISP_Ver0 "24.10.05";
BA_ "Description" SG_ 1278 RearCamera_ISP_Ver1 "The built-in cam Rear Camera ISP version has 8 digits.

Example 

 RearCamera_ISP_Ver0 : 0x18 (HEX) ->unsigned int ‘24’  

 RearCamera_ISP_Ver1 : 0x04 (HEX) ->unsigned int ‘04’  

 RearCamera_ISP_Ver2 : 0x09 (HEX) ->unsigned int ‘09’  

 RearCamera";
BA_ "GenSigSendType" SG_ 1278 RearCamera_ISP_Ver1 4;
BA_ "UserSigValidity" SG_ 1278 RearCamera_ISP_Ver1 0;
BA_ "Version" SG_ 1278 RearCamera_ISP_Ver1 "24.10.05";
BA_ "Description" SG_ 1278 RearCamera_ISP_Ver2 "The built-in cam Rear Camera ISP version has 8 digits.

Example 

 RearCamera_ISP_Ver0 : 0x18 (HEX) ->unsigned int ‘24’  

 RearCamera_ISP_Ver1 : 0x04 (HEX) ->unsigned int ‘04’  

 RearCamera_ISP_Ver2 : 0x09 (HEX) ->unsigned int ‘09’  

 RearCamera";
BA_ "GenSigSendType" SG_ 1278 RearCamera_ISP_Ver2 4;
BA_ "UserSigValidity" SG_ 1278 RearCamera_ISP_Ver2 0;
BA_ "Version" SG_ 1278 RearCamera_ISP_Ver2 "24.10.05";
BA_ "Description" SG_ 1278 RearCamera_ISP_Ver3 "The built-in cam Rear Camera ISP version has 8 digits.

Example 

 RearCamera_ISP_Ver0 : 0x18 (HEX) ->unsigned int ‘24’  

 RearCamera_ISP_Ver1 : 0x04 (HEX) ->unsigned int ‘04’  

 RearCamera_ISP_Ver2 : 0x09 (HEX) ->unsigned int ‘09’  

 RearCamera";
BA_ "GenSigSendType" SG_ 1278 RearCamera_ISP_Ver3 4;
BA_ "UserSigValidity" SG_ 1278 RearCamera_ISP_Ver3 0;
BA_ "Version" SG_ 1278 RearCamera_ISP_Ver3 "24.10.05";
BA_ "Description" SG_ 1278 DCM_Output_Color_Fromat "DCM Output Color Fromat";
BA_ "GenSigSendType" SG_ 1278 DCM_Output_Color_Fromat 4;
BA_ "UserSigValidity" SG_ 1278 DCM_Output_Color_Fromat 0;
BA_ "Version" SG_ 1278 DCM_Output_Color_Fromat "25.10.00";
BA_ "Description" SG_ 1278 DCM_Output_Color_bit_Num "DCM Output Color bit Number";
BA_ "GenSigSendType" SG_ 1278 DCM_Output_Color_bit_Num 4;
BA_ "UserSigValidity" SG_ 1278 DCM_Output_Color_bit_Num 0;
BA_ "Version" SG_ 1278 DCM_Output_Color_bit_Num "25.10.00";
BA_ "Description" SG_ 1278 RearCamera_Lenz_Ver "Built-in Camera Lenz version information";
BA_ "GenSigSendType" SG_ 1278 RearCamera_Lenz_Ver 4;
BA_ "GenSigStartValue" SG_ 1278 RearCamera_Lenz_Ver 6;
BA_ "UserSigValidity" SG_ 1278 RearCamera_Lenz_Ver 0;
BA_ "Version" SG_ 1278 RearCamera_Lenz_Ver "25.10.02";
BA_ "Description" SG_ 1279 DCM_HW_Ver_Major "The DCM Hardware version has 3 digits.

The notations Major and Minor are separated by ‘.’

Example 

 DCM_HW_Ver_Major : 0x41 (HEX) -> ASCII CODE : ‘A’  

 DCM_HW_Ver_Minor : 0x00 (HEX) -> ’00’

=> DCM_ Hardware Version is ‘A.00’";
BA_ "GenSigSendType" SG_ 1279 DCM_HW_Ver_Major 4;
BA_ "UserSigValidity" SG_ 1279 DCM_HW_Ver_Major 0;
BA_ "Version" SG_ 1279 DCM_HW_Ver_Major "24.10.05";
BA_ "Description" SG_ 1279 DCM_HW_Ver_Minor "The DCM Hardware version has 3 digits.

The notations Major and Minor are separated by ‘.’

Example 

 DCM_HW_Ver_Major : 0x41 (HEX) -> ASCII CODE : ‘A’  

 DCM_HW_Ver_Minor : 0x00 (HEX) -> ’00’

=> DCM_ Hardware Version is ‘A.00’";
BA_ "GenSigSendType" SG_ 1279 DCM_HW_Ver_Minor 4;
BA_ "UserSigValidity" SG_ 1279 DCM_HW_Ver_Minor 0;
BA_ "Version" SG_ 1279 DCM_HW_Ver_Minor "24.10.05";
BA_ "Description" SG_ 1279 DCM_ResetOpSta "This signal indicates whether the reset operation has been completed or not";
BA_ "GenSigSendType" SG_ 1279 DCM_ResetOpSta 4;
BA_ "UserSigValidity" SG_ 1279 DCM_ResetOpSta 0;
BA_ "Version" SG_ 1279 DCM_ResetOpSta "25.01.00";
BA_ "Description" SG_ 1279 DCM_SW_Ver_1st_Digit "The DCM Software version has 4 digits.

 - Example :

 1st Digit : 0x32 (HEX) -> ASCII CODE : ‘2’

 2nd Digit : 0x35 (HEX) -> ASCII CODE : ‘5’

 3rd Digit : 0x41 (HEX) -> ASCII CODE : ‘A’ 

 4th Digit : 0x33 (HEX) -> ASCII CODE : ‘3’

=> DCM Soft";
BA_ "GenSigSendType" SG_ 1279 DCM_SW_Ver_1st_Digit 4;
BA_ "GenSigStartValue" SG_ 1279 DCM_SW_Ver_1st_Digit 254;
BA_ "UserSigValidity" SG_ 1279 DCM_SW_Ver_1st_Digit 0;
BA_ "Version" SG_ 1279 DCM_SW_Ver_1st_Digit "25.10.00";
BA_ "Description" SG_ 1279 DCM_SW_Ver_2nd_Digit "The DCM Software version has 4 digits.

 - Example :

 1st Digit : 0x32 (HEX) -> ASCII CODE : ‘2’

 2nd Digit : 0x35 (HEX) -> ASCII CODE : ‘5’

 3rd Digit : 0x41 (HEX) -> ASCII CODE : ‘A’ 

 4th Digit : 0x33 (HEX) -> ASCII CODE : ‘3’

=> DCM Soft";
BA_ "GenSigSendType" SG_ 1279 DCM_SW_Ver_2nd_Digit 4;
BA_ "GenSigStartValue" SG_ 1279 DCM_SW_Ver_2nd_Digit 254;
BA_ "UserSigValidity" SG_ 1279 DCM_SW_Ver_2nd_Digit 0;
BA_ "Version" SG_ 1279 DCM_SW_Ver_2nd_Digit "25.10.00";
BA_ "Description" SG_ 1279 DCM_SW_Ver_3rd_Digit "The DCM Software version has 4 digits.

 - Example :

 1st Digit : 0x32 (HEX) -> ASCII CODE : ‘2’

 2nd Digit : 0x35 (HEX) -> ASCII CODE : ‘5’

 3rd Digit : 0x41 (HEX) -> ASCII CODE : ‘A’ 

 4th Digit : 0x33 (HEX) -> ASCII CODE : ‘3’

=> DCM Soft";
BA_ "GenSigSendType" SG_ 1279 DCM_SW_Ver_3rd_Digit 4;
BA_ "GenSigStartValue" SG_ 1279 DCM_SW_Ver_3rd_Digit 254;
BA_ "UserSigValidity" SG_ 1279 DCM_SW_Ver_3rd_Digit 0;
BA_ "Version" SG_ 1279 DCM_SW_Ver_3rd_Digit "25.10.00";
BA_ "Description" SG_ 1279 DCM_SW_Ver_4th_Digit "The DCM Software version has 4 digits.

 - Example :

 1st Digit : 0x32 (HEX) -> ASCII CODE : ‘2’

 2nd Digit : 0x35 (HEX) -> ASCII CODE : ‘5’

 3rd Digit : 0x41 (HEX) -> ASCII CODE : ‘A’ 

 4th Digit : 0x33 (HEX) -> ASCII CODE : ‘3’

=> DCM Soft";
BA_ "GenSigSendType" SG_ 1279 DCM_SW_Ver_4th_Digit 4;
BA_ "GenSigStartValue" SG_ 1279 DCM_SW_Ver_4th_Digit 254;
BA_ "UserSigValidity" SG_ 1279 DCM_SW_Ver_4th_Digit 0;
BA_ "Version" SG_ 1279 DCM_SW_Ver_4th_Digit "25.10.00";
BA_ "Description" SG_ 1276 DCM_Output_Reset_Req "DCM Output Reset Request

0x0(Default) : When another signal is sent to request, 

                       this signal send 0x0(Default)";
BA_ "GenSigSendType" SG_ 1276 DCM_Output_Reset_Req 4;
BA_ "UserSigValidity" SG_ 1276 DCM_Output_Reset_Req 0;
BA_ "Version" SG_ 1276 DCM_Output_Reset_Req "24.10.05";
BA_ "Description" SG_ 1276 Resolution_Req_Width "Built-in Cam DCM Output Request Resolution Width

0x0(Default) : When another Signal is sent to request, 

                      this signal send 0x0(Default)";
BA_ "GenSigSendType" SG_ 1276 Resolution_Req_Width 4;
BA_ "UserSigValidity" SG_ 1276 Resolution_Req_Width 0;
BA_ "Version" SG_ 1276 Resolution_Req_Width "25.03.01";
BA_ "Description" SG_ 1276 Resolution_Req_Height "Built-in Cam DCM Output Request Resolution Height

0x0(Default) : When another Signal is sent to request, 

                      this signal send 0x0(Default)";
BA_ "GenSigSendType" SG_ 1276 Resolution_Req_Height 4;
BA_ "UserSigValidity" SG_ 1276 Resolution_Req_Height 0;
BA_ "Version" SG_ 1276 Resolution_Req_Height "24.10.05";
BA_ "Description" SG_ 1276 Center_offset_Width_set "Built-in Cam DCM Output Request Width pixel offset from Center

0xFFE(Default) : When another Signal is sent to request, 

                      this signal send 0xFFE(Default)";
BA_ "GenSigSendType" SG_ 1276 Center_offset_Width_set 4;
BA_ "GenSigStartValue" SG_ 1276 Center_offset_Width_set 4094;
BA_ "UserSigValidity" SG_ 1276 Center_offset_Width_set 0;
BA_ "Version" SG_ 1276 Center_offset_Width_set "24.10.05";
BA_ "Description" SG_ 1276 Center_offset_Height_set "Built-in Cam DCM Output Request Height pixel offset from Center

0xFFE(Default) : When another signal is sent to request, 

                          this signal send 0xFFE(Default)";
BA_ "GenSigSendType" SG_ 1276 Center_offset_Height_set 4;
BA_ "GenSigStartValue" SG_ 1276 Center_offset_Height_set 4094;
BA_ "UserSigValidity" SG_ 1276 Center_offset_Height_set 0;
BA_ "Version" SG_ 1276 Center_offset_Height_set "24.10.05";
BA_ "Description" SG_ 1276 DCM_FPS_Change "Requested Rear Camera FPS

0x0(Default) : When another Signal is sent to request, 

                  this signal send 0x0(Default)";
BA_ "GenSigSendType" SG_ 1276 DCM_FPS_Change 4;
BA_ "UserSigValidity" SG_ 1276 DCM_FPS_Change 0;
BA_ "Version" SG_ 1276 DCM_FPS_Change "24.10.05";
BA_ "Description" SG_ 1277 BLTN_CAM_FD_DCM_Crc1Val "The data area for CRC calculation is based on the data length (DLC) of the message DB.

The CRC shall be calculated over the entire data block (excluding the CRC bytes) including the user data, alive counter and Data ID



- CRC Polynomial (0x1021) , Ini";
BA_ "GenSigSendType" SG_ 1277 BLTN_CAM_FD_DCM_Crc1Val 4;
BA_ "GenSigStartValue" SG_ 1277 BLTN_CAM_FD_DCM_Crc1Val 65535;
BA_ "UserSigValidity" SG_ 1277 BLTN_CAM_FD_DCM_Crc1Val 3;
BA_ "Version" SG_ 1277 BLTN_CAM_FD_DCM_Crc1Val "24.10.04";
BA_ "Description" SG_ 1277 RearCamera_EmbeddedData0 "RearCamera_EmbeddedData0";
BA_ "GenSigSendType" SG_ 1277 RearCamera_EmbeddedData0 4;
BA_ "UserSigValidity" SG_ 1277 RearCamera_EmbeddedData0 0;
BA_ "Version" SG_ 1277 RearCamera_EmbeddedData0 "24.10.05";
BA_ "Description" SG_ 1277 RearCamera_EmbeddedData1 "RearCamera_EmbeddedData1";
BA_ "GenSigSendType" SG_ 1277 RearCamera_EmbeddedData1 4;
BA_ "UserSigValidity" SG_ 1277 RearCamera_EmbeddedData1 0;
BA_ "Version" SG_ 1277 RearCamera_EmbeddedData1 "24.10.05";
BA_ "Description" SG_ 1277 RearCamera_EmbeddedData2 "RearCamera_EmbeddedData2";
BA_ "GenSigSendType" SG_ 1277 RearCamera_EmbeddedData2 4;
BA_ "UserSigValidity" SG_ 1277 RearCamera_EmbeddedData2 0;
BA_ "Version" SG_ 1277 RearCamera_EmbeddedData2 "24.10.05";
BA_ "Description" SG_ 1277 RearCamera_EmbeddedData3 "RearCamera_EmbeddedData3";
BA_ "GenSigSendType" SG_ 1277 RearCamera_EmbeddedData3 4;
BA_ "UserSigValidity" SG_ 1277 RearCamera_EmbeddedData3 0;
BA_ "Version" SG_ 1277 RearCamera_EmbeddedData3 "24.10.05";
BA_ "Description" SG_ 1277 BLTN_CAM_FD_DCM_AlvCnt1Val "For the first transmission request for a data element the counter shall be initialized with 0 and shall be incremented by 1 for every subsequent send request. 

When the counter reaches the maximum value(0xFF), then it shall restart with 0 for the next s";
BA_ "GenSigSendType" SG_ 1277 BLTN_CAM_FD_DCM_AlvCnt1Val 4;
BA_ "UserSigValidity" SG_ 1277 BLTN_CAM_FD_DCM_AlvCnt1Val 3;
BA_ "Version" SG_ 1277 BLTN_CAM_FD_DCM_AlvCnt1Val "24.10.04";
BA_ "Description" SG_ 1277 BLTN_CAM_DCM_Status "DCM display output state of the built-in cam.";
BA_ "GenSigSendType" SG_ 1277 BLTN_CAM_DCM_Status 4;
BA_ "UserSigValidity" SG_ 1277 BLTN_CAM_DCM_Status 0;
BA_ "Version" SG_ 1277 BLTN_CAM_DCM_Status "24.10.05";
BA_ "Description" SG_ 1277 RearCamera_Input_Status "Built-in Camera Rear Camera Input Status";
BA_ "GenSigSendType" SG_ 1277 RearCamera_Input_Status 4;
BA_ "UserSigValidity" SG_ 1277 RearCamera_Input_Status 0;
BA_ "Version" SG_ 1277 RearCamera_Input_Status "24.10.05";
BA_ "Description" SG_ 1277 DCM_Output_Resolution_Width "Built-in Cam DCM Output Resolution Width

At the beginning of built-in cam booting, the value is ‘0x0’ for a moment.";
BA_ "GenSigSendType" SG_ 1277 DCM_Output_Resolution_Width 4;
BA_ "UserSigValidity" SG_ 1277 DCM_Output_Resolution_Width 0;
BA_ "Version" SG_ 1277 DCM_Output_Resolution_Width "25.10.00";
BA_ "Description" SG_ 1277 DCM_Output_Resolution_Height "Built-in Cam DCM Output Resolution Height

At the beginning of built-in cam booting, the value is ‘0x0’ for a moment.";
BA_ "GenSigSendType" SG_ 1277 DCM_Output_Resolution_Height 4;
BA_ "UserSigValidity" SG_ 1277 DCM_Output_Resolution_Height 0;
BA_ "Version" SG_ 1277 DCM_Output_Resolution_Height "25.10.00";
BA_ "Description" SG_ 1277 BLTN_CAM_DCM_SER_I2C_Master "Bulit-In Cam DCM LVDS output Serializer I2C Master status to inform DCM for prevention I2C master collision between Built-in Cam and DCM.";
BA_ "GenSigSendType" SG_ 1277 BLTN_CAM_DCM_SER_I2C_Master 4;
BA_ "UserSigValidity" SG_ 1277 BLTN_CAM_DCM_SER_I2C_Master 0;
BA_ "Version" SG_ 1277 BLTN_CAM_DCM_SER_I2C_Master "25.04.01";
BA_ "Description" SG_ 1277 Center_offset_Width "Built-in Cam DCM Output Width pixel offset from Center

At the beginning of built-in cam booting, the value is ‘0xFFE’ for a moment.";
BA_ "GenSigSendType" SG_ 1277 Center_offset_Width 4;
BA_ "GenSigStartValue" SG_ 1277 Center_offset_Width 4094;
BA_ "UserSigValidity" SG_ 1277 Center_offset_Width 0;
BA_ "Version" SG_ 1277 Center_offset_Width "25.10.02";
BA_ "Description" SG_ 1277 Center_offset_Height "Built-in Cam DCM Output Height pixel offset from Center

At the beginning of built-in cam booting, the value is ‘0xFFE’ for a moment.";
BA_ "GenSigSendType" SG_ 1277 Center_offset_Height 4;
BA_ "GenSigStartValue" SG_ 1277 Center_offset_Height 4094;
BA_ "UserSigValidity" SG_ 1277 Center_offset_Height 0;
BA_ "Version" SG_ 1277 Center_offset_Height "25.10.02";
BA_ "Description" SG_ 1277 FPS_RearCamera "Rear Camera FPS

At the beginning of built-in cam booting, the value is ‘0x0’ for a moment.";
BA_ "GenSigSendType" SG_ 1277 FPS_RearCamera 4;
BA_ "UserSigValidity" SG_ 1277 FPS_RearCamera 0;
BA_ "Version" SG_ 1277 FPS_RearCamera "25.10.00";
BA_ "Description" SG_ 1277 FPS_DCM_Output "DCM output FPS

At the beginning of built-in cam booting, the value is ‘0x0’ for a moment.";
BA_ "GenSigSendType" SG_ 1277 FPS_DCM_Output 4;
BA_ "UserSigValidity" SG_ 1277 FPS_DCM_Output 0;
BA_ "Version" SG_ 1277 FPS_DCM_Output "25.10.00";
BA_ "Description" SG_ 69 HTCU_Crc4Val "The data area for CRC calculation is based on the data length (DLC) of the message DB.

The CRC shall be calculated over the entire data block (excluding the CRC bytes) including the user data, alive counter and Data ID

 

- CRC Polynomial (0x1021) , In";
BA_ "GenSigStartValue" SG_ 69 HTCU_Crc4Val 65535;
BA_ "UserSigValidity" SG_ 69 HTCU_Crc4Val 3;
BA_ "RoutingFactor" SG_ 69 HTCU_Crc4Val 5;
BA_ "Version" SG_ 69 HTCU_Crc4Val "18.11.08";
BA_ "Description" SG_ 69 HTCU_CtrlablSta "This signal indicates the status of the TCU control which normally works by hydraulic pressure in the T/M";
BA_ "UserSigValidity" SG_ 69 HTCU_CtrlablSta 3;
BA_ "RoutingFactor" SG_ 69 HTCU_CtrlablSta 5;
BA_ "Version" SG_ 69 HTCU_CtrlablSta "20.10.02";
BA_ "Description" SG_ 69 HTCU_PrgrmSta "This signal informs about current program status in HTCU";
BA_ "UserSigValidity" SG_ 69 HTCU_PrgrmSta 3;
BA_ "RoutingFactor" SG_ 69 HTCU_PrgrmSta 5;
BA_ "Version" SG_ 69 HTCU_PrgrmSta "17.11.00";
BA_ "Description" SG_ 69 HTCU_FsCltchLmphmActvSta "This signal informs about engine clutch limp-home control activation";
BA_ "UserSigValidity" SG_ 69 HTCU_FsCltchLmphmActvSta 3;
BA_ "RoutingFactor" SG_ 69 HTCU_FsCltchLmphmActvSta 5;
BA_ "Version" SG_ 69 HTCU_FsCltchLmphmActvSta "17.11.00";
BA_ "Description" SG_ 69 HTCU_FsIdleTrgtRpmVal "Request idle target rpm for engine clutch limp-home control";
BA_ "UserSigValidity" SG_ 69 HTCU_FsIdleTrgtRpmVal 3;
BA_ "RoutingFactor" SG_ 69 HTCU_FsIdleTrgtRpmVal 5;
BA_ "Version" SG_ 69 HTCU_FsIdleTrgtRpmVal "17.11.00";
BA_ "Description" SG_ 69 HTCU_FsAddtnlTqLssPcVal "Additional torque loss for engine clutch limp-home control";
BA_ "UserSigValidity" SG_ 69 HTCU_FsAddtnlTqLssPcVal 3;
BA_ "RoutingFactor" SG_ 69 HTCU_FsAddtnlTqLssPcVal 5;
BA_ "Version" SG_ 69 HTCU_FsAddtnlTqLssPcVal "17.11.00";
BA_ "Description" SG_ 69 HTCU_FsEngTqRdctnPcVal "This signal informs about engine torque reduction request for engine clutch limp-home control";
BA_ "GenSigStartValue" SG_ 69 HTCU_FsEngTqRdctnPcVal 255;
BA_ "UserSigValidity" SG_ 69 HTCU_FsEngTqRdctnPcVal 3;
BA_ "RoutingFactor" SG_ 69 HTCU_FsEngTqRdctnPcVal 5;
BA_ "Version" SG_ 69 HTCU_FsEngTqRdctnPcVal "19.02.06";
BA_ "Description" SG_ 69 HTCU_LnPrsBarVal "This signal informs about the Transmission valve body line pressure command from HTCU";
BA_ "UserSigValidity" SG_ 69 HTCU_LnPrsBarVal 3;
BA_ "RoutingFactor" SG_ 69 HTCU_LnPrsBarVal 5;
BA_ "Version" SG_ 69 HTCU_LnPrsBarVal "17.11.00";
BA_ "Description" SG_ 69 HTCU_RapidKDReq "Rapid K/D Shift Request";
BA_ "UserSigValidity" SG_ 69 HTCU_RapidKDReq 3;
BA_ "RoutingFactor" SG_ 69 HTCU_RapidKDReq 5;
BA_ "Version" SG_ 69 HTCU_RapidKDReq "17.11.00";
BA_ "UserSigValidity" SG_ 69 HTCU_CurrGearSta 3;
BA_ "RoutingFactor" SG_ 69 HTCU_CurrGearSta 5;
BA_ "Version" SG_ 69 HTCU_CurrGearSta "25.07.04";
BA_ "Description" SG_ 69 HTCU_GearShftUpDisGSI "Gear Shift-up display status for Gear shift indicator (EU Regulations)";
BA_ "UserSigValidity" SG_ 69 HTCU_GearShftUpDisGSI 3;
BA_ "RoutingFactor" SG_ 69 HTCU_GearShftUpDisGSI 5;
BA_ "Version" SG_ 69 HTCU_GearShftUpDisGSI "18.08.01";
BA_ "Description" SG_ 69 HTCU_GearShftDnDisGSI "Gear Shift-down display status for Gear shift indicator (EU Regulations)";
BA_ "UserSigValidity" SG_ 69 HTCU_GearShftDnDisGSI 3;
BA_ "RoutingFactor" SG_ 69 HTCU_GearShftDnDisGSI 5;
BA_ "Version" SG_ 69 HTCU_GearShftDnDisGSI "18.08.01";
BA_ "Description" SG_ 69 HTCU_TrgtGearStaGSI "Target Gear for Gear shift indicator (EU Regulations)";
BA_ "UserSigValidity" SG_ 69 HTCU_TrgtGearStaGSI 3;
BA_ "RoutingFactor" SG_ 69 HTCU_TrgtGearStaGSI 5;
BA_ "Version" SG_ 69 HTCU_TrgtGearStaGSI "25.07.04";
BA_ "Description" SG_ 69 HTCU_SolBSta "Status of On/Off Solenoid B";
BA_ "UserSigValidity" SG_ 69 HTCU_SolBSta 3;
BA_ "RoutingFactor" SG_ 69 HTCU_SolBSta 5;
BA_ "Version" SG_ 69 HTCU_SolBSta "18.08.01";
BA_ "Description" SG_ 69 HTCU_AlvCnt4Val "For the first transmission request for a data element the counter shall be initialized with 0 and shall be incremented by 1 for every subsequent send request. 

When the counter reaches the maximum value(0xFF), then it shall restart with 0 for the next s";
BA_ "UserSigValidity" SG_ 69 HTCU_AlvCnt4Val 3;
BA_ "RoutingFactor" SG_ 69 HTCU_AlvCnt4Val 5;
BA_ "Version" SG_ 69 HTCU_AlvCnt4Val "18.11.08";
BA_ "Description" SG_ 69 HTCU_TqRdctnNegativePcVal "Torque intervention for negative reduction,referred to the indicated torque.





<Range>

-200 ~ 199.61% = 0x200 ~ 0x1FF



<Conversion>

If MSB of high byte is 1,(PH) = 0.390625 x (HEX) - 400[%],

Else,(PH) = 0.390625 x (HEX) [%]";
BA_ "GenSigStartValue" SG_ 69 HTCU_TqRdctnNegativePcVal 8191;
BA_ "UserSigValidity" SG_ 69 HTCU_TqRdctnNegativePcVal 3;
BA_ "RoutingFactor" SG_ 69 HTCU_TqRdctnNegativePcVal 5;
BA_ "Version" SG_ 69 HTCU_TqRdctnNegativePcVal "23.03.00";
BA_ "Description" SG_ 69 HTCU_PddlShftMdSlctSta "0x0:Invalid (USM display deactivated)

0x1:Paddle Step Control Mode (USM ON : Sync with DriveMode)

0x2:Manual Shift Mode (USM ON : Sync with DriveMode)

0x3:Manual Shift Mode (USM ON : Fixed to Manual Shift Mode)";
BA_ "UserSigValidity" SG_ 69 HTCU_PddlShftMdSlctSta 3;
BA_ "RoutingFactor" SG_ 69 HTCU_PddlShftMdSlctSta 5;
BA_ "Version" SG_ 69 HTCU_PddlShftMdSlctSta "24.02.09";
BA_ "Description" SG_ 69 HTCU_PrkReleaseReq "When the Parking solenoid or some wiring harness has an electrical failure, the Parking solenoid cannot be controlled by TCU anymore. In this case, TCU requests E-shifter(Electronic shift lever) to release the Parking device and make the vehicle movable.";
BA_ "UserSigValidity" SG_ 69 HTCU_PrkReleaseReq 3;
BA_ "RoutingFactor" SG_ 69 HTCU_PrkReleaseReq 5;
BA_ "Version" SG_ 69 HTCU_PrkReleaseReq "24.08.00";
BA_ "Description" SG_ 69 HTCU_TrgtGearSta "HTCU_TrgtGearSta informs about the speed, which is currently engaged in the gearbox, or, in case of a gear change (HTCU_GearChgSta), which speed is reached.

Note: Gear changes covering more than one speed are also possible.

In the P and N positions, th";
BA_ "UserSigValidity" SG_ 69 HTCU_TrgtGearSta 3;
BA_ "RoutingFactor" SG_ 69 HTCU_TrgtGearSta 5;
BA_ "Version" SG_ 69 HTCU_TrgtGearSta "25.07.04";
BA_ "Description" SG_ 69 HTCU_RdySta "Flag that the HTCU is ready to work. (In fact, this flag is true from the moment that CAN is working. So, normally no “false” will be sent on CAN.) This flag does not show that everything is alright in the HTCU. This information is given in the warning";
BA_ "UserSigValidity" SG_ 69 HTCU_RdySta 3;
BA_ "RoutingFactor" SG_ 69 HTCU_RdySta 5;
BA_ "Version" SG_ 69 HTCU_RdySta "18.08.02";
BA_ "Description" SG_ 69 HTCU_GearChgSta "HTCU_GearChgSta indicates whether a gear change is being executed in the gearbox.

Note : Gear change means a gear shift at D-range and Garage shift(PRND).";
BA_ "UserSigValidity" SG_ 69 HTCU_GearChgSta 3;
BA_ "RoutingFactor" SG_ 69 HTCU_GearChgSta 5;
BA_ "Version" SG_ 69 HTCU_GearChgSta "18.08.02";
BA_ "Description" SG_ 69 HTCU_TqRdctnPcVal "The HTCU requests a torque reduction via the signal CR_Tcu_TqInt_Pc to the ECU and MCU.

The requested torque HTCU_TqRdctnPcVal refers to a maximum torque CR_Ems_TqStd_Nm. This conversion into a physical quantity provides a range of CR_Ems_TqStd_Nm of 0 ";
BA_ "GenSigStartValue" SG_ 69 HTCU_TqRdctnPcVal 511;
BA_ "UserSigValidity" SG_ 69 HTCU_TqRdctnPcVal 3;
BA_ "RoutingFactor" SG_ 69 HTCU_TqRdctnPcVal 5;
BA_ "Version" SG_ 69 HTCU_TqRdctnPcVal "18.08.02";
BA_ "Description" SG_ 69 HTCU_FltSta "HTCU_FltSta informs about status of transmission control.



<Value Description>

Bit 0: HTCU Diagnostic failure

Bit 1: HTCU Diagnostic failure ? Limphome activated

Bit 2: OPU/EOP Diagnostic failure";
BA_ "UserSigValidity" SG_ 69 HTCU_FltSta 3;
BA_ "RoutingFactor" SG_ 69 HTCU_FltSta 5;
BA_ "Version" SG_ 69 HTCU_FltSta "18.08.02";
BA_ "Description" SG_ 69 HTCU_GearSlctrDis "Position (P, R, N..), which was identified by the gear selector.

In case the gear selector is in a intermediate position, the last clear recognized position is used.

There is no specific phase relationship between the output and any other signal.";
BA_ "GenSigStartValue" SG_ 69 HTCU_GearSlctrDis 9;
BA_ "UserSigValidity" SG_ 69 HTCU_GearSlctrDis 3;
BA_ "RoutingFactor" SG_ 69 HTCU_GearSlctrDis 5;
BA_ "Version" SG_ 69 HTCU_GearSlctrDis "25.01.00";
BA_ "Description" SG_ 69 HTCU_SlwTqRdctnPcVal "The HTCU requests a slow torque reduction via the signal HTCU_TqRdctnPcVal to the ECU and MCU.";
BA_ "GenSigStartValue" SG_ 69 HTCU_SlwTqRdctnPcVal 511;
BA_ "UserSigValidity" SG_ 69 HTCU_SlwTqRdctnPcVal 3;
BA_ "RoutingFactor" SG_ 69 HTCU_SlwTqRdctnPcVal 5;
BA_ "Version" SG_ 69 HTCU_SlwTqRdctnPcVal "18.08.02";
BA_ "UserSigValidity" SG_ 69 HTCU_PddlShftUpDn 3;
BA_ "RoutingFactor" SG_ 69 HTCU_PddlShftUpDn 5;
BA_ "Version" SG_ 69 HTCU_PddlShftUpDn "22.10.20";
BA_ "Description" SG_ 69 HTCU_FanCtrlReq "Fan control request by OPU";
BA_ "TimeoutValue" SG_ 69 HTCU_FanCtrlReq "0x0";
BA_ "UserSigValidity" SG_ 69 HTCU_FanCtrlReq 3;
BA_ "RoutingFactor" SG_ 69 HTCU_FanCtrlReq 5;
BA_ "Version" SG_ 69 HTCU_FanCtrlReq "21.07.00";
BA_ "Description" SG_ 69 HTCU_VehSpdKphVal "The vehicle speed calculated by HTCU is transferred.

If a vehicle has no vehicle speed sensor, no wheel speed sensor and no ABS(ESC) then it is impossible for an EMS to calculate veficle speed. In this case a HTCU should calculate vehicle speed and send";
BA_ "UserSigValidity" SG_ 69 HTCU_VehSpdKphVal 3;
BA_ "RoutingFactor" SG_ 69 HTCU_VehSpdKphVal 5;
BA_ "Version" SG_ 69 HTCU_VehSpdKphVal "18.08.02";
BA_ "Description" SG_ 69 HTCU_VehSpdDcmlKphVal "The signal HTCU_VehSpdDcmlKphVal means the value which is below decimal point of the vehicle speed.

For instance, if a vehicle speed is 13.75Km/h, HTCU_VehSpdKphVal means 13Km/h and HTCU_VehSpdDcmlKphVal means 0.75Km/h.

(Min ~ Max: 0.00 ~ 0.99)";
BA_ "UserSigValidity" SG_ 69 HTCU_VehSpdDcmlKphVal 3;
BA_ "RoutingFactor" SG_ 69 HTCU_VehSpdDcmlKphVal 5;
BA_ "Version" SG_ 69 HTCU_VehSpdDcmlKphVal "18.12.07";
BA_ "Description" SG_ 69 HTCU_HvOpuSpdCmdRpmVal "CR_Tcu_OpuSpdCmd_Rpm informs about the external oil pump speed.";
BA_ "UserSigValidity" SG_ 69 HTCU_HvOpuSpdCmdRpmVal 3;
BA_ "RoutingFactor" SG_ 69 HTCU_HvOpuSpdCmdRpmVal 5;
BA_ "Version" SG_ 69 HTCU_HvOpuSpdCmdRpmVal "17.11.00";
BA_ "UserSigValidity" SG_ 69 HTCU_TrgtShftClsCCanSta 3;
BA_ "RoutingFactor" SG_ 69 HTCU_TrgtShftClsCCanSta 5;
BA_ "Version" SG_ 69 HTCU_TrgtShftClsCCanSta "17.11.00";
BA_REL_ "GenSigTimeoutTime" BU_SG_REL_ vDummy_FD_B2 SG_ 648 CCU_AP_OTA_Crc1Val 1500;
BA_REL_ "GenSigTimeoutTime" BU_SG_REL_ vFD_B2 SG_ 648 CCU_AP_OTA_Crc1Val 1500;
BA_REL_ "GenSigTimeoutTime" BU_SG_REL_ vDummy_FD_B2 SG_ 648 CCU_AP_OTA_AlvCnt1Val 1500;
BA_REL_ "GenSigTimeoutTime" BU_SG_REL_ vFD_B2 SG_ 648 CCU_AP_OTA_AlvCnt1Val 1500;
BA_REL_ "GenSigTimeoutTime" BU_SG_REL_ BLTN_CAM_FD SG_ 648 CCU_OTA_mode 1500;
BA_REL_ "GenSigTimeoutTime" BU_SG_REL_ DCM_FD SG_ 648 CCU_OTA_mode 1500;
BA_REL_ "GenSigTimeoutTime" BU_SG_REL_ BLTN_CAM_FD SG_ 920 CTM_TrailerAct 1500;
BA_REL_ "GenSigTimeoutTime" BU_SG_REL_ GW_PSU_DRV_FD SG_ 918 CMS_LH_FD_Crc1Val 1500;
BA_REL_ "GenSigTimeoutTime" BU_SG_REL_ GW_PSU_DRV_FD SG_ 918 IMS_CMSPlayBackSta_LH 1500;
BA_REL_ "GenSigTimeoutTime" BU_SG_REL_ BLTN_CAM_FD SG_ 918 CMS_Opt 1500;
BA_REL_ "GenSigTimeoutTime" BU_SG_REL_ GW_PSU_DRV_FD SG_ 918 CMS_LH_FD_AlvCnt1Val 1500;
BA_REL_ "GenSigTimeoutTime" BU_SG_REL_ ATS_FD SG_ 426 CLU_Crc1Val 1500;
BA_REL_ "GenSigTimeoutTime" BU_SG_REL_ GW_PSU_DRV_FD SG_ 426 CLU_Crc1Val 1500;
BA_REL_ "GenSigTimeoutTime" BU_SG_REL_ RCM_FD SG_ 426 CLU_Crc1Val 1500;
BA_REL_ "GenSigTimeoutTime" BU_SG_REL_ SHVU_3RD_FD SG_ 426 CLU_Crc1Val 1500;
BA_REL_ "GenSigTimeoutTime" BU_SG_REL_ SHVU_REAR_FD SG_ 426 CLU_Crc1Val 1500;
BA_REL_ "GenSigTimeoutTime" BU_SG_REL_ ATS_FD SG_ 426 CLU_AlvCnt1Val 1500;
BA_REL_ "GenSigTimeoutTime" BU_SG_REL_ GW_PSU_DRV_FD SG_ 426 CLU_AlvCnt1Val 1500;
BA_REL_ "GenSigTimeoutTime" BU_SG_REL_ RCM_FD SG_ 426 CLU_AlvCnt1Val 1500;
BA_REL_ "GenSigTimeoutTime" BU_SG_REL_ SHVU_3RD_FD SG_ 426 CLU_AlvCnt1Val 1500;
BA_REL_ "GenSigTimeoutTime" BU_SG_REL_ SHVU_REAR_FD SG_ 426 CLU_AlvCnt1Val 1500;
BA_REL_ "GenSigTimeoutTime" BU_SG_REL_ ARS_FD SG_ 426 CLU_DtntOutSta 1500;
BA_REL_ "GenSigTimeoutTime" BU_SG_REL_ ATS_FD SG_ 426 CLU_DtntOutSta 1500;
BA_REL_ "GenSigTimeoutTime" BU_SG_REL_ FCS_FD SG_ 426 CLU_DtntOutSta 1500;
BA_REL_ "GenSigTimeoutTime" BU_SG_REL_ GW_PSU_3RD_FD SG_ 426 CLU_DtntOutSta 1500;
BA_REL_ "GenSigTimeoutTime" BU_SG_REL_ GW_PSU_AST_FD SG_ 426 CLU_DtntOutSta 1500;
BA_REL_ "GenSigTimeoutTime" BU_SG_REL_ GW_PSU_DRV_FD SG_ 426 CLU_DtntOutSta 1500;
BA_REL_ "GenSigTimeoutTime" BU_SG_REL_ GW_PSU_RL_FD SG_ 426 CLU_DtntOutSta 1500;
BA_REL_ "GenSigTimeoutTime" BU_SG_REL_ GW_PSU_RR_FD SG_ 426 CLU_DtntOutSta 1500;
BA_REL_ "GenSigTimeoutTime" BU_SG_REL_ GW_SAU_DRV_FD SG_ 426 CLU_DtntOutSta 1500;
BA_REL_ "GenSigTimeoutTime" BU_SG_REL_ OHCL_FD SG_ 426 CLU_DtntOutSta 1500;
BA_REL_ "GenSigTimeoutTime" BU_SG_REL_ RCS_FD SG_ 426 CLU_DtntOutSta 1500;
BA_REL_ "GenSigTimeoutTime" BU_SG_REL_ RWPC_FD SG_ 426 CLU_DtntOutSta 1500;
BA_REL_ "GenSigTimeoutTime" BU_SG_REL_ SHVU_3RD_FD SG_ 426 CLU_DtntOutSta 1500;
BA_REL_ "GenSigTimeoutTime" BU_SG_REL_ SHVU_FRNT_FD SG_ 426 CLU_DtntOutSta 1500;
BA_REL_ "GenSigTimeoutTime" BU_SG_REL_ SHVU_REAR_FD SG_ 426 CLU_DtntOutSta 1500;
BA_REL_ "GenSigTimeoutTime" BU_SG_REL_ SHVU_RL_FD SG_ 426 CLU_DtntOutSta 1500;
BA_REL_ "GenSigTimeoutTime" BU_SG_REL_ SHVU_RR_FD SG_ 426 CLU_DtntOutSta 1500;
BA_REL_ "GenSigTimeoutTime" BU_SG_REL_ WPC2_FD SG_ 426 CLU_DtntOutSta 1500;
BA_REL_ "GenSigTimeoutTime" BU_SG_REL_ WPC_FD SG_ 426 CLU_DtntOutSta 1500;
BA_REL_ "GenSigTimeoutTime" BU_SG_REL_ BLTN_CAM_FD SG_ 426 CLU_SpdUnitTyp 1500;
BA_REL_ "GenSigTimeoutTime" BU_SG_REL_ GW_PSU_DRV_FD SG_ 426 CLU_SpdUnitTyp 1500;
BA_REL_ "GenSigTimeoutTime" BU_SG_REL_ WPC2_FD SG_ 426 CLU_SpdUnitTyp 1500;
BA_REL_ "GenSigTimeoutTime" BU_SG_REL_ ARS_FD SG_ 426 CLU_RhstaLvlSta 1500;
BA_REL_ "GenSigTimeoutTime" BU_SG_REL_ ATS_FD SG_ 426 CLU_RhstaLvlSta 1500;
BA_REL_ "GenSigTimeoutTime" BU_SG_REL_ FCS_FD SG_ 426 CLU_RhstaLvlSta 1500;
BA_REL_ "GenSigTimeoutTime" BU_SG_REL_ GW_PSU_3RD_FD SG_ 426 CLU_RhstaLvlSta 1500;
BA_REL_ "GenSigTimeoutTime" BU_SG_REL_ GW_PSU_AST_FD SG_ 426 CLU_RhstaLvlSta 1500;
BA_REL_ "GenSigTimeoutTime" BU_SG_REL_ GW_PSU_DRV_FD SG_ 426 CLU_RhstaLvlSta 1500;
BA_REL_ "GenSigTimeoutTime" BU_SG_REL_ GW_PSU_RL_FD SG_ 426 CLU_RhstaLvlSta 1500;
BA_REL_ "GenSigTimeoutTime" BU_SG_REL_ GW_PSU_RR_FD SG_ 426 CLU_RhstaLvlSta 1500;
BA_REL_ "GenSigTimeoutTime" BU_SG_REL_ GW_SAU_DRV_FD SG_ 426 CLU_RhstaLvlSta 1500;
BA_REL_ "GenSigTimeoutTime" BU_SG_REL_ OHCL_FD SG_ 426 CLU_RhstaLvlSta 1500;
BA_REL_ "GenSigTimeoutTime" BU_SG_REL_ RCS_FD SG_ 426 CLU_RhstaLvlSta 1500;
BA_REL_ "GenSigTimeoutTime" BU_SG_REL_ RWPC_FD SG_ 426 CLU_RhstaLvlSta 1500;
BA_REL_ "GenSigTimeoutTime" BU_SG_REL_ SHVU_3RD_FD SG_ 426 CLU_RhstaLvlSta 1500;
BA_REL_ "GenSigTimeoutTime" BU_SG_REL_ SHVU_FRNT_FD SG_ 426 CLU_RhstaLvlSta 1500;
BA_REL_ "GenSigTimeoutTime" BU_SG_REL_ SHVU_REAR_FD SG_ 426 CLU_RhstaLvlSta 1500;
BA_REL_ "GenSigTimeoutTime" BU_SG_REL_ SHVU_RL_FD SG_ 426 CLU_RhstaLvlSta 1500;
BA_REL_ "GenSigTimeoutTime" BU_SG_REL_ SHVU_RR_FD SG_ 426 CLU_RhstaLvlSta 1500;
BA_REL_ "GenSigTimeoutTime" BU_SG_REL_ WPC2_FD SG_ 426 CLU_RhstaLvlSta 1500;
BA_REL_ "GenSigTimeoutTime" BU_SG_REL_ WPC_FD SG_ 426 CLU_RhstaLvlSta 1500;
BA_REL_ "GenSigTimeoutTime" BU_SG_REL_ BLTN_CAM_FD SG_ 426 CLU_DisSpdVal 1500;
BA_REL_ "GenSigTimeoutTime" BU_SG_REL_ GW_PSU_AST_FD SG_ 426 CLU_DisSpdVal 1500;
BA_REL_ "GenSigTimeoutTime" BU_SG_REL_ GW_PSU_DRV_FD SG_ 426 CLU_DisSpdVal 1500;
BA_REL_ "GenSigTimeoutTime" BU_SG_REL_ WPC2_FD SG_ 426 CLU_DisSpdVal 1500;
BA_REL_ "GenSigTimeoutTime" BU_SG_REL_ ARS_FD SG_ 426 CLU_DisSpdVal_KPH 1500;
BA_REL_ "GenSigTimeoutTime" BU_SG_REL_ ATS_FD SG_ 426 CLU_DisSpdVal_KPH 1500;
BA_REL_ "GenSigTimeoutTime" BU_SG_REL_ DCM_FD SG_ 426 CLU_DisSpdVal_KPH 1500;
BA_REL_ "GenSigTimeoutTime" BU_SG_REL_ FCS_FD SG_ 426 CLU_DisSpdVal_KPH 1500;
BA_REL_ "GenSigTimeoutTime" BU_SG_REL_ GW_PSU_3RD_FD SG_ 426 CLU_DisSpdVal_KPH 1500;
BA_REL_ "GenSigTimeoutTime" BU_SG_REL_ GW_PSU_AST_FD SG_ 426 CLU_DisSpdVal_KPH 1500;
BA_REL_ "GenSigTimeoutTime" BU_SG_REL_ GW_PSU_DRV_FD SG_ 426 CLU_DisSpdVal_KPH 1500;
BA_REL_ "GenSigTimeoutTime" BU_SG_REL_ GW_PSU_RL_FD SG_ 426 CLU_DisSpdVal_KPH 1500;
BA_REL_ "GenSigTimeoutTime" BU_SG_REL_ GW_PSU_RR_FD SG_ 426 CLU_DisSpdVal_KPH 1500;
BA_REL_ "GenSigTimeoutTime" BU_SG_REL_ GW_SAU_DRV_FD SG_ 426 CLU_DisSpdVal_KPH 1500;
BA_REL_ "GenSigTimeoutTime" BU_SG_REL_ RCM_FD SG_ 426 CLU_DisSpdVal_KPH 1500;
BA_REL_ "GenSigTimeoutTime" BU_SG_REL_ RWPC_FD SG_ 426 CLU_DisSpdVal_KPH 1500;
BA_REL_ "GenSigTimeoutTime" BU_SG_REL_ SHVU_3RD_FD SG_ 426 CLU_DisSpdVal_KPH 1500;
BA_REL_ "GenSigTimeoutTime" BU_SG_REL_ SHVU_FRNT_FD SG_ 426 CLU_DisSpdVal_KPH 1500;
BA_REL_ "GenSigTimeoutTime" BU_SG_REL_ SHVU_REAR_FD SG_ 426 CLU_DisSpdVal_KPH 1500;
BA_REL_ "GenSigTimeoutTime" BU_SG_REL_ SHVU_RL_FD SG_ 426 CLU_DisSpdVal_KPH 1500;
BA_REL_ "GenSigTimeoutTime" BU_SG_REL_ SHVU_RR_FD SG_ 426 CLU_DisSpdVal_KPH 1500;
BA_REL_ "GenSigTimeoutTime" BU_SG_REL_ WPC2_FD SG_ 426 CLU_DisSpdVal_KPH 1500;
BA_REL_ "GenSigTimeoutTime" BU_SG_REL_ WPC_FD SG_ 426 CLU_DisSpdVal_KPH 1500;
BA_REL_ "GenSigTimeoutTime" BU_SG_REL_ ATS_FD SG_ 426 CLU_AutoBrightSta 1500;
BA_REL_ "GenSigTimeoutTime" BU_SG_REL_ BLTN_CAM_FD SG_ 426 CLU_AutoBrightSta 1500;
BA_REL_ "GenSigTimeoutTime" BU_SG_REL_ FCS_FD SG_ 426 CLU_AutoBrightSta 1500;
BA_REL_ "GenSigTimeoutTime" BU_SG_REL_ GW_PSU_3RD_FD SG_ 426 CLU_AutoBrightSta 1500;
BA_REL_ "GenSigTimeoutTime" BU_SG_REL_ GW_PSU_AST_FD SG_ 426 CLU_AutoBrightSta 1500;
BA_REL_ "GenSigTimeoutTime" BU_SG_REL_ GW_PSU_DRV_FD SG_ 426 CLU_AutoBrightSta 1500;
BA_REL_ "GenSigTimeoutTime" BU_SG_REL_ GW_PSU_RL_FD SG_ 426 CLU_AutoBrightSta 1500;
BA_REL_ "GenSigTimeoutTime" BU_SG_REL_ GW_PSU_RR_FD SG_ 426 CLU_AutoBrightSta 1500;
BA_REL_ "GenSigTimeoutTime" BU_SG_REL_ GW_SAU_DRV_FD SG_ 426 CLU_AutoBrightSta 1500;
BA_REL_ "GenSigTimeoutTime" BU_SG_REL_ OHCL_FD SG_ 426 CLU_AutoBrightSta 1500;
BA_REL_ "GenSigTimeoutTime" BU_SG_REL_ PSB_FD SG_ 426 CLU_AutoBrightSta 1500;
BA_REL_ "GenSigTimeoutTime" BU_SG_REL_ RCS_FD SG_ 426 CLU_AutoBrightSta 1500;
BA_REL_ "GenSigTimeoutTime" BU_SG_REL_ RWPC_FD SG_ 426 CLU_AutoBrightSta 1500;
BA_REL_ "GenSigTimeoutTime" BU_SG_REL_ SHVU_3RD_FD SG_ 426 CLU_AutoBrightSta 1500;
BA_REL_ "GenSigTimeoutTime" BU_SG_REL_ SHVU_FRNT_FD SG_ 426 CLU_AutoBrightSta 1500;
BA_REL_ "GenSigTimeoutTime" BU_SG_REL_ SHVU_REAR_FD SG_ 426 CLU_AutoBrightSta 1500;
BA_REL_ "GenSigTimeoutTime" BU_SG_REL_ SHVU_RL_FD SG_ 426 CLU_AutoBrightSta 1500;
BA_REL_ "GenSigTimeoutTime" BU_SG_REL_ SHVU_RR_FD SG_ 426 CLU_AutoBrightSta 1500;
BA_REL_ "GenSigTimeoutTime" BU_SG_REL_ WPC2_FD SG_ 426 CLU_AutoBrightSta 1500;
BA_REL_ "GenSigTimeoutTime" BU_SG_REL_ WPC_FD SG_ 426 CLU_AutoBrightSta 1500;
BA_REL_ "GenSigTimeoutTime" BU_SG_REL_ DCM_FD SG_ 1278 DCM_VideoOut_Interface_Ver_Major 5000;
BA_REL_ "GenSigTimeoutTime" BU_SG_REL_ DCM_FD SG_ 1278 DCM_VideoOut_Interface_Ver_Minor 5000;
BA_REL_ "GenSigTimeoutTime" BU_SG_REL_ DCM_FD SG_ 1278 BLTN_CAM_HW_Platform_Ver_Major 5000;
BA_REL_ "GenSigTimeoutTime" BU_SG_REL_ DCM_FD SG_ 1278 BLTN_CAM_HW_Platform_Ver_Minor 5000;
BA_REL_ "GenSigTimeoutTime" BU_SG_REL_ DCM_FD SG_ 1278 RearCamera_HW_Ver_Major 5000;
BA_REL_ "GenSigTimeoutTime" BU_SG_REL_ DCM_FD SG_ 1278 RearCamera_HW_Ver_Minor 5000;
BA_REL_ "GenSigTimeoutTime" BU_SG_REL_ DCM_FD SG_ 1278 RearCamera_SW_Ver_Major 5000;
BA_REL_ "GenSigTimeoutTime" BU_SG_REL_ DCM_FD SG_ 1278 RearCamera_SW_Ver_Minor 5000;
BA_REL_ "GenSigTimeoutTime" BU_SG_REL_ DCM_FD SG_ 1278 RearCamera_ISP_Ver0 5000;
BA_REL_ "GenSigTimeoutTime" BU_SG_REL_ DCM_FD SG_ 1278 RearCamera_ISP_Ver1 5000;
BA_REL_ "GenSigTimeoutTime" BU_SG_REL_ DCM_FD SG_ 1278 RearCamera_ISP_Ver2 5000;
BA_REL_ "GenSigTimeoutTime" BU_SG_REL_ DCM_FD SG_ 1278 RearCamera_ISP_Ver3 5000;
BA_REL_ "GenSigTimeoutTime" BU_SG_REL_ DCM_FD SG_ 1278 DCM_Output_Color_Fromat 5000;
BA_REL_ "GenSigTimeoutTime" BU_SG_REL_ DCM_FD SG_ 1278 DCM_Output_Color_bit_Num 5000;
BA_REL_ "GenSigTimeoutTime" BU_SG_REL_ DCM_FD SG_ 1278 RearCamera_Lenz_Ver 5000;
BA_REL_ "GenSigTimeoutTime" BU_SG_REL_ BLTN_CAM_FD SG_ 1279 DCM_HW_Ver_Major 5000;
BA_REL_ "GenSigTimeoutTime" BU_SG_REL_ BLTN_CAM_FD SG_ 1279 DCM_HW_Ver_Minor 5000;
BA_REL_ "GenSigTimeoutTime" BU_SG_REL_ BLTN_CAM_FD SG_ 1279 DCM_SW_Ver_1st_Digit 5000;
BA_REL_ "GenSigTimeoutTime" BU_SG_REL_ BLTN_CAM_FD SG_ 1279 DCM_SW_Ver_2nd_Digit 5000;
BA_REL_ "GenSigTimeoutTime" BU_SG_REL_ BLTN_CAM_FD SG_ 1279 DCM_SW_Ver_3rd_Digit 5000;
BA_REL_ "GenSigTimeoutTime" BU_SG_REL_ BLTN_CAM_FD SG_ 1279 DCM_SW_Ver_4th_Digit 5000;
BA_REL_ "GenSigTimeoutTime" BU_SG_REL_ BLTN_CAM_FD SG_ 1276 DCM_Output_Reset_Req 0;
BA_REL_ "GenSigTimeoutTime" BU_SG_REL_ BLTN_CAM_FD SG_ 1276 Resolution_Req_Width 0;
BA_REL_ "GenSigTimeoutTime" BU_SG_REL_ BLTN_CAM_FD SG_ 1276 Resolution_Req_Height 0;
BA_REL_ "GenSigTimeoutTime" BU_SG_REL_ BLTN_CAM_FD SG_ 1276 Center_offset_Width_set 0;
BA_REL_ "GenSigTimeoutTime" BU_SG_REL_ BLTN_CAM_FD SG_ 1276 Center_offset_Height_set 0;
BA_REL_ "GenSigTimeoutTime" BU_SG_REL_ BLTN_CAM_FD SG_ 1276 DCM_FPS_Change 0;
BA_REL_ "GenSigTimeoutTime" BU_SG_REL_ DCM_FD SG_ 1277 RearCamera_EmbeddedData0 5000;
BA_REL_ "GenSigTimeoutTime" BU_SG_REL_ DCM_FD SG_ 1277 RearCamera_EmbeddedData1 5000;
BA_REL_ "GenSigTimeoutTime" BU_SG_REL_ DCM_FD SG_ 1277 RearCamera_EmbeddedData2 5000;
BA_REL_ "GenSigTimeoutTime" BU_SG_REL_ DCM_FD SG_ 1277 RearCamera_EmbeddedData3 5000;
BA_REL_ "GenSigTimeoutTime" BU_SG_REL_ DCM_FD SG_ 1277 BLTN_CAM_DCM_Status 5000;
BA_REL_ "GenSigTimeoutTime" BU_SG_REL_ DCM_FD SG_ 1277 RearCamera_Input_Status 5000;
BA_REL_ "GenSigTimeoutTime" BU_SG_REL_ DCM_FD SG_ 1277 DCM_Output_Resolution_Width 5000;
BA_REL_ "GenSigTimeoutTime" BU_SG_REL_ DCM_FD SG_ 1277 DCM_Output_Resolution_Height 5000;
BA_REL_ "GenSigTimeoutTime" BU_SG_REL_ DCM_FD SG_ 1277 BLTN_CAM_DCM_SER_I2C_Master 5000;
BA_REL_ "GenSigTimeoutTime" BU_SG_REL_ DCM_FD SG_ 1277 Center_offset_Width 5000;
BA_REL_ "GenSigTimeoutTime" BU_SG_REL_ DCM_FD SG_ 1277 Center_offset_Height 5000;
BA_REL_ "GenSigTimeoutTime" BU_SG_REL_ DCM_FD SG_ 1277 FPS_RearCamera 5000;
BA_REL_ "GenSigTimeoutTime" BU_SG_REL_ DCM_FD SG_ 1277 FPS_DCM_Output 5000;
VAL_ 648 CCU_AP_OTA_Crc1Val 0 "0x0~0xFFFF:CRCValue" 65535 "0x0~0xFFFF:CRCValue" ;
VAL_ 648 CCU_AP_OTA_AlvCnt1Val 0 "0x0~0xFF:AlvCntValue" 255 "0x0~0xFF:AlvCntValue" ;
VAL_ 648 CCU_OTA_mode 0 "idle" 1 "Download" 2 "BackgroundSend" 3 "UpdateReady_bf_apv" 4 "UpdateReady_af_apv" 5 "Update_preprocess" 6 "Update_PE" 7 "Update_other" ;
VAL_ 648 CCU_OTA_IG3On_request 0 "off(Default)" 1 "on" 2 "Not used" 3 "Error Indicator" ;
VAL_ 648 OTA_Cond_Vehicle_Pwr 0 "NoDisplay" 1 "OK" 2 "NOK" 3 "Reserved" ;
VAL_ 648 OTA_Cond_Gear_P 0 "NoDisplay" 1 "OK" 2 "NOK" 3 "Reserved" ;
VAL_ 648 OTA_Cond_Parking_Brk 0 "NoDisplay" 1 "OK" 2 "NOK" 3 "Reserved" ;
VAL_ 648 OTA_Cond_Ext_Lamp 0 "NoDisplay" 1 "OK" 2 "NOK" 3 "Reserved" ;
VAL_ 648 OTA_Cond_Hood_Closed 0 "NoDisplay" 1 "OK" 2 "NOK" 3 "Reserved" ;
VAL_ 648 CCU_OTA_req_power_State 0 "No Control (Default)" 1 "Keep Power On state" 2 "Power off" 3 "Invalid" ;
VAL_ 648 OTA_Cond_HighBatt 0 "NoDisplay" 1 "OK" 2 "NOK" 3 "RESERVED" ;
VAL_ 648 CCU_OTA_Cond_Request 0 "No Request" 1 "Request" 2 "Not Used" 3 "Error Indicator" ;
VAL_ 648 CCU_OTA_Tele_Cranking 0 "default (off)" 1 "IGN1 on, Cranking" 2 "IGN1 on" 3 "Stop" 7 "Error Indicator" ;
VAL_ 648 OTA_UI_Ready_request 0 "off (default)" 1 "ON" 2 "Not Used" 3 "Error Indicator" ;
VAL_ 648 OTA_Result 0 "Default" 1 "Success" 2 "failed_rollback_complete" 3 "failed_rollback_failed" ;
VAL_ 648 CF_AVN_InterAutoLockMode_Set2_Co 0 "Default" 1 "Auto Mode" 2 "Lock Mode" 3 "Unlock Mode" 4 "Reserved" 5 "Reserved" 6 "Reserved" 7 "Invalid" ;
VAL_ 648 CCU_OTA_EOU 0 "OFF" 1 "ON" 2 "Reserved" 3 "Invalid" ;
VAL_ 920 CTM_FD_Crc2Val 0 "0x0~0xFFFF:CRCValue" 65535 "0x0~0xFFFF:CRCValue" ;
VAL_ 920 ITBC_TrLampTypeSta 4 "RESERVED" 5 "RESERVED" 6 "RESERVED" 7 "Invalid" 0 "Default" 1 "Separate Light" 2 "Combined Light" 3 "RESERVED" ;
VAL_ 920 CTM_FD_AlvCnt2Val 0 "0x0~0xFF:AlvCntValue" 255 "0x0~0xFF:AlvCntValue" ;
VAL_ 920 ITBC_Brk_FaultWarnSta 0 "off" 1 "Wiring Fault" 2 "Module Fault" 3 "System Fault" 4 "RESERVED" 5 "RESERVED" 6 "RESERVED" 7 "Invalid" ;
VAL_ 920 USM_TrailerTypSta 0 "off" 1 "Electric Light" 2 "Electric Heavy" 3 "EOH Light" 4 "EOH Heavy" 5 "Invalid" ;
VAL_ 920 ITBC_TrailerDisplayAppliedSta 0 "Default" 1 "ITBC Applied" 2 "TCM Applied" 3 "Invalid" ;
VAL_ 920 ITBC_Brk_FnctWarnSta 0 "Off" 1 "Auto Disabled" 2 "Manual Disabled" 3 "All Disabled" 4 "RESERVED" 5 "RESERVED" 6 "RESERVED" 7 "Invalid" ;
VAL_ 920 ITBC_LampWarnSta 0 "off" 1 "Tail Lamp Fault" 2 "Rear Fog Fault" 3 "Backup Lamp Fault" ;
VAL_ 920 ITBC_Brk_DisconnWarnSta 0 "off" 1 "Connection Check" 2 "RESERVED" 3 "Invalid" ;
VAL_ 920 ITBC_TrailerBrkOut 0 "0x0~0x64:0 ~ 100%" 100 "0x0~0x64:0 ~ 100%" 101 "RESERVED" 102 "RESERVED" 103 "RESERVED" 104 "RESERVED" 105 "RESERVED" 106 "RESERVED" 107 "RESERVED" 108 "RESERVED" 109 "RESERVED" 110 "RESERVED" 111 "RESERVED" 112 "RESERVED" 113 "RESERVED" 114 "RESERVED" 115 "RESERVED" 116 "RESERVED" 117 "RESERVED" 118 "RESERVED" 119 "RESERVED" 120 "RESERVED" 121 "RESERVED" 122 "RESERVED" 123 "RESERVED" 124 "RESERVED" 125 "RESERVED" 126 "RESERVED" 127 "Invalid" ;
VAL_ 920 ITBC_TrailerBrkGainVal 0 "0 ~20" 1 "0 ~20" 2 "0 ~20" 3 "0 ~20" 4 "0 ~20" 5 "0 ~20" 6 "0 ~20" 7 "0 ~20" 8 "0 ~20" 9 "0 ~20" 10 "0 ~20" 11 "0 ~20" 12 "0 ~20" 13 "0 ~20" 14 "0 ~20" 15 "0 ~20" 16 "0 ~20" 17 "0 ~20" 18 "0 ~20" 19 "0 ~20" 20 "0 ~20" 31 "Invalid" ;
VAL_ 920 ITBC_SysWarn 0 "Default" 1 "TBC Switch Error" 2 "TBC Connection Check" 3 "TBC Lamp Error" 4 "RESERVED" 5 "RESERVED" 6 "RESERVED" 7 "RESERVED" ;
VAL_ 920 ITBC_ResetOpSta 0 "Normal" 1 "Reset Complete" 2 "Reset Fail" 3 "RESERVED" ;
VAL_ 920 ITBC_BrkWarn 0 "off" 1 "Warning" 2 "RESERVED" 3 "Invalid" ;
VAL_ 920 ITBC_TrnSigLmpWarn 0 "off" 1 "Left Turn Signal warning" 2 "Right Turn Signal warning" 3 "Turn Signal warning" ;
VAL_ 920 ITBC_StpLmpWarn 0 "off" 1 "Warning" 2 "RESERVE" 3 "Invalid" ;
VAL_ 920 CTM_TrailerAct 0 "Not Connected" 1 "Connected" 2 "Disconnect" 3 "Invaild" ;
VAL_ 920 CTM_RearfogAct 0 "Off" 1 "On" 2 "RESERVED" 3 "Invaild" ;
VAL_ 920 CTM_StpLmpOpnSta 0 "Normal" 1 "Open Status" 2 "Not Used" 3 "Error Indicator" ;
VAL_ 920 CTM_TrnSigLmpLftOpnSta 0 "Normal" 1 "Open Status" 2 "Not Used" 3 "Error Indicator" ;
VAL_ 920 CTM_TrnSigLmpRtOpnSta 0 "Normal" 1 "Open Status" 2 "Not Used" 3 "Error Indicator" ;
VAL_ 920 CTM_ExtTailLmpLftOpnSta 0 "Normal" 1 "Open Status" 2 "Not Used" 3 "Error Indicator" ;
VAL_ 920 CTM_ExtTailLmpRtOpnSta 0 "Normal" 1 "Open Status" 2 "Not Used" 3 "Error Indicator" ;
VAL_ 920 CTM_Exra_EbrakSta 0 "Off" 1 "On" 2 "Not Used" 3 "Error Indicator" ;
VAL_ 920 CTM_TrlAngl_200ms 65535 "Error Indicator" ;
VAL_ 920 TCM_ResetOpSta 0 "Normal" 1 "Reset Complete" 2 "Reset Fail" 3 "RESERVED" ;
VAL_ 918 CMS_LH_FD_Crc1Val 0 "0x0~0xFFFF:CRCValue" 65535 "0x0~0xFFFF:CRCValue" ;
VAL_ 918 IMS_CMSPlayBackSta_LH 0 "Stop" 1 "Play 1" 2 "Play 2" 3 "Play 3" 4 "Smart IMS" 5 "Guest" 6 "Profile 1" 7 "Profile 2" 8 "Profile 3" 9 "Profile 4" 10 "Profile 5" 11 "Profile 6" 12 "Profile 7" 13 "Profile 8" 14 "Profile 9" 15 "Error Indicator" ;
VAL_ 918 CMSFldReq 0 "Default" 1 "Folding Request" 2 "Unfolding Request" 3 "RESERVED" ;
VAL_ 918 CMS_LH_FoldingSta 0 "Off" 1 "Folding" 2 "RESERVED" 3 "Error Indicator" ;
VAL_ 918 CMS_LH_UnfoldingSta 0 "Off" 1 "Unfolding" 2 "RESERVED" 3 "Error Indicator" ;
VAL_ 918 CMS_LHVerPosVal 0 "0x00~0xFA:Real values" 250 "0x00~0xFA:Real values" 251 "RESERVED" 252 "RESERVED" 253 "RESERVED" 254 "RESERVED" 255 "Error Indicator" ;
VAL_ 918 CMS_LHHorPosVal 0 "0x00~0xFA:Real values" 250 "0x00~0xFA:Real values" 251 "RESERVED" 252 "RESERVED" 253 "RESERVED" 254 "RESERVED" 255 "Error Indicator" ;
VAL_ 918 CMS_LHSta 0 "Default" 1 "Valid" 2 "RESERVED" 3 "Error Indicator" ;
VAL_ 918 CMS_Opt 0 "None CMS" 1 "CMS applied" ;
VAL_ 918 CMS_LH_FD_AlvCnt1Val 0 "0x0~0xFF:AlvCntValue" 255 "0x0~0xFF:AlvCntValue" ;
VAL_ 918 Monitor_ViewPanningCmd 0 "No Movement" 1 "Move Up" 2 "Move Down" 3 "Move Left" 4 "Move Right" 5 "RESERVED" 6 "RESERVED" 7 "RESERVED" ;
VAL_ 918 DSM_LH_ResetOpSta 0 "Normal" 1 "Reset Complete" 2 "Reset Fail" 3 "RESERVED" ;
VAL_ 918 USM_TurnDstLnDispSta 0 "Default" 1 "Off" 2 "On" 3 "RESERVED" ;
VAL_ 918 USM_TurnDstLnDispStaRH 0 "Default" 1 "Off" 2 "On" 3 "RESERVED" ;
VAL_ 918 USM_RhstaLvlEnaSta 0 "Default" 1 "Off" 2 "On" 3 "RESERVED" ;
VAL_ 918 USM_RhstaLvlEnaStaRH 0 "Default" 1 "Off" 2 "On" 3 "RESERVED" ;
VAL_ 918 USM_CMSDayBrgtnsLvlLHSta 0 "-5 Level" 1 "-4 Level" 2 "-3 Level" 3 "-2 Level" 4 "-1 Level" 5 "0 Level" 6 "1 Level" 7 "2 Level" 8 "3 Level" 9 "4 Level" 10 "5 Level" 11 "RESERVED" 12 "RESERVED" 13 "RESERVED" 14 "Error Indicator" 15 "RESERVED" ;
VAL_ 918 USM_CMSNgtBrgtnsLvlLHSta 0 "-5 Level" 1 "-4 Level" 2 "-3 Level" 3 "-2 Level" 4 "-1 Level" 5 "0 Level" 6 "1 Level" 7 "2 Level" 8 "3 Level" 9 "4 Level" 10 "5 Level" 11 "RESERVED" 12 "RESERVED" 13 "RESERVED" 14 "Error Indicator" 15 "RESERVED" ;
VAL_ 160 WHL_Crc1Val 0 "0x0~0xFFFF:CRCValue" 65535 "0x0~0xFFFF:CRCValue" ;
VAL_ 160 WHL_SpdRRVal 16383 "Error" ;
VAL_ 160 WHL_AlvCnt1Val 0 "0x0~0xFF:AlvCntValue" 255 "0x0~0xFF:AlvCntValue" ;
VAL_ 160 WHL_PlsFLVal 255 "Error" ;
VAL_ 160 WHL_PlsFRVal 255 "Error" ;
VAL_ 160 WHL_PlsRLVal 255 "Error" ;
VAL_ 160 WHL_PlsRRVal 255 "Error" ;
VAL_ 160 WHL_DirFLVal 0 "Unknown (Wheel moving stop state or Not applied wheel sensor for direction)" 1 "Forward direction" 2 "Backward direction" 3 "Error identifier" ;
VAL_ 160 WHL_DirFRVal 0 "Unknown (Wheel moving stop state or Not applied wheel sensor for direction)" 1 "Forward direction" 2 "Backward direction" 3 "Error identifier" ;
VAL_ 160 WHL_DirRLVal 0 "Unknown (Wheel moving stop state or Not applied wheel sensor for direction)" 1 "Forward direction" 2 "Backward direction" 3 "Error identifier" ;
VAL_ 160 WHL_DirRRVal 0 "Unknown (Wheel moving stop state or Not applied wheel sensor for direction)" 1 "Forward direction" 2 "Backward direction" 3 "Error identifier" ;
VAL_ 160 WHL_SpdFLVal 16383 "Error" ;
VAL_ 160 WHL_SpdFRVal 16383 "Error" ;
VAL_ 160 WHL_SpdRLVal 16383 "Error" ;
VAL_ 426 CLU_Crc1Val 0 "0x0~0xFFFF:CRCValue" 65535 "0x0~0xFFFF:CRCValue" ;
VAL_ 426 CLU_FuelSenderRstReq 0 "Default" 1 "Initialization" 2 "RESERVED" 3 "Invalid" ;
VAL_ 426 CLU_PRKDispRdy 0 "Init" 1 "Impossible to display" 2 "Normal Operating Status" 3 "Invalid" ;
VAL_ 426 CLU_XtrekPlusOnOffReq 0 "Default" 1 "X-TREK+ on request" 2 "X-TREK+ off request" 3 "RESERVED" ;
VAL_ 426 CLU_ISG_OFF_SoftkeySta 0 "Default" 1 "Pushed" 2 "RESERVED" 3 "Invalid" ;
VAL_ 426 CLU_AlvCnt1Val 0 "0x0~0xFF:AlvCntValue" 255 "0x0~0xFF:AlvCntValue" ;
VAL_ 426 CLU_DtntOutSta 0 "Detent Off" 1 "Detent On" 2 "Not used" 3 "Error Indicator" ;
VAL_ 426 CLU_SpdUnitTyp 0 "km/h" 1 "MPH" 2 "Not used" 3 "Error Indicator" ;
VAL_ 426 CLU_DisSpdDcmlVal 0 "0" 1 "0.125" 2 "0.250" 3 "0.375" ;
VAL_ 426 CLU_SWRCCrsMainSwSta 0 "Off" 1 "Key On" 2 "Reserved" 3 "Invalid" ;
VAL_ 426 CLU_SWRCCrsSwSta 0 "Idle Position" 1 "Plus" 2 "Minus" 3 "Headway" 4 "Cancel/Pause" 5 "Reserved" 6 "Reserved" 7 "Reserved" ;
VAL_ 426 CLU_SWRCLFASwSta 0 "Off" 1 "Key On" 2 "Reserved" 3 "Invalid" ;
VAL_ 426 CLU_SWRCSldMainSwSta 0 "Off" 1 "Key On" 2 "Reserved" 3 "Invalid" ;
VAL_ 426 CLU_RhstaLvlSta 0 "Reserved" 1 "Step 1" 2 "Step 2" 3 "Step 3" 4 "Step 4" 5 "Step 5" 6 "Step 6" 7 "Step 7" 8 "Step 8" 9 "Step 9" 10 "Step 10" 11 "Step 11" 12 "Step 12" 13 "Step 13" 14 "Step 14" 15 "Step 15" 16 "Step 16" 17 "Step 17" 18 "Step 18" 19 "Step 19" 20 "Step 20 (Reset Value)" 21 "Step 21 (Detent)" ;
VAL_ 426 CLU_DisSpdVal 1023 "Error" ;
VAL_ 426 CLU_OKSwSta 0 "Off" 1 "Key On" 2 "Reserved" 3 "Invalid" ;
VAL_ 426 CLU_DisSpdVal_KPH 511 "Error" ;
VAL_ 426 CLU_PwrAutoOffResetReq_HCU 0 "Default" 1 "Reset Request" 2 "Reserved" 3 "Invalid" ;
VAL_ 426 CLU_CUSTOMSta_NEW 0 "Default" 1 "MY DRIVE MODE(CUSTOM)" 2 "SMART(CUSTOM)" 3 "BABY(CUSTOM)" 4 "RETRO(CUSTOM)" 5 "SNOW(CUSTOM)-Not Terrain" 6 "COMFORT(REAR)(CUSTOM)" 7 "" 8 "" 9 "" 10 "" 11 "" 12 "" 13 "" 14 "Off(CUSTOM)" 15 "Invalid" ;
VAL_ 426 CLU_AutoBrightSta 0 "Reserved (Not Used)" 1 "01~0xC8:Bright State (1~200 Step)" 200 "01~0xC8:Bright State (1~200 Step)" ;
VAL_ 426 CLU_NotMinModeBrightSta 0 "RESERVED" 1 "01~0xC8:CLU Bright State (1~200 Step)" 200 "01~0xC8:CLU Bright State (1~200 Step)" 201 "RESERVED" 202 "RESERVED" 203 "RESERVED" 204 "RESERVED" 205 "RESERVED" 206 "RESERVED" 207 "RESERVED" 208 "RESERVED" 209 "RESERVED" 210 "RESERVED" 211 "RESERVED" 212 "RESERVED" 213 "RESERVED" 214 "RESERVED" 215 "RESERVED" 216 "RESERVED" 217 "RESERVED" 218 "RESERVED" 219 "RESERVED" 220 "RESERVED" 221 "RESERVED" 222 "RESERVED" 223 "RESERVED" 224 "RESERVED" 225 "RESERVED" 226 "RESERVED" 227 "RESERVED" 228 "RESERVED" 229 "RESERVED" 230 "RESERVED" 231 "RESERVED" 232 "RESERVED" 233 "RESERVED" 234 "RESERVED" 235 "RESERVED" 236 "RESERVED" 237 "RESERVED" 238 "RESERVED" 239 "RESERVED" 240 "RESERVED" 241 "RESERVED" 242 "RESERVED" 243 "RESERVED" 244 "RESERVED" 245 "RESERVED" 246 "RESERVED" 247 "RESERVED" 248 "RESERVED" 249 "RESERVED" 250 "RESERVED" 251 "RESERVED" 252 "RESERVED" 253 "RESERVED" 254 "RESERVED" 255 "RESERVED" ;
VAL_ 426 CLU_FuelSenderResistVal 0 "Default(no data)" 1 "1~0x1FFE:0.1~819.0(Ω)" 8190 "1~0x1FFE:0.1~819.0(Ω)" 8191 "Invalid" ;
VAL_ 293 SAS_AnglVal 0 "0x0000~0x7FFE:real value" 32766 "0x0000~0x7FFE:real value" 32767 "Error Indicator" 32768 "8000~0xFFFF:real value" 65535 "8000~0xFFFF:real value" ;
VAL_ 293 SAS_SpdVal 0 "0x00~0xFE:real value" 254 "0x00~0xFE:real value" 255 "Error Indicator" ;
VAL_ 293 SAS_IntSta 0 "real vaule" 1 "real vaule" 2 "real vaule" 3 "real vaule" 4 "real vaule" 5 "real vaule" 6 "real vaule" 7 "real vaule" 8 "real vaule" 9 "real vaule" 10 "real vaule" 11 "real vaule" 12 "real vaule" 13 "real vaule" 14 "real vaule" 15 "real vaule" 16 "10~0xFF:RESERVED" 255 "10~0xFF:RESERVED" ;
VAL_ 53 VCU_Crc1Val 0 "0x0~0xFFFF:CRCValue" 65535 "0x0~0xFFFF:CRCValue" ;
VAL_ 53 VCU_ScuKeepWakeReq 0 "None" 1 "Keep Wake Request" 2 "Not used" 3 "Error Indicator" ;
VAL_ 53 VCU_FmcuZeroTqOfsReq 0 "No Request" 1 "Request" 2 "Not used" 3 "Error Indicator" ;
VAL_ 53 VCU_EcmSeqSta 0 "IG Off" 1 "IG On_PowerLatch" 2 "IG On Init" 3 "IG On_Rdy" 4 "IG On_Drivalble" 5 "IG On_PD" 6 "IGON_NonDrivable" ;
VAL_ 53 VCU_AlvCnt1Val 0 "0x0~0xFF:AlvCntValue" 255 "0x0~0xFF:AlvCntValue" ;
VAL_ 53 VCU_MainBattTypeSta 0 "Short Range Type" 1 "Standard Range Type" 2 "Long Range Type" 3 "Not Used" ;
VAL_ 53 VCU_MainBattTypeLrnSta 0 "Unlearnt" 1 "Learnt" 2 "Not used" 3 "Error Indicator" ;
VAL_ 53 VCU_WarmupCycSta 0 "None" 1 "Warm-up Cycle Completed" 2 "Not used" 3 "Error Indicator" ;
VAL_ 53 VCU_GearPosStaDisp 0 "P" 1 "Not Used" 2 "Not Used" 3 "Not Used" 4 "Not Used" 5 "D" 6 "N" 7 "R" 8 "Not Used" 9 "Not Display at Cluster" 10 "RESERVED" 11 "RESERVED" 12 "Manual Shift Mode on Retromode" 13 "RESERVED" 14 "RESERVED" 15 "Fault" ;
VAL_ 53 VCU_PdlStopCtrlSta 0 "No Request" 1 "Target brake torque control request" 2 "AVH request" 3 "AVH working" ;
VAL_ 53 VCU_PdlStopReqTqNmVal 0 "0x0~0xFFFF:Request brake torque for stop assist control" 65535 "0x0~0xFFFF:Request brake torque for stop assist control" ;
VAL_ 53 VCU_PMPDActSta 0 "Off" 1 "PMPD ON - Torque Limitation" 2 "PMPD ON - Brake Act" 3 "PMPD Inactive" ;
VAL_ 53 VCU_PMPDWarnSta 0 "default" 1 "reactivate" 2 "temporary off" 3 "off by system fault" ;
VAL_ 53 VCU_VgsVirSoundBackFireIndex 0 "No Action Status" 1 "Tip-Out Back Fire Lv1 ~ Lv8" 2 "Tip-Out Back Fire Lv1 ~ Lv8" 3 "Tip-Out Back Fire Lv1 ~ Lv8" 4 "Tip-Out Back Fire Lv1 ~ Lv8" 5 "Tip-Out Back Fire Lv1 ~ Lv8" 6 "Tip-Out Back Fire Lv1 ~ Lv8" 7 "Tip-Out Back Fire Lv1 ~ Lv8" 8 "Tip-Out Back Fire Lv1 ~ Lv8" 17 "Bubbling Sound Lv1 ~ Lv8" 18 "Bubbling Sound Lv1 ~ Lv8" 19 "Bubbling Sound Lv1 ~ Lv8" 20 "Bubbling Sound Lv1 ~ Lv8" 21 "Bubbling Sound Lv1 ~ Lv8" 22 "Bubbling Sound Lv1 ~ Lv8" 23 "Bubbling Sound Lv1 ~ Lv8" 24 "Bubbling Sound Lv1 ~ Lv8" 9 "Upshift BANG Sound Lv1 ~ Lv8" 10 "Upshift BANG Sound Lv1 ~ Lv8" 11 "Upshift BANG Sound Lv1 ~ Lv8" 12 "Upshift BANG Sound Lv1 ~ Lv8" 13 "Upshift BANG Sound Lv1 ~ Lv8" 14 "Upshift BANG Sound Lv1 ~ Lv8" 15 "Upshift BANG Sound Lv1 ~ Lv8" 16 "Upshift BANG Sound Lv1 ~ Lv8" ;
VAL_ 53 VCU_VgsVirEngSpdRpmVal 0 "0x0~0x7FFE:RPM" 32766 "0x0~0x7FFE:RPM" 32767 "Error Indicator" ;
VAL_ 53 VCU_RdySta 0 "None" 1 "VCU Control Board Ready" 2 "Not used" 3 "Error Indicator" ;
VAL_ 53 VCU_VgsVirSoundVolume 0 "0x0~0xFE:0~100%" 254 "0x0~0xFE:0~100%" 0 "0~0xFF:Invalid Error" 255 "0~0xFF:Invalid Error" ;
VAL_ 53 VCU_VgsVirGearStep 0 "Not Used" 1 "1gear" 2 "2gear" 3 "3gear" 4 "4gear" 5 "5gear" 6 "6gear" 7 "7gear" 8 "8gear" 9 "Reserved" 10 "Reserved" 11 "Reserved" 12 "Reserved" 13 "Reserved" 14 "Reserved" 15 "Reserved" ;
VAL_ 53 VCU_StandbyModSta 0 "Standby Mode Off" 1 "Standby Mode without HV Request" 2 "Standby Mode with HV Request" 3 "RESERVED" ;
VAL_ 53 VCU_HVIntLkDischrgReq 0 "Not Request(Default)" 1 "Request" 2 "RESERVED" 3 "Error Indicator" ;
VAL_ 53 VCU_StartKeyHoldSta 0 "None" 1 "Start" 2 "Not used" 3 "Error Indicator" ;
VAL_ 53 VCU_EvDrvRdySta 0 "None" 1 "EV Drivable" 2 "Not used" 3 "Error Indicator" ;
VAL_ 53 VCU_MotPwrEnReq 0 "None" 1 "Allow Motor System to Control" 2 "Not used" 3 "Error Indicator" ;
VAL_ 53 VCU_GearPosSta 0 "P" 1 "Not Used" 2 "Not Used" 3 "Not Used" 4 "Not Used" 5 "D" 6 "N" 7 "R" 8 "Not Used" 9 "Not Display at Cluster" 10 "RESERVED" 11 "RESERVED" 12 "RESERVED" 13 "RESERVED" 14 "RESERVED" 15 "Fault" ;
VAL_ 53 VCU_LdcInhReq 0 "None" 1 "LDC Off Request" 2 "Not used" 3 "Error Indicator" ;
VAL_ 53 VCU_MainRlyOffReq 0 "None" 1 "Relay Cut Off" 2 "Not used" 3 "Error Indicator" ;
VAL_ 53 VCU_AccPedDepVal 255 "Error Indicator" ;
VAL_ 53 VCU_FatcOperPermSta 0 "Not Permiited" 1 "Permitted" 2 "Not used" 3 "Error Indicator" ;
VAL_ 53 VCU_DrvCycSta 0 "No Driving Cycle Active" 1 "Driving Cycle Active" 2 "Not used" 3 "Error Indicator" ;
VAL_ 53 VCU_CltActOpSta 0 "Neutral" 1 "Actuating" 2 "In Gear" 3 "Referencing" 4 "Fault" ;
VAL_ 53 VCU_WhlSpdSnsrAlvReq 0 "No Request" 1 "Alive Request" 2 "Not used" 3 "Error Indicator" ;
VAL_ 53 VCU_DrvModOpSta 0 "Eco" 1 "Normal" 2 "Sport" 3 "Sport+" 4 "RESERVED" 5 "Snow" 6 "Sand" 7 "Mud" 8 "Chauffeur" 9 "Easy" 10 "RESERVED" 11 "RESERVED" 12 "RESERVED" 13 "RESERVED" 14 "RESERVED" 15 "RESERVED" ;
VAL_ 53 VCU_HydBrkFcHoldRq 0 "None" 1 "Hold Request" 2 "Reserved" 3 "Error" ;
VAL_ 53 VCU_McuAntiJerkInhFrntSta 0 "Anti-jerk Not Inhibit" 1 "Anti-jerk Inhibit" 2 "Not used" 3 "Error Indicator" ;
VAL_ 53 VCU_McuAntiJerkInhRearSta 0 "Anti-jerk Not Inhibit" 1 "Anti-jerk Inhibit" 2 "Not used" 3 "Error Indicator" ;
VAL_ 53 VCU_McuPwrLatchHoldReq 0 "No Request" 1 "Power Latch Hold Request" 2 "Not used" 3 "Error Indicator" ;
VAL_ 53 VCU_ScuParkReq 0 "Wait Command" 1 "Not used" 2 "Parking Command" 3 "Not Parking Command" ;
VAL_ 1278 BLTN_CAM_FD_DCM_Crc0Val 0 "0x0~0xFFFF:CRCValue" 65535 "0x0~0xFFFF:CRCValue" ;
VAL_ 1278 DCM_VideoOut_Interface_Ver_Major 0 "0x0~0xFD:DCM video output interface major version ASCII Code Value (HEX)" 253 "0x0~0xFD:DCM video output interface major version ASCII Code Value (HEX)" 254 "Default(The information is not checked yet.)" 255 "Invalid" ;
VAL_ 1278 DCM_VideoOut_Interface_Ver_Minor 0 "0x0~0xFD:DCM video output interface minor version ASCII Code Value (HEX)" 253 "0x0~0xFD:DCM video output interface minor version ASCII Code Value (HEX)" 254 "Default(The information is not checked yet.)" 255 "Invalid" ;
VAL_ 1278 BLTN_CAM_FD_DCM_AlvCnt0Val 0 "0x0~0xFF:AlvCntValue" 255 "0x0~0xFF:AlvCntValue" ;
VAL_ 1278 BLTN_CAM_HW_Platform_Ver_Major 14 "Default(the information is not checked yet.)" 0 "Major version, 0~13 dec" 1 "Major version, 0~13 dec" 2 "Major version, 0~13 dec" 3 "Major version, 0~13 dec" 4 "Major version, 0~13 dec" 5 "Major version, 0~13 dec" 6 "Major version, 0~13 dec" 7 "Major version, 0~13 dec" 8 "Major version, 0~13 dec" 9 "Major version, 0~13 dec" 10 "Major version, 0~13 dec" 11 "Major version, 0~13 dec" 12 "Major version, 0~13 dec" 13 "Major version, 0~13 dec" 15 "Invalid" ;
VAL_ 1278 BLTN_CAM_HW_Platform_Ver_Minor 14 "Default(the information is not checked yet.)" 0 "Minor version, 0~13 dec" 1 "Minor version, 0~13 dec" 2 "Minor version, 0~13 dec" 3 "Minor version, 0~13 dec" 4 "Minor version, 0~13 dec" 5 "Minor version, 0~13 dec" 6 "Minor version, 0~13 dec" 7 "Minor version, 0~13 dec" 8 "Minor version, 0~13 dec" 9 "Minor version, 0~13 dec" 10 "Minor version, 0~13 dec" 11 "Minor version, 0~13 dec" 12 "Minor version, 0~13 dec" 13 "Minor version, 0~13 dec" 15 "Invalid" ;
VAL_ 1278 RearCamera_HW_Ver_Major 0 "0x0~0x7D:Major version, ASCII Code Value (HEX)" 125 "0x0~0x7D:Major version, ASCII Code Value (HEX)" 126 "Default(the information is not checked yet.)" 127 "Invalid" ;
VAL_ 1278 RearCamera_HW_Ver_Minor 126 "Default(the information is not checked yet.)" 0 "Minor version, 0~99 dec" 1 "Minor version, 0~99 dec" 2 "Minor version, 0~99 dec" 3 "Minor version, 0~99 dec" 4 "Minor version, 0~99 dec" 5 "Minor version, 0~99 dec" 6 "Minor version, 0~99 dec" 7 "Minor version, 0~99 dec" 8 "Minor version, 0~99 dec" 9 "Minor version, 0~99 dec" 10 "Minor version, 0~99 dec" 11 "Minor version, 0~99 dec" 12 "Minor version, 0~99 dec" 13 "Minor version, 0~99 dec" 14 "Minor version, 0~99 dec" 15 "Minor version, 0~99 dec" 16 "Minor version, 0~99 dec" 17 "Minor version, 0~99 dec" 18 "Minor version, 0~99 dec" 19 "Minor version, 0~99 dec" 20 "Minor version, 0~99 dec" 21 "Minor version, 0~99 dec" 22 "Minor version, 0~99 dec" 23 "Minor version, 0~99 dec" 24 "Minor version, 0~99 dec" 25 "Minor version, 0~99 dec" 26 "Minor version, 0~99 dec" 27 "Minor version, 0~99 dec" 28 "Minor version, 0~99 dec" 29 "Minor version, 0~99 dec" 30 "Minor version, 0~99 dec" 31 "Minor version, 0~99 dec" 32 "Minor version, 0~99 dec" 33 "Minor version, 0~99 dec" 34 "Minor version, 0~99 dec" 35 "Minor version, 0~99 dec" 36 "Minor version, 0~99 dec" 37 "Minor version, 0~99 dec" 38 "Minor version, 0~99 dec" 39 "Minor version, 0~99 dec" 40 "Minor version, 0~99 dec" 41 "Minor version, 0~99 dec" 42 "Minor version, 0~99 dec" 43 "Minor version, 0~99 dec" 44 "Minor version, 0~99 dec" 45 "Minor version, 0~99 dec" 46 "Minor version, 0~99 dec" 47 "Minor version, 0~99 dec" 48 "Minor version, 0~99 dec" 49 "Minor version, 0~99 dec" 50 "Minor version, 0~99 dec" 51 "Minor version, 0~99 dec" 52 "Minor version, 0~99 dec" 53 "Minor version, 0~99 dec" 54 "Minor version, 0~99 dec" 55 "Minor version, 0~99 dec" 56 "Minor version, 0~99 dec" 57 "Minor version, 0~99 dec" 58 "Minor version, 0~99 dec" 59 "Minor version, 0~99 dec" 60 "Minor version, 0~99 dec" 61 "Minor version, 0~99 dec" 62 "Minor version, 0~99 dec" 63 "Minor version, 0~99 dec" 64 "Minor version, 0~99 dec" 65 "Minor version, 0~99 dec" 66 "Minor version, 0~99 dec" 67 "Minor version, 0~99 dec" 68 "Minor version, 0~99 dec" 69 "Minor version, 0~99 dec" 70 "Minor version, 0~99 dec" 71 "Minor version, 0~99 dec" 72 "Minor version, 0~99 dec" 73 "Minor version, 0~99 dec" 74 "Minor version, 0~99 dec" 75 "Minor version, 0~99 dec" 76 "Minor version, 0~99 dec" 77 "Minor version, 0~99 dec" 78 "Minor version, 0~99 dec" 79 "Minor version, 0~99 dec" 80 "Minor version, 0~99 dec" 81 "Minor version, 0~99 dec" 82 "Minor version, 0~99 dec" 83 "Minor version, 0~99 dec" 84 "Minor version, 0~99 dec" 85 "Minor version, 0~99 dec" 86 "Minor version, 0~99 dec" 87 "Minor version, 0~99 dec" 88 "Minor version, 0~99 dec" 89 "Minor version, 0~99 dec" 90 "Minor version, 0~99 dec" 91 "Minor version, 0~99 dec" 92 "Minor version, 0~99 dec" 93 "Minor version, 0~99 dec" 94 "Minor version, 0~99 dec" 95 "Minor version, 0~99 dec" 96 "Minor version, 0~99 dec" 97 "Minor version, 0~99 dec" 98 "Minor version, 0~99 dec" 99 "Minor version, 0~99 dec" 100 "RESERVED" 101 "RESERVED" 102 "RESERVED" 103 "RESERVED" 104 "RESERVED" 105 "RESERVED" 106 "RESERVED" 107 "RESERVED" 108 "RESERVED" 109 "RESERVED" 110 "RESERVED" 111 "RESERVED" 112 "RESERVED" 113 "RESERVED" 114 "RESERVED" 115 "RESERVED" 116 "RESERVED" 117 "RESERVED" 118 "RESERVED" 119 "RESERVED" 120 "RESERVED" 121 "RESERVED" 122 "RESERVED" 123 "RESERVED" 124 "RESERVED" 125 "RESERVED" 127 "Invalid" ;
VAL_ 1278 RearCamera_SW_Ver_Major 14 "Default(the information is not checked yet.)" 15 "Invalid" 0 "0~0x7D:Major version, ASCII Code Value (HEX)" 125 "0~0x7D:Major version, ASCII Code Value (HEX)" ;
VAL_ 1278 RearCamera_SW_Ver_Minor 126 "Default(the information is not checked yet.)" 0 "Minor version, 0~99 dec" 1 "Minor version, 0~99 dec" 2 "Minor version, 0~99 dec" 3 "Minor version, 0~99 dec" 4 "Minor version, 0~99 dec" 5 "Minor version, 0~99 dec" 6 "Minor version, 0~99 dec" 7 "Minor version, 0~99 dec" 8 "Minor version, 0~99 dec" 9 "Minor version, 0~99 dec" 10 "Minor version, 0~99 dec" 11 "Minor version, 0~99 dec" 12 "Minor version, 0~99 dec" 13 "Minor version, 0~99 dec" 14 "Minor version, 0~99 dec" 15 "Minor version, 0~99 dec" 16 "Minor version, 0~99 dec" 17 "Minor version, 0~99 dec" 18 "Minor version, 0~99 dec" 19 "Minor version, 0~99 dec" 20 "Minor version, 0~99 dec" 21 "Minor version, 0~99 dec" 22 "Minor version, 0~99 dec" 23 "Minor version, 0~99 dec" 24 "Minor version, 0~99 dec" 25 "Minor version, 0~99 dec" 26 "Minor version, 0~99 dec" 27 "Minor version, 0~99 dec" 28 "Minor version, 0~99 dec" 29 "Minor version, 0~99 dec" 30 "Minor version, 0~99 dec" 31 "Minor version, 0~99 dec" 32 "Minor version, 0~99 dec" 33 "Minor version, 0~99 dec" 34 "Minor version, 0~99 dec" 35 "Minor version, 0~99 dec" 36 "Minor version, 0~99 dec" 37 "Minor version, 0~99 dec" 38 "Minor version, 0~99 dec" 39 "Minor version, 0~99 dec" 40 "Minor version, 0~99 dec" 41 "Minor version, 0~99 dec" 42 "Minor version, 0~99 dec" 43 "Minor version, 0~99 dec" 44 "Minor version, 0~99 dec" 45 "Minor version, 0~99 dec" 46 "Minor version, 0~99 dec" 47 "Minor version, 0~99 dec" 48 "Minor version, 0~99 dec" 49 "Minor version, 0~99 dec" 50 "Minor version, 0~99 dec" 51 "Minor version, 0~99 dec" 52 "Minor version, 0~99 dec" 53 "Minor version, 0~99 dec" 54 "Minor version, 0~99 dec" 55 "Minor version, 0~99 dec" 56 "Minor version, 0~99 dec" 57 "Minor version, 0~99 dec" 58 "Minor version, 0~99 dec" 59 "Minor version, 0~99 dec" 60 "Minor version, 0~99 dec" 61 "Minor version, 0~99 dec" 62 "Minor version, 0~99 dec" 63 "Minor version, 0~99 dec" 64 "Minor version, 0~99 dec" 65 "Minor version, 0~99 dec" 66 "Minor version, 0~99 dec" 67 "Minor version, 0~99 dec" 68 "Minor version, 0~99 dec" 69 "Minor version, 0~99 dec" 70 "Minor version, 0~99 dec" 71 "Minor version, 0~99 dec" 72 "Minor version, 0~99 dec" 73 "Minor version, 0~99 dec" 74 "Minor version, 0~99 dec" 75 "Minor version, 0~99 dec" 76 "Minor version, 0~99 dec" 77 "Minor version, 0~99 dec" 78 "Minor version, 0~99 dec" 79 "Minor version, 0~99 dec" 80 "Minor version, 0~99 dec" 81 "Minor version, 0~99 dec" 82 "Minor version, 0~99 dec" 83 "Minor version, 0~99 dec" 84 "Minor version, 0~99 dec" 85 "Minor version, 0~99 dec" 86 "Minor version, 0~99 dec" 87 "Minor version, 0~99 dec" 88 "Minor version, 0~99 dec" 89 "Minor version, 0~99 dec" 90 "Minor version, 0~99 dec" 91 "Minor version, 0~99 dec" 92 "Minor version, 0~99 dec" 93 "Minor version, 0~99 dec" 94 "Minor version, 0~99 dec" 95 "Minor version, 0~99 dec" 96 "Minor version, 0~99 dec" 97 "Minor version, 0~99 dec" 98 "Minor version, 0~99 dec" 99 "Minor version, 0~99 dec" 100 "RESERVED" 101 "RESERVED" 102 "RESERVED" 103 "RESERVED" 104 "RESERVED" 105 "RESERVED" 106 "RESERVED" 107 "RESERVED" 108 "RESERVED" 109 "RESERVED" 110 "RESERVED" 111 "RESERVED" 112 "RESERVED" 113 "RESERVED" 114 "RESERVED" 115 "RESERVED" 116 "RESERVED" 117 "RESERVED" 118 "RESERVED" 119 "RESERVED" 120 "RESERVED" 121 "RESERVED" 122 "RESERVED" 123 "RESERVED" 124 "RESERVED" 125 "RESERVED" 127 "Invalid" ;
VAL_ 1278 RearCamera_ISP_Ver0 0 "Version0, 0~99 dec" 1 "Version0, 0~99 dec" 2 "Version0, 0~99 dec" 3 "Version0, 0~99 dec" 4 "Version0, 0~99 dec" 5 "Version0, 0~99 dec" 6 "Version0, 0~99 dec" 7 "Version0, 0~99 dec" 8 "Version0, 0~99 dec" 9 "Version0, 0~99 dec" 10 "Version0, 0~99 dec" 11 "Version0, 0~99 dec" 12 "Version0, 0~99 dec" 13 "Version0, 0~99 dec" 14 "Version0, 0~99 dec" 15 "Version0, 0~99 dec" 16 "Version0, 0~99 dec" 17 "Version0, 0~99 dec" 18 "Version0, 0~99 dec" 19 "Version0, 0~99 dec" 20 "Version0, 0~99 dec" 21 "Version0, 0~99 dec" 22 "Version0, 0~99 dec" 23 "Version0, 0~99 dec" 24 "Version0, 0~99 dec" 25 "Version0, 0~99 dec" 26 "Version0, 0~99 dec" 27 "Version0, 0~99 dec" 28 "Version0, 0~99 dec" 29 "Version0, 0~99 dec" 30 "Version0, 0~99 dec" 31 "Version0, 0~99 dec" 32 "Version0, 0~99 dec" 33 "Version0, 0~99 dec" 34 "Version0, 0~99 dec" 35 "Version0, 0~99 dec" 36 "Version0, 0~99 dec" 37 "Version0, 0~99 dec" 38 "Version0, 0~99 dec" 39 "Version0, 0~99 dec" 40 "Version0, 0~99 dec" 41 "Version0, 0~99 dec" 42 "Version0, 0~99 dec" 43 "Version0, 0~99 dec" 44 "Version0, 0~99 dec" 45 "Version0, 0~99 dec" 46 "Version0, 0~99 dec" 47 "Version0, 0~99 dec" 48 "Version0, 0~99 dec" 49 "Version0, 0~99 dec" 50 "Version0, 0~99 dec" 51 "Version0, 0~99 dec" 52 "Version0, 0~99 dec" 53 "Version0, 0~99 dec" 54 "Version0, 0~99 dec" 55 "Version0, 0~99 dec" 56 "Version0, 0~99 dec" 57 "Version0, 0~99 dec" 58 "Version0, 0~99 dec" 59 "Version0, 0~99 dec" 60 "Version0, 0~99 dec" 61 "Version0, 0~99 dec" 62 "Version0, 0~99 dec" 63 "Version0, 0~99 dec" 64 "Version0, 0~99 dec" 65 "Version0, 0~99 dec" 66 "Version0, 0~99 dec" 67 "Version0, 0~99 dec" 68 "Version0, 0~99 dec" 69 "Version0, 0~99 dec" 70 "Version0, 0~99 dec" 71 "Version0, 0~99 dec" 72 "Version0, 0~99 dec" 73 "Version0, 0~99 dec" 74 "Version0, 0~99 dec" 75 "Version0, 0~99 dec" 76 "Version0, 0~99 dec" 77 "Version0, 0~99 dec" 78 "Version0, 0~99 dec" 79 "Version0, 0~99 dec" 80 "Version0, 0~99 dec" 81 "Version0, 0~99 dec" 82 "Version0, 0~99 dec" 83 "Version0, 0~99 dec" 84 "Version0, 0~99 dec" 85 "Version0, 0~99 dec" 86 "Version0, 0~99 dec" 87 "Version0, 0~99 dec" 88 "Version0, 0~99 dec" 89 "Version0, 0~99 dec" 90 "Version0, 0~99 dec" 91 "Version0, 0~99 dec" 92 "Version0, 0~99 dec" 93 "Version0, 0~99 dec" 94 "Version0, 0~99 dec" 95 "Version0, 0~99 dec" 96 "Version0, 0~99 dec" 97 "Version0, 0~99 dec" 98 "Version0, 0~99 dec" 99 "Version0, 0~99 dec" 100 "RESERVED" 101 "RESERVED" 102 "RESERVED" 103 "RESERVED" 104 "RESERVED" 105 "RESERVED" 106 "RESERVED" 107 "RESERVED" 108 "RESERVED" 109 "RESERVED" 110 "RESERVED" 111 "RESERVED" 112 "RESERVED" 113 "RESERVED" 114 "RESERVED" 115 "RESERVED" 116 "RESERVED" 117 "RESERVED" 118 "RESERVED" 119 "RESERVED" 120 "RESERVED" 121 "RESERVED" 122 "RESERVED" 123 "RESERVED" 124 "RESERVED" 125 "RESERVED" 126 "RESERVED" 127 "Invalid" ;
VAL_ 1278 RearCamera_ISP_Ver1 0 "Version1, 0~99 dec" 1 "Version1, 0~99 dec" 2 "Version1, 0~99 dec" 3 "Version1, 0~99 dec" 4 "Version1, 0~99 dec" 5 "Version1, 0~99 dec" 6 "Version1, 0~99 dec" 7 "Version1, 0~99 dec" 8 "Version1, 0~99 dec" 9 "Version1, 0~99 dec" 10 "Version1, 0~99 dec" 11 "Version1, 0~99 dec" 12 "Version1, 0~99 dec" 13 "Version1, 0~99 dec" 14 "Version1, 0~99 dec" 15 "Version1, 0~99 dec" 16 "Version1, 0~99 dec" 17 "Version1, 0~99 dec" 18 "Version1, 0~99 dec" 19 "Version1, 0~99 dec" 20 "Version1, 0~99 dec" 21 "Version1, 0~99 dec" 22 "Version1, 0~99 dec" 23 "Version1, 0~99 dec" 24 "Version1, 0~99 dec" 25 "Version1, 0~99 dec" 26 "Version1, 0~99 dec" 27 "Version1, 0~99 dec" 28 "Version1, 0~99 dec" 29 "Version1, 0~99 dec" 30 "Version1, 0~99 dec" 31 "Version1, 0~99 dec" 32 "Version1, 0~99 dec" 33 "Version1, 0~99 dec" 34 "Version1, 0~99 dec" 35 "Version1, 0~99 dec" 36 "Version1, 0~99 dec" 37 "Version1, 0~99 dec" 38 "Version1, 0~99 dec" 39 "Version1, 0~99 dec" 40 "Version1, 0~99 dec" 41 "Version1, 0~99 dec" 42 "Version1, 0~99 dec" 43 "Version1, 0~99 dec" 44 "Version1, 0~99 dec" 45 "Version1, 0~99 dec" 46 "Version1, 0~99 dec" 47 "Version1, 0~99 dec" 48 "Version1, 0~99 dec" 49 "Version1, 0~99 dec" 50 "Version1, 0~99 dec" 51 "Version1, 0~99 dec" 52 "Version1, 0~99 dec" 53 "Version1, 0~99 dec" 54 "Version1, 0~99 dec" 55 "Version1, 0~99 dec" 56 "Version1, 0~99 dec" 57 "Version1, 0~99 dec" 58 "Version1, 0~99 dec" 59 "Version1, 0~99 dec" 60 "Version1, 0~99 dec" 61 "Version1, 0~99 dec" 62 "Version1, 0~99 dec" 63 "Version1, 0~99 dec" 64 "Version1, 0~99 dec" 65 "Version1, 0~99 dec" 66 "Version1, 0~99 dec" 67 "Version1, 0~99 dec" 68 "Version1, 0~99 dec" 69 "Version1, 0~99 dec" 70 "Version1, 0~99 dec" 71 "Version1, 0~99 dec" 72 "Version1, 0~99 dec" 73 "Version1, 0~99 dec" 74 "Version1, 0~99 dec" 75 "Version1, 0~99 dec" 76 "Version1, 0~99 dec" 77 "Version1, 0~99 dec" 78 "Version1, 0~99 dec" 79 "Version1, 0~99 dec" 80 "Version1, 0~99 dec" 81 "Version1, 0~99 dec" 82 "Version1, 0~99 dec" 83 "Version1, 0~99 dec" 84 "Version1, 0~99 dec" 85 "Version1, 0~99 dec" 86 "Version1, 0~99 dec" 87 "Version1, 0~99 dec" 88 "Version1, 0~99 dec" 89 "Version1, 0~99 dec" 90 "Version1, 0~99 dec" 91 "Version1, 0~99 dec" 92 "Version1, 0~99 dec" 93 "Version1, 0~99 dec" 94 "Version1, 0~99 dec" 95 "Version1, 0~99 dec" 96 "Version1, 0~99 dec" 97 "Version1, 0~99 dec" 98 "Version1, 0~99 dec" 99 "Version1, 0~99 dec" 100 "RESERVED" 101 "RESERVED" 102 "RESERVED" 103 "RESERVED" 104 "RESERVED" 105 "RESERVED" 106 "RESERVED" 107 "RESERVED" 108 "RESERVED" 109 "RESERVED" 110 "RESERVED" 111 "RESERVED" 112 "RESERVED" 113 "RESERVED" 114 "RESERVED" 115 "RESERVED" 116 "RESERVED" 117 "RESERVED" 118 "RESERVED" 119 "RESERVED" 120 "RESERVED" 121 "RESERVED" 122 "RESERVED" 123 "RESERVED" 124 "RESERVED" 125 "RESERVED" 126 "RESERVED" 127 "Invalid" ;
VAL_ 1278 RearCamera_ISP_Ver2 0 "Version2, 0~99 dec" 1 "Version2, 0~99 dec" 2 "Version2, 0~99 dec" 3 "Version2, 0~99 dec" 4 "Version2, 0~99 dec" 5 "Version2, 0~99 dec" 6 "Version2, 0~99 dec" 7 "Version2, 0~99 dec" 8 "Version2, 0~99 dec" 9 "Version2, 0~99 dec" 10 "Version2, 0~99 dec" 11 "Version2, 0~99 dec" 12 "Version2, 0~99 dec" 13 "Version2, 0~99 dec" 14 "Version2, 0~99 dec" 15 "Version2, 0~99 dec" 16 "Version2, 0~99 dec" 17 "Version2, 0~99 dec" 18 "Version2, 0~99 dec" 19 "Version2, 0~99 dec" 20 "Version2, 0~99 dec" 21 "Version2, 0~99 dec" 22 "Version2, 0~99 dec" 23 "Version2, 0~99 dec" 24 "Version2, 0~99 dec" 25 "Version2, 0~99 dec" 26 "Version2, 0~99 dec" 27 "Version2, 0~99 dec" 28 "Version2, 0~99 dec" 29 "Version2, 0~99 dec" 30 "Version2, 0~99 dec" 31 "Version2, 0~99 dec" 32 "Version2, 0~99 dec" 33 "Version2, 0~99 dec" 34 "Version2, 0~99 dec" 35 "Version2, 0~99 dec" 36 "Version2, 0~99 dec" 37 "Version2, 0~99 dec" 38 "Version2, 0~99 dec" 39 "Version2, 0~99 dec" 40 "Version2, 0~99 dec" 41 "Version2, 0~99 dec" 42 "Version2, 0~99 dec" 43 "Version2, 0~99 dec" 44 "Version2, 0~99 dec" 45 "Version2, 0~99 dec" 46 "Version2, 0~99 dec" 47 "Version2, 0~99 dec" 48 "Version2, 0~99 dec" 49 "Version2, 0~99 dec" 50 "Version2, 0~99 dec" 51 "Version2, 0~99 dec" 52 "Version2, 0~99 dec" 53 "Version2, 0~99 dec" 54 "Version2, 0~99 dec" 55 "Version2, 0~99 dec" 56 "Version2, 0~99 dec" 57 "Version2, 0~99 dec" 58 "Version2, 0~99 dec" 59 "Version2, 0~99 dec" 60 "Version2, 0~99 dec" 61 "Version2, 0~99 dec" 62 "Version2, 0~99 dec" 63 "Version2, 0~99 dec" 64 "Version2, 0~99 dec" 65 "Version2, 0~99 dec" 66 "Version2, 0~99 dec" 67 "Version2, 0~99 dec" 68 "Version2, 0~99 dec" 69 "Version2, 0~99 dec" 70 "Version2, 0~99 dec" 71 "Version2, 0~99 dec" 72 "Version2, 0~99 dec" 73 "Version2, 0~99 dec" 74 "Version2, 0~99 dec" 75 "Version2, 0~99 dec" 76 "Version2, 0~99 dec" 77 "Version2, 0~99 dec" 78 "Version2, 0~99 dec" 79 "Version2, 0~99 dec" 80 "Version2, 0~99 dec" 81 "Version2, 0~99 dec" 82 "Version2, 0~99 dec" 83 "Version2, 0~99 dec" 84 "Version2, 0~99 dec" 85 "Version2, 0~99 dec" 86 "Version2, 0~99 dec" 87 "Version2, 0~99 dec" 88 "Version2, 0~99 dec" 89 "Version2, 0~99 dec" 90 "Version2, 0~99 dec" 91 "Version2, 0~99 dec" 92 "Version2, 0~99 dec" 93 "Version2, 0~99 dec" 94 "Version2, 0~99 dec" 95 "Version2, 0~99 dec" 96 "Version2, 0~99 dec" 97 "Version2, 0~99 dec" 98 "Version2, 0~99 dec" 99 "Version2, 0~99 dec" 100 "RESERVED" 101 "RESERVED" 102 "RESERVED" 103 "RESERVED" 104 "RESERVED" 105 "RESERVED" 106 "RESERVED" 107 "RESERVED" 108 "RESERVED" 109 "RESERVED" 110 "RESERVED" 111 "RESERVED" 112 "RESERVED" 113 "RESERVED" 114 "RESERVED" 115 "RESERVED" 116 "RESERVED" 117 "RESERVED" 118 "RESERVED" 119 "RESERVED" 120 "RESERVED" 121 "RESERVED" 122 "RESERVED" 123 "RESERVED" 124 "RESERVED" 125 "RESERVED" 126 "RESERVED" 127 "Invalid" ;
VAL_ 1278 RearCamera_ISP_Ver3 0 "Version3, 0~99 dec" 1 "Version3, 0~99 dec" 2 "Version3, 0~99 dec" 3 "Version3, 0~99 dec" 4 "Version3, 0~99 dec" 5 "Version3, 0~99 dec" 6 "Version3, 0~99 dec" 7 "Version3, 0~99 dec" 8 "Version3, 0~99 dec" 9 "Version3, 0~99 dec" 10 "Version3, 0~99 dec" 11 "Version3, 0~99 dec" 12 "Version3, 0~99 dec" 13 "Version3, 0~99 dec" 14 "Version3, 0~99 dec" 15 "Version3, 0~99 dec" 16 "Version3, 0~99 dec" 17 "Version3, 0~99 dec" 18 "Version3, 0~99 dec" 19 "Version3, 0~99 dec" 20 "Version3, 0~99 dec" 21 "Version3, 0~99 dec" 22 "Version3, 0~99 dec" 23 "Version3, 0~99 dec" 24 "Version3, 0~99 dec" 25 "Version3, 0~99 dec" 26 "Version3, 0~99 dec" 27 "Version3, 0~99 dec" 28 "Version3, 0~99 dec" 29 "Version3, 0~99 dec" 30 "Version3, 0~99 dec" 31 "Version3, 0~99 dec" 32 "Version3, 0~99 dec" 33 "Version3, 0~99 dec" 34 "Version3, 0~99 dec" 35 "Version3, 0~99 dec" 36 "Version3, 0~99 dec" 37 "Version3, 0~99 dec" 38 "Version3, 0~99 dec" 39 "Version3, 0~99 dec" 40 "Version3, 0~99 dec" 41 "Version3, 0~99 dec" 42 "Version3, 0~99 dec" 43 "Version3, 0~99 dec" 44 "Version3, 0~99 dec" 45 "Version3, 0~99 dec" 46 "Version3, 0~99 dec" 47 "Version3, 0~99 dec" 48 "Version3, 0~99 dec" 49 "Version3, 0~99 dec" 50 "Version3, 0~99 dec" 51 "Version3, 0~99 dec" 52 "Version3, 0~99 dec" 53 "Version3, 0~99 dec" 54 "Version3, 0~99 dec" 55 "Version3, 0~99 dec" 56 "Version3, 0~99 dec" 57 "Version3, 0~99 dec" 58 "Version3, 0~99 dec" 59 "Version3, 0~99 dec" 60 "Version3, 0~99 dec" 61 "Version3, 0~99 dec" 62 "Version3, 0~99 dec" 63 "Version3, 0~99 dec" 64 "Version3, 0~99 dec" 65 "Version3, 0~99 dec" 66 "Version3, 0~99 dec" 67 "Version3, 0~99 dec" 68 "Version3, 0~99 dec" 69 "Version3, 0~99 dec" 70 "Version3, 0~99 dec" 71 "Version3, 0~99 dec" 72 "Version3, 0~99 dec" 73 "Version3, 0~99 dec" 74 "Version3, 0~99 dec" 75 "Version3, 0~99 dec" 76 "Version3, 0~99 dec" 77 "Version3, 0~99 dec" 78 "Version3, 0~99 dec" 79 "Version3, 0~99 dec" 80 "Version3, 0~99 dec" 81 "Version3, 0~99 dec" 82 "Version3, 0~99 dec" 83 "Version3, 0~99 dec" 84 "Version3, 0~99 dec" 85 "Version3, 0~99 dec" 86 "Version3, 0~99 dec" 87 "Version3, 0~99 dec" 88 "Version3, 0~99 dec" 89 "Version3, 0~99 dec" 90 "Version3, 0~99 dec" 91 "Version3, 0~99 dec" 92 "Version3, 0~99 dec" 93 "Version3, 0~99 dec" 94 "Version3, 0~99 dec" 95 "Version3, 0~99 dec" 96 "Version3, 0~99 dec" 97 "Version3, 0~99 dec" 98 "Version3, 0~99 dec" 99 "Version3, 0~99 dec" 100 "RESERVED" 101 "RESERVED" 102 "RESERVED" 103 "RESERVED" 104 "RESERVED" 105 "RESERVED" 106 "RESERVED" 107 "RESERVED" 108 "RESERVED" 109 "RESERVED" 110 "RESERVED" 111 "RESERVED" 112 "RESERVED" 113 "RESERVED" 114 "RESERVED" 115 "RESERVED" 116 "RESERVED" 117 "RESERVED" 118 "RESERVED" 119 "RESERVED" 120 "RESERVED" 121 "RESERVED" 122 "RESERVED" 123 "RESERVED" 124 "RESERVED" 125 "RESERVED" 126 "RESERVED" 127 "Invalid" ;
VAL_ 1278 DCM_Output_Color_Fromat 0 "Default(the information is not checked yet.)" 1 "YUV422" 2 "RGB888" 3 "RESERVED" 4 "RESERVED" 5 "RESERVED" 6 "RESERVED" 7 "Inavlid" ;
VAL_ 1278 DCM_Output_Color_bit_Num 0 "Default(the information is not checked yet.)" 1 "8bit" 2 "16bit" 3 "24bit" 4 "32bit" 5 "RESERVED" 6 "RESERVED" 7 "Invalid" ;
VAL_ 1278 RearCamera_Lenz_Ver 0 "Initial Version" 1 "Improvement - First" 2 "Improvement - Second" 3 "Improvement -Third" 4 "RESERVED" 5 "RESERVED" 6 "Default(The lenz information is not checked yet.)" 7 "Invalid" ;
VAL_ 1279 DCM_HW_Ver_Major 0 "0x0~0x7F:0x0~0x7F" 127 "0x0~0x7F:0x0~0x7F" ;
VAL_ 1279 DCM_HW_Ver_Minor 0 "0~99 dec" 1 "0~99 dec" 2 "0~99 dec" 3 "0~99 dec" 4 "0~99 dec" 5 "0~99 dec" 6 "0~99 dec" 7 "0~99 dec" 8 "0~99 dec" 9 "0~99 dec" 10 "0~99 dec" 11 "0~99 dec" 12 "0~99 dec" 13 "0~99 dec" 14 "0~99 dec" 15 "0~99 dec" 16 "0~99 dec" 17 "0~99 dec" 18 "0~99 dec" 19 "0~99 dec" 20 "0~99 dec" 21 "0~99 dec" 22 "0~99 dec" 23 "0~99 dec" 24 "0~99 dec" 25 "0~99 dec" 26 "0~99 dec" 27 "0~99 dec" 28 "0~99 dec" 29 "0~99 dec" 30 "0~99 dec" 31 "0~99 dec" 32 "0~99 dec" 33 "0~99 dec" 34 "0~99 dec" 35 "0~99 dec" 36 "0~99 dec" 37 "0~99 dec" 38 "0~99 dec" 39 "0~99 dec" 40 "0~99 dec" 41 "0~99 dec" 42 "0~99 dec" 43 "0~99 dec" 44 "0~99 dec" 45 "0~99 dec" 46 "0~99 dec" 47 "0~99 dec" 48 "0~99 dec" 49 "0~99 dec" 50 "0~99 dec" 51 "0~99 dec" 52 "0~99 dec" 53 "0~99 dec" 54 "0~99 dec" 55 "0~99 dec" 56 "0~99 dec" 57 "0~99 dec" 58 "0~99 dec" 59 "0~99 dec" 60 "0~99 dec" 61 "0~99 dec" 62 "0~99 dec" 63 "0~99 dec" 64 "0~99 dec" 65 "0~99 dec" 66 "0~99 dec" 67 "0~99 dec" 68 "0~99 dec" 69 "0~99 dec" 70 "0~99 dec" 71 "0~99 dec" 72 "0~99 dec" 73 "0~99 dec" 74 "0~99 dec" 75 "0~99 dec" 76 "0~99 dec" 77 "0~99 dec" 78 "0~99 dec" 79 "0~99 dec" 80 "0~99 dec" 81 "0~99 dec" 82 "0~99 dec" 83 "0~99 dec" 84 "0~99 dec" 85 "0~99 dec" 86 "0~99 dec" 87 "0~99 dec" 88 "0~99 dec" 89 "0~99 dec" 90 "0~99 dec" 91 "0~99 dec" 92 "0~99 dec" 93 "0~99 dec" 94 "0~99 dec" 95 "0~99 dec" 96 "0~99 dec" 97 "0~99 dec" 98 "0~99 dec" 99 "0~99 dec" 100 "RESERVED" 101 "RESERVED" 102 "RESERVED" 103 "RESERVED" 104 "RESERVED" 105 "RESERVED" 106 "RESERVED" 107 "RESERVED" 108 "RESERVED" 109 "RESERVED" 110 "RESERVED" 111 "RESERVED" 112 "RESERVED" 113 "RESERVED" 114 "RESERVED" 115 "RESERVED" 116 "RESERVED" 117 "RESERVED" 118 "RESERVED" 119 "RESERVED" 120 "RESERVED" 121 "RESERVED" 122 "RESERVED" 123 "RESERVED" 124 "RESERVED" 125 "RESERVED" 126 "RESERVED" 127 "Invalid" ;
VAL_ 1279 DCM_ResetOpSta 0 "Normal" 1 "Reset Complete" 2 "Reset Fail" 3 "RESERVED" ;
VAL_ 1279 DCM_SW_Ver_1st_Digit 0 "0x0~0xFD:Software version 1st Digit, ASCII Code Value (HEX)" 253 "0x0~0xFD:Software version 1st Digit, ASCII Code Value (HEX)" 254 "Default" 255 "Invalid" ;
VAL_ 1279 DCM_SW_Ver_2nd_Digit 0 "0x0~0xFD:Software version 2nd Digit, ASCII Code Value (HEX)" 253 "0x0~0xFD:Software version 2nd Digit, ASCII Code Value (HEX)" 254 "Default" 255 "Invalid" ;
VAL_ 1279 DCM_SW_Ver_3rd_Digit 0 "0x0~0xFD:Software version 3rd Digit, ASCII Code Value (HEX)" 253 "0x0~0xFD:Software version 3rd Digit, ASCII Code Value (HEX)" 254 "Default" 255 "Invalid" ;
VAL_ 1279 DCM_SW_Ver_4th_Digit 0 "0x0~0xFD:Software version 4th Digit, ASCII Code Value (HEX)" 253 "0x0~0xFD:Software version 4th Digit, ASCII Code Value (HEX)" 254 "Default" 255 "Invalid" ;
VAL_ 1276 DCM_Output_Reset_Req 0 "Default" 1 "Reset Camera Power" 2 "Reset Camera SERDES" 3 "Reset Camera ISP" 4 "Reset Built-in Cam SER" 5 "Reset Built-in Cam Software" 6 "RESERVED" 7 "RESERVED" 8 "RESERVED" 9 "RESERVED" 10 "RESERVED" 11 "RESERVED" 12 "RESERVED" 13 "RESERVED" 14 "RESERVED" 15 "Invalid" ;
VAL_ 1276 Resolution_Req_Width 0 "Default" 1 "001~0xFFE:1~4094 dec" 4094 "001~0xFFE:1~4094 dec" 4095 "Invalid" ;
VAL_ 1276 Resolution_Req_Height 0 "Default" 1 "001~0xFFE:1~4094 dec" 4094 "001~0xFFE:1~4094 dec" 4095 "Invalid" ;
VAL_ 1276 Center_offset_Width_set 0 "0x0~0x800:0~2048 dec" 2048 "0x0~0x800:0~2048 dec" 2049 "801~0xFFD:-1~ -2046:  ( -1 * (Req_Center_Width - 0x800))" 4093 "801~0xFFD:-1~ -2046:  ( -1 * (Req_Center_Width - 0x800))" 4094 "Default" 4095 "Invalid" ;
VAL_ 1276 Center_offset_Height_set 0 "0x0~0x800:0~2048 dec" 2048 "0x0~0x800:0~2048 dec" 2049 "801~0xFFD:0x801~0xFFD: -1~ -2047 :  ( -1 * (Req_Center_Height - 0x800))" 4093 "801~0xFFD:0x801~0xFFD: -1~ -2047 :  ( -1 * (Req_Center_Height - 0x800))" 4094 "Default" 4095 "Invalid" ;
VAL_ 1276 DCM_FPS_Change 0 "Default" 1 "1~0x7E:0~127 FPS" 126 "1~0x7E:0~127 FPS" 127 "Invalid" ;
VAL_ 1277 BLTN_CAM_FD_DCM_Crc1Val 0 "0x0~0xFFFF:CRCValue" 65535 "0x0~0xFFFF:CRCValue" ;
VAL_ 1277 BLTN_CAM_FD_DCM_AlvCnt1Val 0 "0x0~0xFF:AlvCntValue" 255 "0x0~0xFF:AlvCntValue" ;
VAL_ 1277 BLTN_CAM_DCM_Status 0 "Normal" 1 "Built-in Cam Display DCM normally" 2 "Built-in Cam Not Ready to DCM display output - Built-in CAM Booting" 3 "Built-in Cam DCM display error because of built-in Cam System error" 4 "Built-in Cam DCM display error because of built-in Cam Rear Camera error" 5 "Built-in Cam DCM display No Output because of DCM Status" 6 "RESERVED" 7 "RESERVED" 8 "RESERVED" 9 "RESERVED" 10 "RESERVED" 11 "RESERVED" 12 "RESERVED" 13 "RESERVED" 14 "RESERVED" 15 "Invalid" ;
VAL_ 1277 RearCamera_Input_Status 0 "Normal" 1 "Rear Camera Error because the camera is not connected" 2 "Rear Camera Error because the camera is  connected and camera error." 3 "Initializing by Built-in Cam" 4 "Initializing by DCM Request" 5 "RESERVED" 6 "RESERVED" 7 "RESERVED" 8 "RESERVED" 9 "RESERVED" 10 "RESERVED" 11 "RESERVED" 12 "RESERVED" 13 "RESERVED" 14 "RESERVED" 15 "Invalid" ;
VAL_ 1277 DCM_Output_Resolution_Width 0 "Default(the information is not checked yet.)" 1 "1~0xFFE:1~4094 dec" 4094 "1~0xFFE:1~4094 dec" 15 "Inavlid" ;
VAL_ 1277 DCM_Output_Resolution_Height 0 "Default(the information is not checked yet.)" 1 "1~0xFFE:1~4094 dec" 4094 "1~0xFFE:1~4094 dec" 4095 "Inavlid" ;
VAL_ 1277 BLTN_CAM_DCM_SER_I2C_Master 0 "Default" 1 "Built-in Cam I2C Master Off" 2 "Built-in Cam I2C Master On" 3 "Inavlid" ;
VAL_ 1277 Center_offset_Width 0 "0x0~0x800:0~2048 dec" 2048 "0x0~0x800:0~2048 dec" 2049 "801~0xFFD:-1~ -2045 dec" 4093 "801~0xFFD:-1~ -2045 dec" 4094 "Default(the information is not checked yet.)" 4095 "Invalid" ;
VAL_ 1277 Center_offset_Height 4094 "Default(the information is not checked yet.)" 0 "0~0x800:0~2048 dec" 2048 "0~0x800:0~2048 dec" 2049 "801~0xFFD:-1~ -2045 dec" 4093 "801~0xFFD:-1~ -2045 dec" 4095 "Inavlid" ;
VAL_ 1277 FPS_RearCamera 0 "Default(the information is not checked yet.)" 1 "1~0x7E:0~126 FPS" 126 "1~0x7E:0~126 FPS" 127 "Inavalid" ;
VAL_ 1277 FPS_DCM_Output 0 "Default(the information is not checked yet.)" 1 "1~0x7E:1~126 FPS" 126 "1~0x7E:1~126 FPS" 127 "Inavlid" ;
VAL_ 69 HTCU_CtrlablSta 0 "Not ready" 1 "TCU Controllable" 2 "Not Used" 3 "Error Indicator" ;
VAL_ 69 HTCU_PrgrmSta 0 "PR_NML" 1 "PR_MED" 2 "PR_SPTY" 3 "PR_LD1" 4 "PR_LD2" 5 "PR_LD3" 6 "PR_DLD" 7 "PR_LD1_H" 8 "PR_LD2_H" 9 "PR_LD3_H" 10 "PR_PRT" 11 "PR_WRM_UP" 12 "PR_BLUE" 13 "PR_ECO_ATC" 14 "PR_LD_ATC" 15 "PR_LD_ATC_H" 16 "PR_HWY" 17 "PR_SOL_L" 18 "PR_SOL_M" 19 "PR_SOL_H" 20 "PR_REGEN" 21 "PR_TF_LO" 22 "PR_TCS" 23 "PR_LD_TCS" 24 "PR_DS" 25 "PR_EV_BLUE" 26 "PR_EV_NML" 27 "PR_EV_SOC_H" 28 "PR_EV_SOC_L" 29 "PR_EV_HWY" 30 "PR_SOS" 31 "PR_ECO_ATC_EV" 32 "PR_LD_ATC_EV" 33 "PR_LD_ATC_HI_EV" 34 "PR_LD2_ATC" 35 "PR_LD3_ATC" 36 "PR_LD2_ATC_H" 37 "PR_LD3_ATC_H" 38 "PR_EC_PRT" ;
VAL_ 69 HTCU_FsCltchLmphmActvSta 0 "Inactive" 1 "Active" 2 "Not used" 3 "Error Indicator" ;
VAL_ 69 HTCU_RapidKDReq 0 "Inactive" 1 "Active" 2 "Not used" 3 "Error Indicator" ;
VAL_ 69 HTCU_CurrGearSta 15 "--" 0 "If N or P are detected(No frictional conncetion)" 1 "1st speed" 2 "2nd speed" 3 "3rd speed" 4 "4th speed" 5 "5th speed" 6 "6th speed" 7 "Reverse" 8 "7th speed" 9 "8th Speed" ;
VAL_ 69 HTCU_GearShftUpDisGSI 0 "Gear Shiftup Display Off" 1 "Gear Shiftup Display On" 2 "Not used" 3 "Error Indicator" ;
VAL_ 69 HTCU_GearShftDnDisGSI 0 "Gear Shiftdown Display Off" 1 "Gear Shiftdown Display On" 2 "Not used" 3 "Error Indicator" ;
VAL_ 69 HTCU_TrgtGearStaGSI 0 "--" 1 "1st speed" 2 "2nd speed" 3 "3rd speed" 4 "4th speed" 5 "5th speed" 6 "6th speed" 7 "7th speed" 8 "8th Speed" 9 "--" ;
VAL_ 69 HTCU_SolBSta 0 "OFF" 1 "ON" 2 "Not used" 3 "Error Indicator" ;
VAL_ 69 HTCU_PddlShftMdSlctSta 0 "Invalid (USM Off)" 1 "Paddle Step Control Mode (Sync with DrvMod)" 2 "Manual Shift Mode (Sync with DrvMod)" 3 "Manual Shift Mode (Fixed)" ;
VAL_ 69 HTCU_PrkReleaseReq 0 "No Request" 1 "E-shifter Parking Release" 2 "Not used" 3 "Error Indicator" ;
VAL_ 69 HTCU_TrgtGearSta 15 "--" 0 "If N or P are detected(No frictional conncetion)" 1 "1st speed" 2 "2nd speed" 3 "3rd speed" 4 "4th speed" 5 "5th speed" 6 "6th speed" 7 "Reverse" 8 "7th speed" 9 "8th Speed" ;
VAL_ 69 HTCU_RdySta 0 "Not ready" 1 "Ready" 2 "Not used" 3 "Error Indicator" ;
VAL_ 69 HTCU_GearChgSta 0 "Inactive" 1 "Active" 2 "Not used" 3 "Error Indicator" ;
VAL_ 69 HTCU_FltSta 0 "No fault" 1 "TCU Diagnostic failure" 2 "Not used" 3 "TCU Diagnostic failure & Limphome activated" 4 "OPU/EOP Diagnostic failure" 5 "TCU & OPU/EOP Diagnostic failure" 6 "Not used" 7 "TCU/OPU Diagnostic failure & Limphome activated" ;
VAL_ 69 HTCU_GearSlctrDis 0 "P" 1 "L" 2 "2" 3 "3" 4 "DS Mode" 5 "D" 6 "N" 7 "R" 8 "Sports mode / Manual Shift" 9 "Not display at Cluster" 10 "Sub-Rom Communication" 11 "Sub-Rom Communication Error" 12 "Paddle shift (D-Position)" 13 "Full-time manual shift" 14 "Intermediate Position" 15 "Fault" ;
VAL_ 69 HTCU_PddlShftUpDn 0 "Not Request" 1 "Paddle Plus" 2 "Paddle Minus" 3 "RESERVED" ;
VAL_ 69 HTCU_FanCtrlReq 0 "Not Request" 1 "Request" 2 "Not Used" 3 "Error Indicator" ;
VAL_ 69 HTCU_TrgtShftClsCCanSta 0 "NO SHIFT" 1 "PON UP" 2 "POF UP" 3 "PON DN@HIGH SPEED(Not Used)" 4 "PON DN@LOW SPEED" 5 "POF DN" 6 "NSTP TO 5/4/3/2" 7 "NSTP TO 1" 8 "LOW_VSP SFT12" 9 "N-D 12" 10 "N-D 3456" 11 "N-D5(NOT USED)" 12 "N-R" 13 "N-N" 14 "PON DN WOT SHIFT (NOT USED)" 15 "PON DN SEMI SHIFT" 16 "D-N/R-N" 17 "RESERVED" 18 "RESERVED" 19 "RESERVED" 20 "FAILSAFE 2-3-4 SHIFT" 21 "RESERVED" 22 "RESERVED" 23 "RESERVED" 24 "RESERVED" 25 "RESERVED" 26 "RESERVED" 27 "RESERVED" 28 "RESERVED" 29 "RESERVED" 30 "RESERVED" 31 "RESERVED" ;
