VERSION ""

NS_ :

BS_:

BU_: SHVU_CCS_FD ARS_FD WPC_FD WPC2_FD SCM_FD SHVU_FRNT_FD FLLR_FD vDummy_FD_B2 GW_SAU_DRV_FD ATS_FD PSB_FD GW_PSU_RR_FD SHVU_RL_FD RWPC_FD CGW_CCU OHCL_FD SHVU_REAR_FD BLTN_CAM_FD GW_PSU_DRV_FD FCS_FD GW_PSU_AST_FD GW_PSU_3RD_FD RCS_FD GW_PSU_RL_FD SHVU_3RD_FD SHVU_RR_FD RCM_FD DCM_FD SGU_FD vFD_B2

BO_ 250 HCU_03_10ms: 32 CGW_CCU
 SG_ HCU_Crc3Val : 0|16@1+ (1,0) [0|0] ""  GW_PSU_DRV_FD
 SG_ HCU_SpdLimDeviceActSta : 100|2@1+ (1,0) [0|0] "" Vector__XXX
 SG_ HCU_SpdLimDeviceOperSta : 102|2@1+ (1,0) [0|0] "" Vector__XXX
 SG_ HCU_SpdLimDeviceVehSpdVal : 104|8@1+ (1,0) [0|0] "" Vector__XXX
 SG_ HCU_SrvModSta : 112|2@1+ (1,0) [0|0] "" Vector__XXX
 SG_ HCU_StrtInhbt2Sta : 114|2@1+ (1,0) [0|0] "" Vector__XXX
 SG_ HCU_StrtInhbtSta : 116|2@1+ (1,0) [0|0] "" Vector__XXX
 SG_ HCU_PdlRgnCmpnRear : 118|2@1+ (1,0) [0|0] "flag" Vector__XXX
 SG_ HCU_VehStrtEnblSta : 120|2@1+ (1,0) [0|0] "" Vector__XXX
 SG_ HCU_BrkLmpOnReq : 122|2@1+ (1,0) [0|0] "" Vector__XXX
 SG_ HCU_CcDrvAlrtDis : 124|2@1+ (1,0) [0|0] "" Vector__XXX
 SG_ HCU_SldDrvAlrtDis : 126|2@1+ (1,0) [0|0] "" Vector__XXX
 SG_ HCU_WhlCrpCrpTqNmVal : 128|16@1- (1,0) [0|0] "Nm" Vector__XXX
 SG_ LHCU_EngCltchTrnsfrTqPcVal_Copy_ : 144|10@1- (0.1953125,0) [0|0] "%" Vector__XXX
 SG_ HCU_RspaAlvCntVal : 154|2@1+ (1,0) [0|0] "Step" Vector__XXX
 SG_ HCU_RspaSta : 156|4@1+ (1,0) [0|0] "" Vector__XXX
 SG_ HCU_AlvCnt3Val : 16|8@1+ (1,0) [0|0] ""  GW_PSU_DRV_FD
 SG_ HCU_RspaCanFailSta : 160|2@1+ (1,0) [0|0] "" Vector__XXX
 SG_ HCU_PdlStopCtrlSta : 162|2@1+ (1,0) [0|0] "" Vector__XXX
 SG_ HCU_PdlRgnCmpn : 164|2@1+ (1,0) [0|0] "flag" Vector__XXX
 SG_ HCU_RForwardRq : 166|2@1+ (1,0) [0|0] "" Vector__XXX
 SG_ HCU_PdlStopReqTqNmVal : 168|16@1+ (1,0) [0|0] "Nm" Vector__XXX
 SG_ HCU_GearRInhbtSta : 184|2@1+ (1,0) [0|0] "" Vector__XXX
 SG_ HCU_GreenzoneDistinctGen : 186|4@1+ (1,0) [0|0] "" Vector__XXX
 SG_ HCU_2ndStpSig : 190|2@1+ (1,0) [0|0] "" Vector__XXX
 SG_ HCU_Mg3SpdCmdVal : 192|14@1+ (1,0) [0|0] "rpm" Vector__XXX
 SG_ HCU_Mg3TqPcReq : 206|10@1- (0.1953125,0) [0|0] "%" Vector__XXX
 SG_ HCU_Mg3DisChrgTqCmdPcVal_FS : 216|10@1- (0.1953125,0) [0|0] "%" Vector__XXX
 SG_ HCU_Mg3ChrgTqCmdPcVal_FS : 226|10@1- (0.1953125,0) [0|0] "%" Vector__XXX
 SG_ HCU_11sMaxSpdLimOperSta : 236|2@1+ (1,0) [0|0] "" Vector__XXX
 SG_ HCU_PMPDUsmSta : 238|2@1+ (1,0) [0|0] "flag" Vector__XXX
 SG_ HCU_DrvWhlDmndTqNmVal : 24|16@1- (1,0) [0|0] "Nm" Vector__XXX
 SG_ HCU_PMPDActSta : 240|2@1+ (1,0) [0|0] "" Vector__XXX
 SG_ HCU_PMPDWarnSta : 242|2@1+ (1,0) [0|0] "" Vector__XXX
 SG_ HCU_STAYModSta : 244|3@1+ (1,0) [0|0] "" Vector__XXX
 SG_ HCU_STAYModWarnSta : 247|3@1+ (1,0) [0|0] "" Vector__XXX
 SG_ HCU_STAYModReservationSta : 250|2@1+ (1,0) [0|0] "" Vector__XXX
 SG_ HCU_STAYModBattMngmntSta : 252|2@1+ (1,0) [0|0] "" Vector__XXX
 SG_ HCU_Mg3AntJrkInhbtReq : 40|2@1+ (1,0) [0|0] "" Vector__XXX
 SG_ HCU_Mg3CtrlModReq : 42|2@1+ (1,0) [0|0] "" Vector__XXX
 SG_ HCU_Mg3PwmOffInhbtSta : 44|2@1+ (1,0) [0|0] "" Vector__XXX
 SG_ HCU_Mg3PwrEnaSta : 46|2@1+ (1,0) [0|0] "" Vector__XXX
 SG_ HCU_SmartRegen_HeadwayDstSet : 48|3@1+ (1,0) [0|0] "" Vector__XXX
 SG_ HCU_EstAccelPdlPcVal : 51|8@1+ (0.390625,0) [0|0] "%" Vector__XXX
 SG_ HCU_EstApsSelSta : 59|2@1+ (1,0) [0|0] "" Vector__XXX
 SG_ HCU_GreenZoneDrvModSta : 61|2@1+ (1,0) [0|0] "" Vector__XXX
 SG_ HCU_GreenZoneLmpDis : 64|2@1+ (1,0) [0|0] "" Vector__XXX
 SG_ HCU_HcuRdySta : 66|2@1+ (1,0) [0|0] "" Vector__XXX
 SG_ HCU_HEVRdyDis : 68|2@1+ (1,0) [0|0] "" Vector__XXX
 SG_ HCU_HevRdySta : 70|2@1+ (1,0) [0|0] ""  ARS_FD,BLTN_CAM_FD,GW_PSU_3RD_FD,GW_PSU_AST_FD,GW_PSU_DRV_FD,GW_PSU_RL_FD,GW_PSU_RR_FD,GW_SAU_DRV_FD,PSB_FD,RCM_FD,RWPC_FD,SCM_FD,SHVU_3RD_FD,SHVU_CCS_FD,SHVU_FRNT_FD,SHVU_REAR_FD,SHVU_RL_FD,SHVU_RR_FD,WPC2_FD,WPC_FD
 SG_ HCU_LimpOffSta : 72|2@1+ (1,0) [0|0] "" Vector__XXX
 SG_ HCU_MILOnReq : 74|2@1+ (1,0) [0|0] "" Vector__XXX
 SG_ HCU_PhevAutoModOnSta : 76|2@1+ (1,0) [0|0] "flag" Vector__XXX
 SG_ HCU_SccDrvOvrdReq : 78|2@1+ (1,0) [0|0] "" Vector__XXX
 SG_ HCU_SccEnblSta : 80|2@1+ (1,0) [0|0] "" Vector__XXX
 SG_ HCU_SlwDnSta : 82|2@1+ (1,0) [0|0] "" Vector__XXX
 SG_ HCU_SmrtEcoGdDis : 84|2@1+ (1,0) [0|0] "" Vector__XXX
 SG_ HCU_SmrtEcoLvlDis : 86|7@1+ (1,0) [0|0] "" Vector__XXX
 SG_ HCU_SmrtEcoRngDis : 93|7@1+ (1,0) [0|0] "" Vector__XXX

BO_ 1325 BLTN_CAM_ADAS_PRK_00_500ms: 32 BLTN_CAM_FD
 SG_ BLTN_CAM_ADAS_PRK_Crc0Val : 0|16@1+ (1,0) [0|0] "" Vector__XXX
 SG_ BLTN_CAM_ADAS_PRK_AlvCnt0Val : 16|8@1+ (1,0) [0|0] "" Vector__XXX
 SG_ BLTN_CAM_I2CMasterSta_Left : 24|2@1+ (1,0) [0|0] ""  CGW_CCU
 SG_ BLTN_CAM_I2CMasterSta_Right : 26|2@1+ (1,0) [0|0] ""  CGW_CCU
 SG_ BLTN_CAM_CamSta_Left : 28|4@1+ (1,0) [0|0] ""  CGW_CCU
 SG_ BLTN_CAM_CamSta_Right : 32|4@1+ (1,0) [0|0] ""  CGW_CCU

BO_ 112 HTCU_05_10ms: 32 CGW_CCU
 SG_ HTCU_Crc5Val : 0|16@1+ (1,0) [0|0] "" Vector__XXX
 SG_ HDCT_TqIncReq : 101|2@1+ (1,0) [0|0] "" Vector__XXX
 SG_ HDCT_TqIncVal : 103|10@1+ (0.390625,-200) [0|0] "%" Vector__XXX
 SG_ HDCT_EOLReq : 113|2@1+ (1,0) [0|0] "" Vector__XXX
 SG_ HDCT_CltchSta : 115|2@1+ (1,0) [0|0] "" Vector__XXX
 SG_ HDCT_DblCltchSta : 117|4@1+ (1,0) [0|0] "" Vector__XXX
 SG_ HDCT_AcnChrgInhbtReq : 121|2@1+ (1,0) [0|0] "" Vector__XXX
 SG_ HDCT_SlipCrnkAllw : 123|2@1+ (1,0) [0|0] "" Vector__XXX
 SG_ HDCT_KckDnSkpShftCnt : 125|2@1+ (1,0) [0|0] "" Vector__XXX
 SG_ HDCT_FuelCutReq : 128|2@1+ (1,0) [0|0] "" Vector__XXX
 SG_ HDCT_NCoastTrgtGear : 130|4@1+ (1,0) [0|0] "" Vector__XXX
 SG_ HDCT_NCoastDnReq : 134|2@1+ (1,0) [0|0] "" Vector__XXX
 SG_ HDCT_CLUEngSpd : 136|13@1+ (0.9766,0) [0|0] "" Vector__XXX
 SG_ HDCT_CLUEngSpdFlag : 149|2@1+ (1,0) [0|0] "" Vector__XXX
 SG_ HDCT_CLUTrgtGear : 151|4@1+ (1,0) [0|0] "" Vector__XXX
 SG_ HDCT_GSITrgtGear : 155|4@1+ (1,0) [0|0] "" Vector__XXX
 SG_ HDCT_PtrnGear : 159|4@1+ (1,0) [0|0] "" Vector__XXX
 SG_ HTCU_AlvCnt5Val : 16|8@1+ (1,0) [0|0] "" Vector__XXX
 SG_ HDCT_AddtnlTqLssVal : 24|8@1+ (0.390625,0) [0|0] "%" Vector__XXX
 SG_ HDCT_OBDSta : 32|4@1+ (1,0) [0|0] "" Vector__XXX
 SG_ HDCT_OBDErrSta : 36|2@1+ (1,0) [0|0] "" Vector__XXX
 SG_ HDCT_StcShftLrchCtrl : 38|2@1+ (1,0) [0|0] "" Vector__XXX
 SG_ HDCT_EngCltchLmphmMod : 40|2@1+ (1,0) [0|0] "" Vector__XXX
 SG_ HDCT_CurrPrgrm : 42|5@1+ (1,0) [0|0] "" Vector__XXX
 SG_ HDCT_FltSta : 47|3@1+ (1,0) [0|0] "" Vector__XXX
 SG_ HDCT_MCUAntJrkInhbt : 50|2@1+ (1,0) [0|0] "" Vector__XXX
 SG_ HDCT_TrgtGear : 52|4@1+ (1,0) [0|0] "" Vector__XXX
 SG_ HDCT_CurrGear : 56|4@1+ (1,0) [0|0] "" Vector__XXX
 SG_ HDCT_GearSelDis : 60|4@1+ (1,0) [0|0] ""  BLTN_CAM_FD,DCM_FD,FCS_FD
 SG_ HDCT_TCURdySta : 64|2@1+ (1,0) [0|0] "" Vector__XXX
 SG_ HDCT_CtrlablSta : 66|2@1+ (1,0) [0|0] "" Vector__XXX
 SG_ HDCT_TrgtShftCls : 68|5@1+ (1,0) [0|0] "flag" Vector__XXX
 SG_ HDCT_ShftPhase : 73|5@1+ (1,0) [0|0] "" Vector__XXX
 SG_ HDCT_NetrlCtrlSta : 78|2@1+ (1,0) [0|0] "" Vector__XXX
 SG_ HDCT_GearShftSta : 80|2@1+ (1,0) [0|0] "" Vector__XXX
 SG_ HDCT_TqRdctnVal : 82|10@1+ (0.390625,-200) [0|0] "%" Vector__XXX
 SG_ HTCU_SlwTqRdctnVal : 92|9@1+ (0.390625,0) [0|0] "%" Vector__XXX

BO_ 126 HU_BLTN_CAM_01_00ms: 24 CGW_CCU
 SG_ HU_BLTN_CAM_Crc1Val : 0|16@1+ (1,0) [0|0] "" Vector__XXX
 SG_ BLTN_CAM_EV_BfrTime_NvalueSet : 102|5@1+ (1,0) [0|0] ""  BLTN_CAM_FD
 SG_ BLTN_CAM_EV_AftTime_NvalueSet : 107|5@1+ (1,0) [0|0] ""  BLTN_CAM_FD
 SG_ BLTN_CAM_TML_Int_NvalueSet : 112|4@1+ (1,0) [0|0] ""  BLTN_CAM_FD
 SG_ BLTN_CAM_Sen_DEV_NvalueSet : 116|4@1+ (1,0) [0|0] ""  BLTN_CAM_FD
 SG_ BLTN_CAM_Sen_PEV_NvalueSet : 120|4@1+ (1,0) [0|0] ""  BLTN_CAM_FD
 SG_ BLTN_CAM_FR_VerPos_NvalueSet : 128|5@1+ (1,0) [0|0] ""  BLTN_CAM_FD
 SG_ BLTN_CAM_RR_VerPos_NvalueSet : 133|5@1+ (1,0) [0|0] ""  BLTN_CAM_FD
 SG_ BLTN_CAM_AppNoti_PEV_NvalueSet : 138|2@1+ (1,0) [0|0] ""  BLTN_CAM_FD
 SG_ BLTN_CAM_WiFi_AutoOn_NvalueSet : 140|2@1+ (1,0) [0|0] ""  BLTN_CAM_FD
 SG_ BLTN_CAM_StoProp_NvalueSet : 142|4@1+ (1,0) [0|0] ""  BLTN_CAM_FD
 SG_ CF_AVN_BLTN_CAM_USMReset : 146|2@1+ (1,0) [0|0] ""  BLTN_CAM_FD
 SG_ CF_AVN_BLTN_CAM_RecReset : 148|2@1+ (1,0) [0|0] ""  BLTN_CAM_FD
 SG_ BLTN_CAM_File_DEL_CPY_Cmd : 150|4@1+ (1,0) [0|0] ""  BLTN_CAM_FD
 SG_ BLTN_CAM_LVDS_Mode_Cmd : 154|2@1+ (1,0) [0|0] ""  BLTN_CAM_FD
 SG_ HU_BLTN_CAM_Disp_Touch_Pos_X : 156|11@1+ (1,0) [0|0] ""  BLTN_CAM_FD
 SG_ HU_BLTN_CAM_AlvCnt1Val : 16|8@1+ (1,0) [0|0] "" Vector__XXX
 SG_ HU_BLTN_CAM_Disp_Touch_Pos_Y : 167|10@1+ (1,0) [0|0] ""  BLTN_CAM_FD
 SG_ MEV_Rec_Req : 177|2@1+ (1,0) [0|0] ""  BLTN_CAM_FD
 SG_ TML_Rec_Req : 179|2@1+ (1,0) [0|0] ""  BLTN_CAM_FD
 SG_ BLTN_CAM_SD_Card_UnMt_Mt_Req : 181|2@1+ (1,0) [0|0] ""  BLTN_CAM_FD
 SG_ BLTN_CAM_PMD_NvalueSet : 24|2@1+ (1,0) [0|0] ""  BLTN_CAM_FD
 SG_ BLTN_CAM_PMDEV_NvalueSet : 26|2@1+ (1,0) [0|0] ""  BLTN_CAM_FD
 SG_ BLTN_CAM_Ran_PMDR_NvalueSet : 28|4@1+ (1,0) [0|0] ""  BLTN_CAM_FD
 SG_ BLTN_CAM_PMDTime_NvalueSet : 32|8@1+ (1,0) [0|0] ""  BLTN_CAM_FD
 SG_ BLTN_CAM_BPR_TM_NvalueSet : 40|3@1+ (1,0) [0|0] ""  BLTN_CAM_FD
 SG_ BLTN_CAM_BPR_RE_NvalueSet : 43|3@1+ (1,0) [0|0] ""  BLTN_CAM_FD
 SG_ BLTN_CAM_BPR_SndRec_NvalueSet : 46|2@1+ (1,0) [0|0] ""  BLTN_CAM_FD
 SG_ BLTN_CAM_BPR_AutRec_NvalueSet : 48|2@1+ (1,0) [0|0] ""  BLTN_CAM_FD
 SG_ BLTN_CAM_BPR_Rec_Req : 50|2@1+ (1,0) [0|0] ""  BLTN_CAM_FD
 SG_ BLTN_CAM_Rec_LPE_NvalueSet : 52|2@1+ (1,0) [0|0] ""  BLTN_CAM_FD
 SG_ BLTN_CAM_Distort_NvalueSet : 54|2@1+ (1,0) [0|0] ""  BLTN_CAM_FD
 SG_ BLTN_CAM_Pollution_NvalueSet : 56|2@1+ (1,0) [0|0] ""  BLTN_CAM_FD
 SG_ BLTN_CAM_Crash_Pos_NvalueSet : 58|2@1+ (1,0) [0|0] ""  BLTN_CAM_FD
 SG_ BLTN_CAM_Rear_Flip_NvalueSet : 60|2@1+ (1,0) [0|0] ""  BLTN_CAM_FD
 SG_ BLTN_CAM_Stm_all_NvalueSet : 62|2@1+ (1,0) [0|0] ""  BLTN_CAM_FD
 SG_ BLTN_CAM_Rec_OWD_NvalueSet : 64|2@1+ (1,0) [0|0] ""  BLTN_CAM_FD
 SG_ BLTN_CAM_Rec_DEV_NvalueSet : 66|2@1+ (1,0) [0|0] ""  BLTN_CAM_FD
 SG_ BLTN_CAM_Rec_OWP_NvalueSet : 68|2@1+ (1,0) [0|0] ""  BLTN_CAM_FD
 SG_ BLTN_CAM_Rec_PEV_NvalueSet : 70|2@1+ (1,0) [0|0] ""  BLTN_CAM_FD
 SG_ BLTN_CAM_AudRec_NvalueSet : 72|2@1+ (1,0) [0|0] ""  BLTN_CAM_FD
 SG_ BLTN_CAM_Time_Stm_NvalueSet : 74|2@1+ (1,0) [0|0] ""  BLTN_CAM_FD
 SG_ BLTN_CAM_Spd_Stm_NvalueSet : 76|2@1+ (1,0) [0|0] ""  BLTN_CAM_FD
 SG_ BLTN_CAM_Locatn_Stm_NvalueSet : 78|2@1+ (1,0) [0|0] ""  BLTN_CAM_FD
 SG_ BLTN_CAM_TrnSig_Stm_NvalueSet : 80|2@1+ (1,0) [0|0] ""  BLTN_CAM_FD
 SG_ BLTN_CAM_AclBrk_Stm_NvalueSet : 82|2@1+ (1,0) [0|0] ""  BLTN_CAM_FD
 SG_ BLTN_CAM_GearPos_Stm_NvalueSet : 84|2@1+ (1,0) [0|0] ""  BLTN_CAM_FD
 SG_ BLTN_CAM_EVSen_Stm_NvalueSet : 86|2@1+ (1,0) [0|0] ""  BLTN_CAM_FD
 SG_ BLTN_CAM_Strangl_Stm_NvalueSet : 88|2@1+ (1,0) [0|0] ""  BLTN_CAM_FD
 SG_ BLTN_CAM_EV_RecMaxTime_NvalueSet : 90|2@1+ (1,0) [0|0] ""  BLTN_CAM_FD
 SG_ BLTN_CAM_Rec_STRM_NvalueSet : 92|2@1+ (1,0) [0|0] ""  BLTN_CAM_FD
 SG_ BLTN_CAM_PrkTime_NvalueSet : 94|8@1+ (1,0) [0|0] "Hour"  BLTN_CAM_FD

BO_ 2549874789 NM_SHVU_CCS_FD: 32 SHVU_CCS_FD
 SG_ SNI_SHVU_CCS_FD : 0|8@1+ (1,0) [0|0] ""  ARS_FD,ATS_FD,BLTN_CAM_FD,CGW_CCU,DCM_FD,FCS_FD,FLLR_FD,GW_PSU_3RD_FD,GW_PSU_AST_FD,GW_PSU_DRV_FD,GW_PSU_RL_FD,GW_PSU_RR_FD,GW_SAU_DRV_FD,OHCL_FD,PSB_FD,RCM_FD,RCS_FD,RWPC_FD,SCM_FD,SGU_FD,SHVU_3RD_FD,SHVU_FRNT_FD,SHVU_REAR_FD,SHVU_RL_FD,SHVU_RR_FD,WPC2_FD,WPC_FD
 SG_ CBV_RMR_SHVU_CCS_FD : 8|1@1+ (1,0) [0|0] ""  ARS_FD,ATS_FD,BLTN_CAM_FD,CGW_CCU,DCM_FD,FCS_FD,FLLR_FD,GW_PSU_3RD_FD,GW_PSU_AST_FD,GW_PSU_DRV_FD,GW_PSU_RL_FD,GW_PSU_RR_FD,GW_SAU_DRV_FD,OHCL_FD,PSB_FD,RCM_FD,RCS_FD,RWPC_FD,SCM_FD,SGU_FD,SHVU_3RD_FD,SHVU_FRNT_FD,SHVU_REAR_FD,SHVU_RL_FD,SHVU_RR_FD,WPC2_FD,WPC_FD
 SG_ CBV_NMCoID_SHVU_CCS_FD : 9|2@1+ (1,0) [0|0] ""  ARS_FD,ATS_FD,BLTN_CAM_FD,CGW_CCU,DCM_FD,FCS_FD,FLLR_FD,GW_PSU_3RD_FD,GW_PSU_AST_FD,GW_PSU_DRV_FD,GW_PSU_RL_FD,GW_PSU_RR_FD,GW_SAU_DRV_FD,OHCL_FD,PSB_FD,RCM_FD,RCS_FD,RWPC_FD,SCM_FD,SGU_FD,SHVU_3RD_FD,SHVU_FRNT_FD,SHVU_REAR_FD,SHVU_RL_FD,SHVU_RR_FD,WPC2_FD,WPC_FD
 SG_ CBV_NMCoSRB_SHVU_CCS_FD : 11|1@1+ (1,0) [0|0] ""  ARS_FD,ATS_FD,BLTN_CAM_FD,CGW_CCU,DCM_FD,FCS_FD,FLLR_FD,GW_PSU_3RD_FD,GW_PSU_AST_FD,GW_PSU_DRV_FD,GW_PSU_RL_FD,GW_PSU_RR_FD,GW_SAU_DRV_FD,OHCL_FD,PSB_FD,RCM_FD,RCS_FD,RWPC_FD,SCM_FD,SGU_FD,SHVU_3RD_FD,SHVU_FRNT_FD,SHVU_REAR_FD,SHVU_RL_FD,SHVU_RR_FD,WPC2_FD,WPC_FD
 SG_ CBV_AWB_SHVU_CCS_FD : 12|1@1+ (1,0) [0|0] ""  ARS_FD,ATS_FD,BLTN_CAM_FD,CGW_CCU,DCM_FD,FCS_FD,FLLR_FD,GW_PSU_3RD_FD,GW_PSU_AST_FD,GW_PSU_DRV_FD,GW_PSU_RL_FD,GW_PSU_RR_FD,GW_SAU_DRV_FD,OHCL_FD,PSB_FD,RCM_FD,RCS_FD,RWPC_FD,SCM_FD,SGU_FD,SHVU_3RD_FD,SHVU_FRNT_FD,SHVU_REAR_FD,SHVU_RL_FD,SHVU_RR_FD,WPC2_FD,WPC_FD
 SG_ CBV_PNIB_SHVU_CCS_FD : 14|1@1+ (1,0) [0|0] ""  ARS_FD,ATS_FD,BLTN_CAM_FD,CGW_CCU,DCM_FD,FCS_FD,FLLR_FD,GW_PSU_3RD_FD,GW_PSU_AST_FD,GW_PSU_DRV_FD,GW_PSU_RL_FD,GW_PSU_RR_FD,GW_SAU_DRV_FD,OHCL_FD,PSB_FD,RCM_FD,RCS_FD,RWPC_FD,SCM_FD,SGU_FD,SHVU_3RD_FD,SHVU_FRNT_FD,SHVU_REAR_FD,SHVU_RL_FD,SHVU_RR_FD,WPC2_FD,WPC_FD
 SG_ NRR_SHVU_CCS_FD : 16|8@1+ (1,0) [0|0] ""  ARS_FD,ATS_FD,BLTN_CAM_FD,CGW_CCU,DCM_FD,FCS_FD,FLLR_FD,GW_PSU_3RD_FD,GW_PSU_AST_FD,GW_PSU_DRV_FD,GW_PSU_RL_FD,GW_PSU_RR_FD,GW_SAU_DRV_FD,OHCL_FD,PSB_FD,RCM_FD,RCS_FD,RWPC_FD,SCM_FD,SGU_FD,SHVU_3RD_FD,SHVU_FRNT_FD,SHVU_REAR_FD,SHVU_RL_FD,SHVU_RR_FD,WPC2_FD,WPC_FD
 SG_ NM_State_SHVU_CCS_FD : 24|8@1+ (1,0) [0|0] ""  ARS_FD,ATS_FD,BLTN_CAM_FD,CGW_CCU,DCM_FD,FCS_FD,FLLR_FD,GW_PSU_3RD_FD,GW_PSU_AST_FD,GW_PSU_DRV_FD,GW_PSU_RL_FD,GW_PSU_RR_FD,GW_SAU_DRV_FD,OHCL_FD,PSB_FD,RCM_FD,RCS_FD,RWPC_FD,SCM_FD,SGU_FD,SHVU_3RD_FD,SHVU_FRNT_FD,SHVU_REAR_FD,SHVU_RL_FD,SHVU_RR_FD,WPC2_FD,WPC_FD
 SG_ PNI_SHVU_CCS_FD : 32|32@1+ (1,0) [0|0] ""  ARS_FD,ATS_FD,BLTN_CAM_FD,CGW_CCU,DCM_FD,FCS_FD,FLLR_FD,GW_PSU_3RD_FD,GW_PSU_AST_FD,GW_PSU_DRV_FD,GW_PSU_RL_FD,GW_PSU_RR_FD,GW_SAU_DRV_FD,OHCL_FD,PSB_FD,RCM_FD,RCS_FD,RWPC_FD,SCM_FD,SGU_FD,SHVU_3RD_FD,SHVU_FRNT_FD,SHVU_REAR_FD,SHVU_RL_FD,SHVU_RR_FD,WPC2_FD,WPC_FD
 SG_ PNI_SHVU_CCS_FD_1 : 64|64@1+ (1,0) [0|0] ""  ARS_FD,ATS_FD,BLTN_CAM_FD,CGW_CCU,DCM_FD,FCS_FD,FLLR_FD,GW_PSU_3RD_FD,GW_PSU_AST_FD,GW_PSU_DRV_FD,GW_PSU_RL_FD,GW_PSU_RR_FD,GW_SAU_DRV_FD,OHCL_FD,PSB_FD,RCM_FD,RCS_FD,RWPC_FD,SCM_FD,SGU_FD,SHVU_3RD_FD,SHVU_FRNT_FD,SHVU_REAR_FD,SHVU_RL_FD,SHVU_RR_FD,WPC2_FD,WPC_FD
 SG_ PNI_SHVU_CCS_FD_2 : 128|64@1+ (1,0) [0|0] ""  ARS_FD,ATS_FD,BLTN_CAM_FD,CGW_CCU,DCM_FD,FCS_FD,FLLR_FD,GW_PSU_3RD_FD,GW_PSU_AST_FD,GW_PSU_DRV_FD,GW_PSU_RL_FD,GW_PSU_RR_FD,GW_SAU_DRV_FD,OHCL_FD,PSB_FD,RCM_FD,RCS_FD,RWPC_FD,SCM_FD,SGU_FD,SHVU_3RD_FD,SHVU_FRNT_FD,SHVU_REAR_FD,SHVU_RL_FD,SHVU_RR_FD,WPC2_FD,WPC_FD
 SG_ PNI_SHVU_CCS_FD_3 : 192|64@1+ (1,0) [0|0] ""  ARS_FD,ATS_FD,BLTN_CAM_FD,CGW_CCU,DCM_FD,FCS_FD,FLLR_FD,GW_PSU_3RD_FD,GW_PSU_AST_FD,GW_PSU_DRV_FD,GW_PSU_RL_FD,GW_PSU_RR_FD,GW_SAU_DRV_FD,OHCL_FD,PSB_FD,RCM_FD,RCS_FD,RWPC_FD,SCM_FD,SGU_FD,SHVU_3RD_FD,SHVU_FRNT_FD,SHVU_REAR_FD,SHVU_RL_FD,SHVU_RR_FD,WPC2_FD,WPC_FD

BO_ 2549874826 NM_ARS_FD: 32 ARS_FD
 SG_ SNI_ARS_FD : 0|8@1+ (1,0) [0|0] ""  ATS_FD,BLTN_CAM_FD,CGW_CCU,DCM_FD,FCS_FD,FLLR_FD,GW_PSU_3RD_FD,GW_PSU_AST_FD,GW_PSU_DRV_FD,GW_PSU_RL_FD,GW_PSU_RR_FD,GW_SAU_DRV_FD,OHCL_FD,PSB_FD,RCM_FD,RCS_FD,RWPC_FD,SCM_FD,SGU_FD,SHVU_3RD_FD,SHVU_CCS_FD,SHVU_FRNT_FD,SHVU_REAR_FD,SHVU_RL_FD,SHVU_RR_FD,WPC2_FD,WPC_FD
 SG_ CBV_RMR_ARS_FD : 8|1@1+ (1,0) [0|0] ""  ATS_FD,BLTN_CAM_FD,CGW_CCU,DCM_FD,FCS_FD,FLLR_FD,GW_PSU_3RD_FD,GW_PSU_AST_FD,GW_PSU_DRV_FD,GW_PSU_RL_FD,GW_PSU_RR_FD,GW_SAU_DRV_FD,OHCL_FD,PSB_FD,RCM_FD,RCS_FD,RWPC_FD,SCM_FD,SGU_FD,SHVU_3RD_FD,SHVU_CCS_FD,SHVU_FRNT_FD,SHVU_REAR_FD,SHVU_RL_FD,SHVU_RR_FD,WPC2_FD,WPC_FD
 SG_ CBV_NMCoID_ARS_FD : 9|2@1+ (1,0) [0|0] ""  ATS_FD,BLTN_CAM_FD,CGW_CCU,DCM_FD,FCS_FD,FLLR_FD,GW_PSU_3RD_FD,GW_PSU_AST_FD,GW_PSU_DRV_FD,GW_PSU_RL_FD,GW_PSU_RR_FD,GW_SAU_DRV_FD,OHCL_FD,PSB_FD,RCM_FD,RCS_FD,RWPC_FD,SCM_FD,SGU_FD,SHVU_3RD_FD,SHVU_CCS_FD,SHVU_FRNT_FD,SHVU_REAR_FD,SHVU_RL_FD,SHVU_RR_FD,WPC2_FD,WPC_FD
 SG_ CBV_NMCoSRB_ARS_FD : 11|1@1+ (1,0) [0|0] ""  ATS_FD,BLTN_CAM_FD,CGW_CCU,DCM_FD,FCS_FD,FLLR_FD,GW_PSU_3RD_FD,GW_PSU_AST_FD,GW_PSU_DRV_FD,GW_PSU_RL_FD,GW_PSU_RR_FD,GW_SAU_DRV_FD,OHCL_FD,PSB_FD,RCM_FD,RCS_FD,RWPC_FD,SCM_FD,SGU_FD,SHVU_3RD_FD,SHVU_CCS_FD,SHVU_FRNT_FD,SHVU_REAR_FD,SHVU_RL_FD,SHVU_RR_FD,WPC2_FD,WPC_FD
 SG_ CBV_AWB_ARS_FD : 12|1@1+ (1,0) [0|0] ""  ATS_FD,BLTN_CAM_FD,CGW_CCU,DCM_FD,FCS_FD,FLLR_FD,GW_PSU_3RD_FD,GW_PSU_AST_FD,GW_PSU_DRV_FD,GW_PSU_RL_FD,GW_PSU_RR_FD,GW_SAU_DRV_FD,OHCL_FD,PSB_FD,RCM_FD,RCS_FD,RWPC_FD,SCM_FD,SGU_FD,SHVU_3RD_FD,SHVU_CCS_FD,SHVU_FRNT_FD,SHVU_REAR_FD,SHVU_RL_FD,SHVU_RR_FD,WPC2_FD,WPC_FD
 SG_ CBV_PNIB_ARS_FD : 14|1@1+ (1,0) [0|0] ""  ATS_FD,BLTN_CAM_FD,CGW_CCU,DCM_FD,FCS_FD,FLLR_FD,GW_PSU_3RD_FD,GW_PSU_AST_FD,GW_PSU_DRV_FD,GW_PSU_RL_FD,GW_PSU_RR_FD,GW_SAU_DRV_FD,OHCL_FD,PSB_FD,RCM_FD,RCS_FD,RWPC_FD,SCM_FD,SGU_FD,SHVU_3RD_FD,SHVU_CCS_FD,SHVU_FRNT_FD,SHVU_REAR_FD,SHVU_RL_FD,SHVU_RR_FD,WPC2_FD,WPC_FD
 SG_ NRR_ARS_FD : 16|8@1+ (1,0) [0|0] ""  ATS_FD,BLTN_CAM_FD,CGW_CCU,DCM_FD,FCS_FD,FLLR_FD,GW_PSU_3RD_FD,GW_PSU_AST_FD,GW_PSU_DRV_FD,GW_PSU_RL_FD,GW_PSU_RR_FD,GW_SAU_DRV_FD,OHCL_FD,PSB_FD,RCM_FD,RCS_FD,RWPC_FD,SCM_FD,SGU_FD,SHVU_3RD_FD,SHVU_CCS_FD,SHVU_FRNT_FD,SHVU_REAR_FD,SHVU_RL_FD,SHVU_RR_FD,WPC2_FD,WPC_FD
 SG_ NM_State_ARS_FD : 24|8@1+ (1,0) [0|0] ""  ATS_FD,BLTN_CAM_FD,CGW_CCU,DCM_FD,FCS_FD,FLLR_FD,GW_PSU_3RD_FD,GW_PSU_AST_FD,GW_PSU_DRV_FD,GW_PSU_RL_FD,GW_PSU_RR_FD,GW_SAU_DRV_FD,OHCL_FD,PSB_FD,RCM_FD,RCS_FD,RWPC_FD,SCM_FD,SGU_FD,SHVU_3RD_FD,SHVU_CCS_FD,SHVU_FRNT_FD,SHVU_REAR_FD,SHVU_RL_FD,SHVU_RR_FD,WPC2_FD,WPC_FD
 SG_ PNI_ARS_FD : 32|32@1+ (1,0) [0|0] ""  ATS_FD,BLTN_CAM_FD,CGW_CCU,DCM_FD,FCS_FD,FLLR_FD,GW_PSU_3RD_FD,GW_PSU_AST_FD,GW_PSU_DRV_FD,GW_PSU_RL_FD,GW_PSU_RR_FD,GW_SAU_DRV_FD,OHCL_FD,PSB_FD,RCM_FD,RCS_FD,RWPC_FD,SCM_FD,SGU_FD,SHVU_3RD_FD,SHVU_CCS_FD,SHVU_FRNT_FD,SHVU_REAR_FD,SHVU_RL_FD,SHVU_RR_FD,WPC2_FD,WPC_FD
 SG_ PNI_ARS_FD_1 : 64|64@1+ (1,0) [0|0] ""  ATS_FD,BLTN_CAM_FD,CGW_CCU,DCM_FD,FCS_FD,FLLR_FD,GW_PSU_3RD_FD,GW_PSU_AST_FD,GW_PSU_DRV_FD,GW_PSU_RL_FD,GW_PSU_RR_FD,GW_SAU_DRV_FD,OHCL_FD,PSB_FD,RCM_FD,RCS_FD,RWPC_FD,SCM_FD,SGU_FD,SHVU_3RD_FD,SHVU_CCS_FD,SHVU_FRNT_FD,SHVU_REAR_FD,SHVU_RL_FD,SHVU_RR_FD,WPC2_FD,WPC_FD
 SG_ PNI_ARS_FD_2 : 128|64@1+ (1,0) [0|0] ""  ATS_FD,BLTN_CAM_FD,CGW_CCU,DCM_FD,FCS_FD,FLLR_FD,GW_PSU_3RD_FD,GW_PSU_AST_FD,GW_PSU_DRV_FD,GW_PSU_RL_FD,GW_PSU_RR_FD,GW_SAU_DRV_FD,OHCL_FD,PSB_FD,RCM_FD,RCS_FD,RWPC_FD,SCM_FD,SGU_FD,SHVU_3RD_FD,SHVU_CCS_FD,SHVU_FRNT_FD,SHVU_REAR_FD,SHVU_RL_FD,SHVU_RR_FD,WPC2_FD,WPC_FD
 SG_ PNI_ARS_FD_3 : 192|64@1+ (1,0) [0|0] ""  ATS_FD,BLTN_CAM_FD,CGW_CCU,DCM_FD,FCS_FD,FLLR_FD,GW_PSU_3RD_FD,GW_PSU_AST_FD,GW_PSU_DRV_FD,GW_PSU_RL_FD,GW_PSU_RR_FD,GW_SAU_DRV_FD,OHCL_FD,PSB_FD,RCM_FD,RCS_FD,RWPC_FD,SCM_FD,SGU_FD,SHVU_3RD_FD,SHVU_CCS_FD,SHVU_FRNT_FD,SHVU_REAR_FD,SHVU_RL_FD,SHVU_RR_FD,WPC2_FD,WPC_FD

BO_ 2549874846 NM_WPC_FD: 32 WPC_FD
 SG_ SNI_WPC_FD : 0|8@1+ (1,0) [0|0] ""  ARS_FD,ATS_FD,BLTN_CAM_FD,CGW_CCU,DCM_FD,FCS_FD,FLLR_FD,GW_PSU_3RD_FD,GW_PSU_AST_FD,GW_PSU_DRV_FD,GW_PSU_RL_FD,GW_PSU_RR_FD,GW_SAU_DRV_FD,OHCL_FD,PSB_FD,RCM_FD,RCS_FD,RWPC_FD,SCM_FD,SGU_FD,SHVU_3RD_FD,SHVU_CCS_FD,SHVU_FRNT_FD,SHVU_REAR_FD,SHVU_RL_FD,SHVU_RR_FD,WPC2_FD
 SG_ CBV_RMR_WPC_FD : 8|1@1+ (1,0) [0|0] ""  ARS_FD,ATS_FD,BLTN_CAM_FD,CGW_CCU,DCM_FD,FCS_FD,FLLR_FD,GW_PSU_3RD_FD,GW_PSU_AST_FD,GW_PSU_DRV_FD,GW_PSU_RL_FD,GW_PSU_RR_FD,GW_SAU_DRV_FD,OHCL_FD,PSB_FD,RCM_FD,RCS_FD,RWPC_FD,SCM_FD,SGU_FD,SHVU_3RD_FD,SHVU_CCS_FD,SHVU_FRNT_FD,SHVU_REAR_FD,SHVU_RL_FD,SHVU_RR_FD,WPC2_FD
 SG_ CBV_NMCoID_WPC_FD : 9|2@1+ (1,0) [0|0] ""  ARS_FD,ATS_FD,BLTN_CAM_FD,CGW_CCU,DCM_FD,FCS_FD,FLLR_FD,GW_PSU_3RD_FD,GW_PSU_AST_FD,GW_PSU_DRV_FD,GW_PSU_RL_FD,GW_PSU_RR_FD,GW_SAU_DRV_FD,OHCL_FD,PSB_FD,RCM_FD,RCS_FD,RWPC_FD,SCM_FD,SGU_FD,SHVU_3RD_FD,SHVU_CCS_FD,SHVU_FRNT_FD,SHVU_REAR_FD,SHVU_RL_FD,SHVU_RR_FD,WPC2_FD
 SG_ CBV_NMCoSRB_WPC_FD : 11|1@1+ (1,0) [0|0] ""  ARS_FD,ATS_FD,BLTN_CAM_FD,CGW_CCU,DCM_FD,FCS_FD,FLLR_FD,GW_PSU_3RD_FD,GW_PSU_AST_FD,GW_PSU_DRV_FD,GW_PSU_RL_FD,GW_PSU_RR_FD,GW_SAU_DRV_FD,OHCL_FD,PSB_FD,RCM_FD,RCS_FD,RWPC_FD,SCM_FD,SGU_FD,SHVU_3RD_FD,SHVU_CCS_FD,SHVU_FRNT_FD,SHVU_REAR_FD,SHVU_RL_FD,SHVU_RR_FD,WPC2_FD
 SG_ CBV_AWB_WPC_FD : 12|1@1+ (1,0) [0|0] ""  ARS_FD,ATS_FD,BLTN_CAM_FD,CGW_CCU,DCM_FD,FCS_FD,FLLR_FD,GW_PSU_3RD_FD,GW_PSU_AST_FD,GW_PSU_DRV_FD,GW_PSU_RL_FD,GW_PSU_RR_FD,GW_SAU_DRV_FD,OHCL_FD,PSB_FD,RCM_FD,RCS_FD,RWPC_FD,SCM_FD,SGU_FD,SHVU_3RD_FD,SHVU_CCS_FD,SHVU_FRNT_FD,SHVU_REAR_FD,SHVU_RL_FD,SHVU_RR_FD,WPC2_FD
 SG_ CBV_PNIB_WPC_FD : 14|1@1+ (1,0) [0|0] ""  ARS_FD,ATS_FD,BLTN_CAM_FD,CGW_CCU,DCM_FD,FCS_FD,FLLR_FD,GW_PSU_3RD_FD,GW_PSU_AST_FD,GW_PSU_DRV_FD,GW_PSU_RL_FD,GW_PSU_RR_FD,GW_SAU_DRV_FD,OHCL_FD,PSB_FD,RCM_FD,RCS_FD,RWPC_FD,SCM_FD,SGU_FD,SHVU_3RD_FD,SHVU_CCS_FD,SHVU_FRNT_FD,SHVU_REAR_FD,SHVU_RL_FD,SHVU_RR_FD,WPC2_FD
 SG_ NRR_WPC_FD : 16|8@1+ (1,0) [0|0] ""  ARS_FD,ATS_FD,BLTN_CAM_FD,CGW_CCU,DCM_FD,FCS_FD,FLLR_FD,GW_PSU_3RD_FD,GW_PSU_AST_FD,GW_PSU_DRV_FD,GW_PSU_RL_FD,GW_PSU_RR_FD,GW_SAU_DRV_FD,OHCL_FD,PSB_FD,RCM_FD,RCS_FD,RWPC_FD,SCM_FD,SGU_FD,SHVU_3RD_FD,SHVU_CCS_FD,SHVU_FRNT_FD,SHVU_REAR_FD,SHVU_RL_FD,SHVU_RR_FD,WPC2_FD
 SG_ NM_State_WPC_FD : 24|8@1+ (1,0) [0|0] ""  ARS_FD,ATS_FD,BLTN_CAM_FD,CGW_CCU,DCM_FD,FCS_FD,FLLR_FD,GW_PSU_3RD_FD,GW_PSU_AST_FD,GW_PSU_DRV_FD,GW_PSU_RL_FD,GW_PSU_RR_FD,GW_SAU_DRV_FD,OHCL_FD,PSB_FD,RCM_FD,RCS_FD,RWPC_FD,SCM_FD,SGU_FD,SHVU_3RD_FD,SHVU_CCS_FD,SHVU_FRNT_FD,SHVU_REAR_FD,SHVU_RL_FD,SHVU_RR_FD,WPC2_FD
 SG_ PNI_WPC_FD : 32|32@1+ (1,0) [0|0] ""  ARS_FD,ATS_FD,BLTN_CAM_FD,CGW_CCU,DCM_FD,FCS_FD,FLLR_FD,GW_PSU_3RD_FD,GW_PSU_AST_FD,GW_PSU_DRV_FD,GW_PSU_RL_FD,GW_PSU_RR_FD,GW_SAU_DRV_FD,OHCL_FD,PSB_FD,RCM_FD,RCS_FD,RWPC_FD,SCM_FD,SGU_FD,SHVU_3RD_FD,SHVU_CCS_FD,SHVU_FRNT_FD,SHVU_REAR_FD,SHVU_RL_FD,SHVU_RR_FD,WPC2_FD
 SG_ PNI_WPC_FD_1 : 64|64@1+ (1,0) [0|0] ""  ARS_FD,ATS_FD,BLTN_CAM_FD,CGW_CCU,DCM_FD,FCS_FD,FLLR_FD,GW_PSU_3RD_FD,GW_PSU_AST_FD,GW_PSU_DRV_FD,GW_PSU_RL_FD,GW_PSU_RR_FD,GW_SAU_DRV_FD,OHCL_FD,PSB_FD,RCM_FD,RCS_FD,RWPC_FD,SCM_FD,SGU_FD,SHVU_3RD_FD,SHVU_CCS_FD,SHVU_FRNT_FD,SHVU_REAR_FD,SHVU_RL_FD,SHVU_RR_FD,WPC2_FD
 SG_ PNI_WPC_FD_2 : 128|64@1+ (1,0) [0|0] ""  ARS_FD,ATS_FD,BLTN_CAM_FD,CGW_CCU,DCM_FD,FCS_FD,FLLR_FD,GW_PSU_3RD_FD,GW_PSU_AST_FD,GW_PSU_DRV_FD,GW_PSU_RL_FD,GW_PSU_RR_FD,GW_SAU_DRV_FD,OHCL_FD,PSB_FD,RCM_FD,RCS_FD,RWPC_FD,SCM_FD,SGU_FD,SHVU_3RD_FD,SHVU_CCS_FD,SHVU_FRNT_FD,SHVU_REAR_FD,SHVU_RL_FD,SHVU_RR_FD,WPC2_FD
 SG_ PNI_WPC_FD_3 : 192|64@1+ (1,0) [0|0] ""  ARS_FD,ATS_FD,BLTN_CAM_FD,CGW_CCU,DCM_FD,FCS_FD,FLLR_FD,GW_PSU_3RD_FD,GW_PSU_AST_FD,GW_PSU_DRV_FD,GW_PSU_RL_FD,GW_PSU_RR_FD,GW_SAU_DRV_FD,OHCL_FD,PSB_FD,RCM_FD,RCS_FD,RWPC_FD,SCM_FD,SGU_FD,SHVU_3RD_FD,SHVU_CCS_FD,SHVU_FRNT_FD,SHVU_REAR_FD,SHVU_RL_FD,SHVU_RR_FD,WPC2_FD

BO_ 2549874837 NM_WPC2_FD: 32 WPC2_FD
 SG_ SNI_WPC2_FD : 0|8@1+ (1,0) [0|0] ""  ARS_FD,ATS_FD,BLTN_CAM_FD,CGW_CCU,DCM_FD,FCS_FD,FLLR_FD,GW_PSU_3RD_FD,GW_PSU_AST_FD,GW_PSU_DRV_FD,GW_PSU_RL_FD,GW_PSU_RR_FD,GW_SAU_DRV_FD,OHCL_FD,PSB_FD,RCM_FD,RCS_FD,RWPC_FD,SCM_FD,SGU_FD,SHVU_3RD_FD,SHVU_CCS_FD,SHVU_FRNT_FD,SHVU_REAR_FD,SHVU_RL_FD,SHVU_RR_FD,WPC_FD
 SG_ CBV_RMR_WPC2_FD : 8|1@1+ (1,0) [0|0] ""  ARS_FD,ATS_FD,BLTN_CAM_FD,CGW_CCU,DCM_FD,FCS_FD,FLLR_FD,GW_PSU_3RD_FD,GW_PSU_AST_FD,GW_PSU_DRV_FD,GW_PSU_RL_FD,GW_PSU_RR_FD,GW_SAU_DRV_FD,OHCL_FD,PSB_FD,RCM_FD,RCS_FD,RWPC_FD,SCM_FD,SGU_FD,SHVU_3RD_FD,SHVU_CCS_FD,SHVU_FRNT_FD,SHVU_REAR_FD,SHVU_RL_FD,SHVU_RR_FD,WPC_FD
 SG_ CBV_NMCoID_WPC2_FD : 9|2@1+ (1,0) [0|0] ""  ARS_FD,ATS_FD,BLTN_CAM_FD,CGW_CCU,DCM_FD,FCS_FD,FLLR_FD,GW_PSU_3RD_FD,GW_PSU_AST_FD,GW_PSU_DRV_FD,GW_PSU_RL_FD,GW_PSU_RR_FD,GW_SAU_DRV_FD,OHCL_FD,PSB_FD,RCM_FD,RCS_FD,RWPC_FD,SCM_FD,SGU_FD,SHVU_3RD_FD,SHVU_CCS_FD,SHVU_FRNT_FD,SHVU_REAR_FD,SHVU_RL_FD,SHVU_RR_FD,WPC_FD
 SG_ CBV_NMCoSRB_WPC2_FD : 11|1@1+ (1,0) [0|0] ""  ARS_FD,ATS_FD,BLTN_CAM_FD,CGW_CCU,DCM_FD,FCS_FD,FLLR_FD,GW_PSU_3RD_FD,GW_PSU_AST_FD,GW_PSU_DRV_FD,GW_PSU_RL_FD,GW_PSU_RR_FD,GW_SAU_DRV_FD,OHCL_FD,PSB_FD,RCM_FD,RCS_FD,RWPC_FD,SCM_FD,SGU_FD,SHVU_3RD_FD,SHVU_CCS_FD,SHVU_FRNT_FD,SHVU_REAR_FD,SHVU_RL_FD,SHVU_RR_FD,WPC_FD
 SG_ CBV_AWB_WPC2_FD : 12|1@1+ (1,0) [0|0] ""  ARS_FD,ATS_FD,BLTN_CAM_FD,CGW_CCU,DCM_FD,FCS_FD,FLLR_FD,GW_PSU_3RD_FD,GW_PSU_AST_FD,GW_PSU_DRV_FD,GW_PSU_RL_FD,GW_PSU_RR_FD,GW_SAU_DRV_FD,OHCL_FD,PSB_FD,RCM_FD,RCS_FD,RWPC_FD,SCM_FD,SGU_FD,SHVU_3RD_FD,SHVU_CCS_FD,SHVU_FRNT_FD,SHVU_REAR_FD,SHVU_RL_FD,SHVU_RR_FD,WPC_FD
 SG_ CBV_PNIB_WPC2_FD : 14|1@1+ (1,0) [0|0] ""  ARS_FD,ATS_FD,BLTN_CAM_FD,CGW_CCU,DCM_FD,FCS_FD,FLLR_FD,GW_PSU_3RD_FD,GW_PSU_AST_FD,GW_PSU_DRV_FD,GW_PSU_RL_FD,GW_PSU_RR_FD,GW_SAU_DRV_FD,OHCL_FD,PSB_FD,RCM_FD,RCS_FD,RWPC_FD,SCM_FD,SGU_FD,SHVU_3RD_FD,SHVU_CCS_FD,SHVU_FRNT_FD,SHVU_REAR_FD,SHVU_RL_FD,SHVU_RR_FD,WPC_FD
 SG_ NRR_WPC2_FD : 16|8@1+ (1,0) [0|0] ""  ARS_FD,ATS_FD,BLTN_CAM_FD,CGW_CCU,DCM_FD,FCS_FD,FLLR_FD,GW_PSU_3RD_FD,GW_PSU_AST_FD,GW_PSU_DRV_FD,GW_PSU_RL_FD,GW_PSU_RR_FD,GW_SAU_DRV_FD,OHCL_FD,PSB_FD,RCM_FD,RCS_FD,RWPC_FD,SCM_FD,SGU_FD,SHVU_3RD_FD,SHVU_CCS_FD,SHVU_FRNT_FD,SHVU_REAR_FD,SHVU_RL_FD,SHVU_RR_FD,WPC_FD
 SG_ NM_State_WPC2_FD : 24|8@1+ (1,0) [0|0] ""  ARS_FD,ATS_FD,BLTN_CAM_FD,CGW_CCU,DCM_FD,FCS_FD,FLLR_FD,GW_PSU_3RD_FD,GW_PSU_AST_FD,GW_PSU_DRV_FD,GW_PSU_RL_FD,GW_PSU_RR_FD,GW_SAU_DRV_FD,OHCL_FD,PSB_FD,RCM_FD,RCS_FD,RWPC_FD,SCM_FD,SGU_FD,SHVU_3RD_FD,SHVU_CCS_FD,SHVU_FRNT_FD,SHVU_REAR_FD,SHVU_RL_FD,SHVU_RR_FD,WPC_FD
 SG_ PNI_WPC2_FD : 32|32@1+ (1,0) [0|0] ""  ARS_FD,ATS_FD,BLTN_CAM_FD,CGW_CCU,DCM_FD,FCS_FD,FLLR_FD,GW_PSU_3RD_FD,GW_PSU_AST_FD,GW_PSU_DRV_FD,GW_PSU_RL_FD,GW_PSU_RR_FD,GW_SAU_DRV_FD,OHCL_FD,PSB_FD,RCM_FD,RCS_FD,RWPC_FD,SCM_FD,SGU_FD,SHVU_3RD_FD,SHVU_CCS_FD,SHVU_FRNT_FD,SHVU_REAR_FD,SHVU_RL_FD,SHVU_RR_FD,WPC_FD
 SG_ PNI_WPC2_FD_1 : 64|64@1+ (1,0) [0|0] ""  ARS_FD,ATS_FD,BLTN_CAM_FD,CGW_CCU,DCM_FD,FCS_FD,FLLR_FD,GW_PSU_3RD_FD,GW_PSU_AST_FD,GW_PSU_DRV_FD,GW_PSU_RL_FD,GW_PSU_RR_FD,GW_SAU_DRV_FD,OHCL_FD,PSB_FD,RCM_FD,RCS_FD,RWPC_FD,SCM_FD,SGU_FD,SHVU_3RD_FD,SHVU_CCS_FD,SHVU_FRNT_FD,SHVU_REAR_FD,SHVU_RL_FD,SHVU_RR_FD,WPC_FD
 SG_ PNI_WPC2_FD_2 : 128|64@1+ (1,0) [0|0] ""  ARS_FD,ATS_FD,BLTN_CAM_FD,CGW_CCU,DCM_FD,FCS_FD,FLLR_FD,GW_PSU_3RD_FD,GW_PSU_AST_FD,GW_PSU_DRV_FD,GW_PSU_RL_FD,GW_PSU_RR_FD,GW_SAU_DRV_FD,OHCL_FD,PSB_FD,RCM_FD,RCS_FD,RWPC_FD,SCM_FD,SGU_FD,SHVU_3RD_FD,SHVU_CCS_FD,SHVU_FRNT_FD,SHVU_REAR_FD,SHVU_RL_FD,SHVU_RR_FD,WPC_FD
 SG_ PNI_WPC2_FD_3 : 192|64@1+ (1,0) [0|0] ""  ARS_FD,ATS_FD,BLTN_CAM_FD,CGW_CCU,DCM_FD,FCS_FD,FLLR_FD,GW_PSU_3RD_FD,GW_PSU_AST_FD,GW_PSU_DRV_FD,GW_PSU_RL_FD,GW_PSU_RR_FD,GW_SAU_DRV_FD,OHCL_FD,PSB_FD,RCM_FD,RCS_FD,RWPC_FD,SCM_FD,SGU_FD,SHVU_3RD_FD,SHVU_CCS_FD,SHVU_FRNT_FD,SHVU_REAR_FD,SHVU_RL_FD,SHVU_RR_FD,WPC_FD

BO_ 2549874823 NM_SCM_FD: 32 SCM_FD
 SG_ SNI_SCM_FD : 0|8@1+ (1,0) [0|0] ""  ARS_FD,ATS_FD,BLTN_CAM_FD,CGW_CCU,DCM_FD,FCS_FD,FLLR_FD,GW_PSU_3RD_FD,GW_PSU_AST_FD,GW_PSU_DRV_FD,GW_PSU_RL_FD,GW_PSU_RR_FD,GW_SAU_DRV_FD,OHCL_FD,PSB_FD,RCM_FD,RCS_FD,RWPC_FD,SGU_FD,SHVU_3RD_FD,SHVU_CCS_FD,SHVU_FRNT_FD,SHVU_REAR_FD,SHVU_RL_FD,SHVU_RR_FD,WPC2_FD,WPC_FD
 SG_ CBV_RMR_SCM_FD : 8|1@1+ (1,0) [0|0] ""  ARS_FD,ATS_FD,BLTN_CAM_FD,CGW_CCU,DCM_FD,FCS_FD,FLLR_FD,GW_PSU_3RD_FD,GW_PSU_AST_FD,GW_PSU_DRV_FD,GW_PSU_RL_FD,GW_PSU_RR_FD,GW_SAU_DRV_FD,OHCL_FD,PSB_FD,RCM_FD,RCS_FD,RWPC_FD,SGU_FD,SHVU_3RD_FD,SHVU_CCS_FD,SHVU_FRNT_FD,SHVU_REAR_FD,SHVU_RL_FD,SHVU_RR_FD,WPC2_FD,WPC_FD
 SG_ CBV_NMCoID_SCM_FD : 9|2@1+ (1,0) [0|0] ""  ARS_FD,ATS_FD,BLTN_CAM_FD,CGW_CCU,DCM_FD,FCS_FD,FLLR_FD,GW_PSU_3RD_FD,GW_PSU_AST_FD,GW_PSU_DRV_FD,GW_PSU_RL_FD,GW_PSU_RR_FD,GW_SAU_DRV_FD,OHCL_FD,PSB_FD,RCM_FD,RCS_FD,RWPC_FD,SGU_FD,SHVU_3RD_FD,SHVU_CCS_FD,SHVU_FRNT_FD,SHVU_REAR_FD,SHVU_RL_FD,SHVU_RR_FD,WPC2_FD,WPC_FD
 SG_ CBV_NMCoSRB_SCM_FD : 11|1@1+ (1,0) [0|0] ""  ARS_FD,ATS_FD,BLTN_CAM_FD,CGW_CCU,DCM_FD,FCS_FD,FLLR_FD,GW_PSU_3RD_FD,GW_PSU_AST_FD,GW_PSU_DRV_FD,GW_PSU_RL_FD,GW_PSU_RR_FD,GW_SAU_DRV_FD,OHCL_FD,PSB_FD,RCM_FD,RCS_FD,RWPC_FD,SGU_FD,SHVU_3RD_FD,SHVU_CCS_FD,SHVU_FRNT_FD,SHVU_REAR_FD,SHVU_RL_FD,SHVU_RR_FD,WPC2_FD,WPC_FD
 SG_ CBV_AWB_SCM_FD : 12|1@1+ (1,0) [0|0] ""  ARS_FD,ATS_FD,BLTN_CAM_FD,CGW_CCU,DCM_FD,FCS_FD,FLLR_FD,GW_PSU_3RD_FD,GW_PSU_AST_FD,GW_PSU_DRV_FD,GW_PSU_RL_FD,GW_PSU_RR_FD,GW_SAU_DRV_FD,OHCL_FD,PSB_FD,RCM_FD,RCS_FD,RWPC_FD,SGU_FD,SHVU_3RD_FD,SHVU_CCS_FD,SHVU_FRNT_FD,SHVU_REAR_FD,SHVU_RL_FD,SHVU_RR_FD,WPC2_FD,WPC_FD
 SG_ CBV_PNIB_SCM_FD : 14|1@1+ (1,0) [0|0] ""  ARS_FD,ATS_FD,BLTN_CAM_FD,CGW_CCU,DCM_FD,FCS_FD,FLLR_FD,GW_PSU_3RD_FD,GW_PSU_AST_FD,GW_PSU_DRV_FD,GW_PSU_RL_FD,GW_PSU_RR_FD,GW_SAU_DRV_FD,OHCL_FD,PSB_FD,RCM_FD,RCS_FD,RWPC_FD,SGU_FD,SHVU_3RD_FD,SHVU_CCS_FD,SHVU_FRNT_FD,SHVU_REAR_FD,SHVU_RL_FD,SHVU_RR_FD,WPC2_FD,WPC_FD
 SG_ NRR_SCM_FD : 16|8@1+ (1,0) [0|0] ""  ARS_FD,ATS_FD,BLTN_CAM_FD,CGW_CCU,DCM_FD,FCS_FD,FLLR_FD,GW_PSU_3RD_FD,GW_PSU_AST_FD,GW_PSU_DRV_FD,GW_PSU_RL_FD,GW_PSU_RR_FD,GW_SAU_DRV_FD,OHCL_FD,PSB_FD,RCM_FD,RCS_FD,RWPC_FD,SGU_FD,SHVU_3RD_FD,SHVU_CCS_FD,SHVU_FRNT_FD,SHVU_REAR_FD,SHVU_RL_FD,SHVU_RR_FD,WPC2_FD,WPC_FD
 SG_ NM_State_SCM_FD : 24|8@1+ (1,0) [0|0] ""  ARS_FD,ATS_FD,BLTN_CAM_FD,CGW_CCU,DCM_FD,FCS_FD,FLLR_FD,GW_PSU_3RD_FD,GW_PSU_AST_FD,GW_PSU_DRV_FD,GW_PSU_RL_FD,GW_PSU_RR_FD,GW_SAU_DRV_FD,OHCL_FD,PSB_FD,RCM_FD,RCS_FD,RWPC_FD,SGU_FD,SHVU_3RD_FD,SHVU_CCS_FD,SHVU_FRNT_FD,SHVU_REAR_FD,SHVU_RL_FD,SHVU_RR_FD,WPC2_FD,WPC_FD
 SG_ PNI_SCM_FD : 32|32@1+ (1,0) [0|0] ""  ARS_FD,ATS_FD,BLTN_CAM_FD,CGW_CCU,DCM_FD,FCS_FD,FLLR_FD,GW_PSU_3RD_FD,GW_PSU_AST_FD,GW_PSU_DRV_FD,GW_PSU_RL_FD,GW_PSU_RR_FD,GW_SAU_DRV_FD,OHCL_FD,PSB_FD,RCM_FD,RCS_FD,RWPC_FD,SGU_FD,SHVU_3RD_FD,SHVU_CCS_FD,SHVU_FRNT_FD,SHVU_REAR_FD,SHVU_RL_FD,SHVU_RR_FD,WPC2_FD,WPC_FD
 SG_ PNI_SCM_FD_1 : 64|64@1+ (1,0) [0|0] ""  ARS_FD,ATS_FD,BLTN_CAM_FD,CGW_CCU,DCM_FD,FCS_FD,FLLR_FD,GW_PSU_3RD_FD,GW_PSU_AST_FD,GW_PSU_DRV_FD,GW_PSU_RL_FD,GW_PSU_RR_FD,GW_SAU_DRV_FD,OHCL_FD,PSB_FD,RCM_FD,RCS_FD,RWPC_FD,SGU_FD,SHVU_3RD_FD,SHVU_CCS_FD,SHVU_FRNT_FD,SHVU_REAR_FD,SHVU_RL_FD,SHVU_RR_FD,WPC2_FD,WPC_FD
 SG_ PNI_SCM_FD_2 : 128|64@1+ (1,0) [0|0] ""  ARS_FD,ATS_FD,BLTN_CAM_FD,CGW_CCU,DCM_FD,FCS_FD,FLLR_FD,GW_PSU_3RD_FD,GW_PSU_AST_FD,GW_PSU_DRV_FD,GW_PSU_RL_FD,GW_PSU_RR_FD,GW_SAU_DRV_FD,OHCL_FD,PSB_FD,RCM_FD,RCS_FD,RWPC_FD,SGU_FD,SHVU_3RD_FD,SHVU_CCS_FD,SHVU_FRNT_FD,SHVU_REAR_FD,SHVU_RL_FD,SHVU_RR_FD,WPC2_FD,WPC_FD
 SG_ PNI_SCM_FD_3 : 192|64@1+ (1,0) [0|0] ""  ARS_FD,ATS_FD,BLTN_CAM_FD,CGW_CCU,DCM_FD,FCS_FD,FLLR_FD,GW_PSU_3RD_FD,GW_PSU_AST_FD,GW_PSU_DRV_FD,GW_PSU_RL_FD,GW_PSU_RR_FD,GW_SAU_DRV_FD,OHCL_FD,PSB_FD,RCM_FD,RCS_FD,RWPC_FD,SGU_FD,SHVU_3RD_FD,SHVU_CCS_FD,SHVU_FRNT_FD,SHVU_REAR_FD,SHVU_RL_FD,SHVU_RR_FD,WPC2_FD,WPC_FD

BO_ 2549874858 NM_SHVU_FRNT_FD: 32 SHVU_FRNT_FD
 SG_ SNI_SHVU_FRNT_FD : 0|8@1+ (1,0) [0|0] ""  ARS_FD,ATS_FD,BLTN_CAM_FD,CGW_CCU,DCM_FD,FCS_FD,FLLR_FD,GW_PSU_3RD_FD,GW_PSU_AST_FD,GW_PSU_DRV_FD,GW_PSU_RL_FD,GW_PSU_RR_FD,GW_SAU_DRV_FD,OHCL_FD,PSB_FD,RCM_FD,RCS_FD,RWPC_FD,SCM_FD,SGU_FD,SHVU_3RD_FD,SHVU_CCS_FD,SHVU_REAR_FD,SHVU_RL_FD,SHVU_RR_FD,WPC2_FD,WPC_FD
 SG_ CBV_RMR_SHVU_FRNT_FD : 8|1@1+ (1,0) [0|0] ""  ARS_FD,ATS_FD,BLTN_CAM_FD,CGW_CCU,DCM_FD,FCS_FD,FLLR_FD,GW_PSU_3RD_FD,GW_PSU_AST_FD,GW_PSU_DRV_FD,GW_PSU_RL_FD,GW_PSU_RR_FD,GW_SAU_DRV_FD,OHCL_FD,PSB_FD,RCM_FD,RCS_FD,RWPC_FD,SCM_FD,SGU_FD,SHVU_3RD_FD,SHVU_CCS_FD,SHVU_REAR_FD,SHVU_RL_FD,SHVU_RR_FD,WPC2_FD,WPC_FD
 SG_ CBV_NMCoID_SHVU_FRNT_FD : 9|2@1+ (1,0) [0|0] ""  ARS_FD,ATS_FD,BLTN_CAM_FD,CGW_CCU,DCM_FD,FCS_FD,FLLR_FD,GW_PSU_3RD_FD,GW_PSU_AST_FD,GW_PSU_DRV_FD,GW_PSU_RL_FD,GW_PSU_RR_FD,GW_SAU_DRV_FD,OHCL_FD,PSB_FD,RCM_FD,RCS_FD,RWPC_FD,SCM_FD,SGU_FD,SHVU_3RD_FD,SHVU_CCS_FD,SHVU_REAR_FD,SHVU_RL_FD,SHVU_RR_FD,WPC2_FD,WPC_FD
 SG_ CBV_NMCoSRB_SHVU_FRNT_FD : 11|1@1+ (1,0) [0|0] ""  ARS_FD,ATS_FD,BLTN_CAM_FD,CGW_CCU,DCM_FD,FCS_FD,FLLR_FD,GW_PSU_3RD_FD,GW_PSU_AST_FD,GW_PSU_DRV_FD,GW_PSU_RL_FD,GW_PSU_RR_FD,GW_SAU_DRV_FD,OHCL_FD,PSB_FD,RCM_FD,RCS_FD,RWPC_FD,SCM_FD,SGU_FD,SHVU_3RD_FD,SHVU_CCS_FD,SHVU_REAR_FD,SHVU_RL_FD,SHVU_RR_FD,WPC2_FD,WPC_FD
 SG_ CBV_AWB_SHVU_FRNT_FD : 12|1@1+ (1,0) [0|0] ""  ARS_FD,ATS_FD,BLTN_CAM_FD,CGW_CCU,DCM_FD,FCS_FD,FLLR_FD,GW_PSU_3RD_FD,GW_PSU_AST_FD,GW_PSU_DRV_FD,GW_PSU_RL_FD,GW_PSU_RR_FD,GW_SAU_DRV_FD,OHCL_FD,PSB_FD,RCM_FD,RCS_FD,RWPC_FD,SCM_FD,SGU_FD,SHVU_3RD_FD,SHVU_CCS_FD,SHVU_REAR_FD,SHVU_RL_FD,SHVU_RR_FD,WPC2_FD,WPC_FD
 SG_ CBV_PNIB_SHVU_FRNT_FD : 14|1@1+ (1,0) [0|0] ""  ARS_FD,ATS_FD,BLTN_CAM_FD,CGW_CCU,DCM_FD,FCS_FD,FLLR_FD,GW_PSU_3RD_FD,GW_PSU_AST_FD,GW_PSU_DRV_FD,GW_PSU_RL_FD,GW_PSU_RR_FD,GW_SAU_DRV_FD,OHCL_FD,PSB_FD,RCM_FD,RCS_FD,RWPC_FD,SCM_FD,SGU_FD,SHVU_3RD_FD,SHVU_CCS_FD,SHVU_REAR_FD,SHVU_RL_FD,SHVU_RR_FD,WPC2_FD,WPC_FD
 SG_ NRR_SHVU_FRNT_FD : 16|8@1+ (1,0) [0|0] ""  ARS_FD,ATS_FD,BLTN_CAM_FD,CGW_CCU,DCM_FD,FCS_FD,FLLR_FD,GW_PSU_3RD_FD,GW_PSU_AST_FD,GW_PSU_DRV_FD,GW_PSU_RL_FD,GW_PSU_RR_FD,GW_SAU_DRV_FD,OHCL_FD,PSB_FD,RCM_FD,RCS_FD,RWPC_FD,SCM_FD,SGU_FD,SHVU_3RD_FD,SHVU_CCS_FD,SHVU_REAR_FD,SHVU_RL_FD,SHVU_RR_FD,WPC2_FD,WPC_FD
 SG_ NM_State_SHVU_FRNT_FD : 24|8@1+ (1,0) [0|0] ""  ARS_FD,ATS_FD,BLTN_CAM_FD,CGW_CCU,DCM_FD,FCS_FD,FLLR_FD,GW_PSU_3RD_FD,GW_PSU_AST_FD,GW_PSU_DRV_FD,GW_PSU_RL_FD,GW_PSU_RR_FD,GW_SAU_DRV_FD,OHCL_FD,PSB_FD,RCM_FD,RCS_FD,RWPC_FD,SCM_FD,SGU_FD,SHVU_3RD_FD,SHVU_CCS_FD,SHVU_REAR_FD,SHVU_RL_FD,SHVU_RR_FD,WPC2_FD,WPC_FD
 SG_ PNI_SHVU_FRNT_FD : 32|32@1+ (1,0) [0|0] ""  ARS_FD,ATS_FD,BLTN_CAM_FD,CGW_CCU,DCM_FD,FCS_FD,FLLR_FD,GW_PSU_3RD_FD,GW_PSU_AST_FD,GW_PSU_DRV_FD,GW_PSU_RL_FD,GW_PSU_RR_FD,GW_SAU_DRV_FD,OHCL_FD,PSB_FD,RCM_FD,RCS_FD,RWPC_FD,SCM_FD,SGU_FD,SHVU_3RD_FD,SHVU_CCS_FD,SHVU_REAR_FD,SHVU_RL_FD,SHVU_RR_FD,WPC2_FD,WPC_FD
 SG_ PNI_SHVU_FRNT_FD_1 : 64|64@1+ (1,0) [0|0] ""  ARS_FD,ATS_FD,BLTN_CAM_FD,CGW_CCU,DCM_FD,FCS_FD,FLLR_FD,GW_PSU_3RD_FD,GW_PSU_AST_FD,GW_PSU_DRV_FD,GW_PSU_RL_FD,GW_PSU_RR_FD,GW_SAU_DRV_FD,OHCL_FD,PSB_FD,RCM_FD,RCS_FD,RWPC_FD,SCM_FD,SGU_FD,SHVU_3RD_FD,SHVU_CCS_FD,SHVU_REAR_FD,SHVU_RL_FD,SHVU_RR_FD,WPC2_FD,WPC_FD
 SG_ PNI_SHVU_FRNT_FD_2 : 128|64@1+ (1,0) [0|0] ""  ARS_FD,ATS_FD,BLTN_CAM_FD,CGW_CCU,DCM_FD,FCS_FD,FLLR_FD,GW_PSU_3RD_FD,GW_PSU_AST_FD,GW_PSU_DRV_FD,GW_PSU_RL_FD,GW_PSU_RR_FD,GW_SAU_DRV_FD,OHCL_FD,PSB_FD,RCM_FD,RCS_FD,RWPC_FD,SCM_FD,SGU_FD,SHVU_3RD_FD,SHVU_CCS_FD,SHVU_REAR_FD,SHVU_RL_FD,SHVU_RR_FD,WPC2_FD,WPC_FD
 SG_ PNI_SHVU_FRNT_FD_3 : 192|64@1+ (1,0) [0|0] ""  ARS_FD,ATS_FD,BLTN_CAM_FD,CGW_CCU,DCM_FD,FCS_FD,FLLR_FD,GW_PSU_3RD_FD,GW_PSU_AST_FD,GW_PSU_DRV_FD,GW_PSU_RL_FD,GW_PSU_RR_FD,GW_SAU_DRV_FD,OHCL_FD,PSB_FD,RCM_FD,RCS_FD,RWPC_FD,SCM_FD,SGU_FD,SHVU_3RD_FD,SHVU_CCS_FD,SHVU_REAR_FD,SHVU_RL_FD,SHVU_RR_FD,WPC2_FD,WPC_FD

BO_ 2549874750 NM_FLLR_FD: 32 FLLR_FD
 SG_ SNI_FLLR_FD : 0|8@1+ (1,0) [0|0] ""  ARS_FD,ATS_FD,BLTN_CAM_FD,CGW_CCU,DCM_FD,FCS_FD,GW_PSU_3RD_FD,GW_PSU_AST_FD,GW_PSU_DRV_FD,GW_PSU_RL_FD,GW_PSU_RR_FD,GW_SAU_DRV_FD,OHCL_FD,PSB_FD,RCM_FD,RCS_FD,RWPC_FD,SCM_FD,SGU_FD,SHVU_3RD_FD,SHVU_CCS_FD,SHVU_FRNT_FD,SHVU_REAR_FD,SHVU_RL_FD,SHVU_RR_FD,WPC2_FD,WPC_FD
 SG_ CBV_RMR_FLLR_FD : 8|1@1+ (1,0) [0|0] ""  ARS_FD,ATS_FD,BLTN_CAM_FD,CGW_CCU,DCM_FD,FCS_FD,GW_PSU_3RD_FD,GW_PSU_AST_FD,GW_PSU_DRV_FD,GW_PSU_RL_FD,GW_PSU_RR_FD,GW_SAU_DRV_FD,OHCL_FD,PSB_FD,RCM_FD,RCS_FD,RWPC_FD,SCM_FD,SGU_FD,SHVU_3RD_FD,SHVU_CCS_FD,SHVU_FRNT_FD,SHVU_REAR_FD,SHVU_RL_FD,SHVU_RR_FD,WPC2_FD,WPC_FD
 SG_ CBV_NMCoID_FLLR_FD : 9|2@1+ (1,0) [0|0] ""  ARS_FD,ATS_FD,BLTN_CAM_FD,CGW_CCU,DCM_FD,FCS_FD,GW_PSU_3RD_FD,GW_PSU_AST_FD,GW_PSU_DRV_FD,GW_PSU_RL_FD,GW_PSU_RR_FD,GW_SAU_DRV_FD,OHCL_FD,PSB_FD,RCM_FD,RCS_FD,RWPC_FD,SCM_FD,SGU_FD,SHVU_3RD_FD,SHVU_CCS_FD,SHVU_FRNT_FD,SHVU_REAR_FD,SHVU_RL_FD,SHVU_RR_FD,WPC2_FD,WPC_FD
 SG_ CBV_NMCoSRB_FLLR_FD : 11|1@1+ (1,0) [0|0] ""  ARS_FD,ATS_FD,BLTN_CAM_FD,CGW_CCU,DCM_FD,FCS_FD,GW_PSU_3RD_FD,GW_PSU_AST_FD,GW_PSU_DRV_FD,GW_PSU_RL_FD,GW_PSU_RR_FD,GW_SAU_DRV_FD,OHCL_FD,PSB_FD,RCM_FD,RCS_FD,RWPC_FD,SCM_FD,SGU_FD,SHVU_3RD_FD,SHVU_CCS_FD,SHVU_FRNT_FD,SHVU_REAR_FD,SHVU_RL_FD,SHVU_RR_FD,WPC2_FD,WPC_FD
 SG_ CBV_AWB_FLLR_FD : 12|1@1+ (1,0) [0|0] ""  ARS_FD,ATS_FD,BLTN_CAM_FD,CGW_CCU,DCM_FD,FCS_FD,GW_PSU_3RD_FD,GW_PSU_AST_FD,GW_PSU_DRV_FD,GW_PSU_RL_FD,GW_PSU_RR_FD,GW_SAU_DRV_FD,OHCL_FD,PSB_FD,RCM_FD,RCS_FD,RWPC_FD,SCM_FD,SGU_FD,SHVU_3RD_FD,SHVU_CCS_FD,SHVU_FRNT_FD,SHVU_REAR_FD,SHVU_RL_FD,SHVU_RR_FD,WPC2_FD,WPC_FD
 SG_ CBV_PNIB_FLLR_FD : 14|1@1+ (1,0) [0|0] ""  ARS_FD,ATS_FD,BLTN_CAM_FD,CGW_CCU,DCM_FD,FCS_FD,GW_PSU_3RD_FD,GW_PSU_AST_FD,GW_PSU_DRV_FD,GW_PSU_RL_FD,GW_PSU_RR_FD,GW_SAU_DRV_FD,OHCL_FD,PSB_FD,RCM_FD,RCS_FD,RWPC_FD,SCM_FD,SGU_FD,SHVU_3RD_FD,SHVU_CCS_FD,SHVU_FRNT_FD,SHVU_REAR_FD,SHVU_RL_FD,SHVU_RR_FD,WPC2_FD,WPC_FD
 SG_ NRR_FLLR_FD : 16|8@1+ (1,0) [0|0] ""  ARS_FD,ATS_FD,BLTN_CAM_FD,CGW_CCU,DCM_FD,FCS_FD,GW_PSU_3RD_FD,GW_PSU_AST_FD,GW_PSU_DRV_FD,GW_PSU_RL_FD,GW_PSU_RR_FD,GW_SAU_DRV_FD,OHCL_FD,PSB_FD,RCM_FD,RCS_FD,RWPC_FD,SCM_FD,SGU_FD,SHVU_3RD_FD,SHVU_CCS_FD,SHVU_FRNT_FD,SHVU_REAR_FD,SHVU_RL_FD,SHVU_RR_FD,WPC2_FD,WPC_FD
 SG_ NM_State_FLLR_FD : 24|8@1+ (1,0) [0|0] ""  ARS_FD,ATS_FD,BLTN_CAM_FD,CGW_CCU,DCM_FD,FCS_FD,GW_PSU_3RD_FD,GW_PSU_AST_FD,GW_PSU_DRV_FD,GW_PSU_RL_FD,GW_PSU_RR_FD,GW_SAU_DRV_FD,OHCL_FD,PSB_FD,RCM_FD,RCS_FD,RWPC_FD,SCM_FD,SGU_FD,SHVU_3RD_FD,SHVU_CCS_FD,SHVU_FRNT_FD,SHVU_REAR_FD,SHVU_RL_FD,SHVU_RR_FD,WPC2_FD,WPC_FD
 SG_ PNI_FLLR_FD : 32|32@1+ (1,0) [0|0] ""  ARS_FD,ATS_FD,BLTN_CAM_FD,CGW_CCU,DCM_FD,FCS_FD,GW_PSU_3RD_FD,GW_PSU_AST_FD,GW_PSU_DRV_FD,GW_PSU_RL_FD,GW_PSU_RR_FD,GW_SAU_DRV_FD,OHCL_FD,PSB_FD,RCM_FD,RCS_FD,RWPC_FD,SCM_FD,SGU_FD,SHVU_3RD_FD,SHVU_CCS_FD,SHVU_FRNT_FD,SHVU_REAR_FD,SHVU_RL_FD,SHVU_RR_FD,WPC2_FD,WPC_FD
 SG_ PNI_FLLR_FD_1 : 64|64@1+ (1,0) [0|0] ""  ARS_FD,ATS_FD,BLTN_CAM_FD,CGW_CCU,DCM_FD,FCS_FD,GW_PSU_3RD_FD,GW_PSU_AST_FD,GW_PSU_DRV_FD,GW_PSU_RL_FD,GW_PSU_RR_FD,GW_SAU_DRV_FD,OHCL_FD,PSB_FD,RCM_FD,RCS_FD,RWPC_FD,SCM_FD,SGU_FD,SHVU_3RD_FD,SHVU_CCS_FD,SHVU_FRNT_FD,SHVU_REAR_FD,SHVU_RL_FD,SHVU_RR_FD,WPC2_FD,WPC_FD
 SG_ PNI_FLLR_FD_2 : 128|64@1+ (1,0) [0|0] ""  ARS_FD,ATS_FD,BLTN_CAM_FD,CGW_CCU,DCM_FD,FCS_FD,GW_PSU_3RD_FD,GW_PSU_AST_FD,GW_PSU_DRV_FD,GW_PSU_RL_FD,GW_PSU_RR_FD,GW_SAU_DRV_FD,OHCL_FD,PSB_FD,RCM_FD,RCS_FD,RWPC_FD,SCM_FD,SGU_FD,SHVU_3RD_FD,SHVU_CCS_FD,SHVU_FRNT_FD,SHVU_REAR_FD,SHVU_RL_FD,SHVU_RR_FD,WPC2_FD,WPC_FD
 SG_ PNI_FLLR_FD_3 : 192|64@1+ (1,0) [0|0] ""  ARS_FD,ATS_FD,BLTN_CAM_FD,CGW_CCU,DCM_FD,FCS_FD,GW_PSU_3RD_FD,GW_PSU_AST_FD,GW_PSU_DRV_FD,GW_PSU_RL_FD,GW_PSU_RR_FD,GW_SAU_DRV_FD,OHCL_FD,PSB_FD,RCM_FD,RCS_FD,RWPC_FD,SCM_FD,SGU_FD,SHVU_3RD_FD,SHVU_CCS_FD,SHVU_FRNT_FD,SHVU_REAR_FD,SHVU_RL_FD,SHVU_RR_FD,WPC2_FD,WPC_FD

BO_ 2549874905 NM_GW_SAU_DRV_FD: 32 GW_SAU_DRV_FD
 SG_ SNI_GW_SAU_DRV_FD : 0|8@1+ (1,0) [0|0] ""  ARS_FD,ATS_FD,BLTN_CAM_FD,CGW_CCU,DCM_FD,FCS_FD,FLLR_FD,GW_PSU_3RD_FD,GW_PSU_AST_FD,GW_PSU_DRV_FD,GW_PSU_RL_FD,GW_PSU_RR_FD,OHCL_FD,PSB_FD,RCM_FD,RCS_FD,RWPC_FD,SCM_FD,SGU_FD,SHVU_3RD_FD,SHVU_CCS_FD,SHVU_FRNT_FD,SHVU_REAR_FD,SHVU_RL_FD,SHVU_RR_FD,WPC2_FD,WPC_FD
 SG_ CBV_RMR_GW_SAU_DRV_FD : 8|1@1+ (1,0) [0|0] ""  ARS_FD,ATS_FD,BLTN_CAM_FD,CGW_CCU,DCM_FD,FCS_FD,FLLR_FD,GW_PSU_3RD_FD,GW_PSU_AST_FD,GW_PSU_DRV_FD,GW_PSU_RL_FD,GW_PSU_RR_FD,OHCL_FD,PSB_FD,RCM_FD,RCS_FD,RWPC_FD,SCM_FD,SGU_FD,SHVU_3RD_FD,SHVU_CCS_FD,SHVU_FRNT_FD,SHVU_REAR_FD,SHVU_RL_FD,SHVU_RR_FD,WPC2_FD,WPC_FD
 SG_ CBV_NMCoID_GW_SAU_DRV_FD : 9|2@1+ (1,0) [0|0] ""  ARS_FD,ATS_FD,BLTN_CAM_FD,CGW_CCU,DCM_FD,FCS_FD,FLLR_FD,GW_PSU_3RD_FD,GW_PSU_AST_FD,GW_PSU_DRV_FD,GW_PSU_RL_FD,GW_PSU_RR_FD,OHCL_FD,PSB_FD,RCM_FD,RCS_FD,RWPC_FD,SCM_FD,SGU_FD,SHVU_3RD_FD,SHVU_CCS_FD,SHVU_FRNT_FD,SHVU_REAR_FD,SHVU_RL_FD,SHVU_RR_FD,WPC2_FD,WPC_FD
 SG_ CBV_NMCoSRB_GW_SAU_DRV_FD : 11|1@1+ (1,0) [0|0] ""  ARS_FD,ATS_FD,BLTN_CAM_FD,CGW_CCU,DCM_FD,FCS_FD,FLLR_FD,GW_PSU_3RD_FD,GW_PSU_AST_FD,GW_PSU_DRV_FD,GW_PSU_RL_FD,GW_PSU_RR_FD,OHCL_FD,PSB_FD,RCM_FD,RCS_FD,RWPC_FD,SCM_FD,SGU_FD,SHVU_3RD_FD,SHVU_CCS_FD,SHVU_FRNT_FD,SHVU_REAR_FD,SHVU_RL_FD,SHVU_RR_FD,WPC2_FD,WPC_FD
 SG_ CBV_AWB_GW_SAU_DRV_FD : 12|1@1+ (1,0) [0|0] ""  ARS_FD,ATS_FD,BLTN_CAM_FD,CGW_CCU,DCM_FD,FCS_FD,FLLR_FD,GW_PSU_3RD_FD,GW_PSU_AST_FD,GW_PSU_DRV_FD,GW_PSU_RL_FD,GW_PSU_RR_FD,OHCL_FD,PSB_FD,RCM_FD,RCS_FD,RWPC_FD,SCM_FD,SGU_FD,SHVU_3RD_FD,SHVU_CCS_FD,SHVU_FRNT_FD,SHVU_REAR_FD,SHVU_RL_FD,SHVU_RR_FD,WPC2_FD,WPC_FD
 SG_ CBV_PNIB_GW_SAU_DRV_FD : 14|1@1+ (1,0) [0|0] ""  ARS_FD,ATS_FD,BLTN_CAM_FD,CGW_CCU,DCM_FD,FCS_FD,FLLR_FD,GW_PSU_3RD_FD,GW_PSU_AST_FD,GW_PSU_DRV_FD,GW_PSU_RL_FD,GW_PSU_RR_FD,OHCL_FD,PSB_FD,RCM_FD,RCS_FD,RWPC_FD,SCM_FD,SGU_FD,SHVU_3RD_FD,SHVU_CCS_FD,SHVU_FRNT_FD,SHVU_REAR_FD,SHVU_RL_FD,SHVU_RR_FD,WPC2_FD,WPC_FD
 SG_ NRR_GW_SAU_DRV_FD : 16|8@1+ (1,0) [0|0] ""  ARS_FD,ATS_FD,BLTN_CAM_FD,CGW_CCU,DCM_FD,FCS_FD,FLLR_FD,GW_PSU_3RD_FD,GW_PSU_AST_FD,GW_PSU_DRV_FD,GW_PSU_RL_FD,GW_PSU_RR_FD,OHCL_FD,PSB_FD,RCM_FD,RCS_FD,RWPC_FD,SCM_FD,SGU_FD,SHVU_3RD_FD,SHVU_CCS_FD,SHVU_FRNT_FD,SHVU_REAR_FD,SHVU_RL_FD,SHVU_RR_FD,WPC2_FD,WPC_FD
 SG_ NM_State_GW_SAU_DRV_FD : 24|8@1+ (1,0) [0|0] ""  ARS_FD,ATS_FD,BLTN_CAM_FD,CGW_CCU,DCM_FD,FCS_FD,FLLR_FD,GW_PSU_3RD_FD,GW_PSU_AST_FD,GW_PSU_DRV_FD,GW_PSU_RL_FD,GW_PSU_RR_FD,OHCL_FD,PSB_FD,RCM_FD,RCS_FD,RWPC_FD,SCM_FD,SGU_FD,SHVU_3RD_FD,SHVU_CCS_FD,SHVU_FRNT_FD,SHVU_REAR_FD,SHVU_RL_FD,SHVU_RR_FD,WPC2_FD,WPC_FD
 SG_ PNI_GW_SAU_DRV_FD : 32|32@1+ (1,0) [0|0] ""  ARS_FD,ATS_FD,BLTN_CAM_FD,CGW_CCU,DCM_FD,FCS_FD,FLLR_FD,GW_PSU_3RD_FD,GW_PSU_AST_FD,GW_PSU_DRV_FD,GW_PSU_RL_FD,GW_PSU_RR_FD,OHCL_FD,PSB_FD,RCM_FD,RCS_FD,RWPC_FD,SCM_FD,SGU_FD,SHVU_3RD_FD,SHVU_CCS_FD,SHVU_FRNT_FD,SHVU_REAR_FD,SHVU_RL_FD,SHVU_RR_FD,WPC2_FD,WPC_FD
 SG_ PNI_GW_SAU_DRV_FD_1 : 64|64@1+ (1,0) [0|0] ""  ARS_FD,ATS_FD,BLTN_CAM_FD,CGW_CCU,DCM_FD,FCS_FD,FLLR_FD,GW_PSU_3RD_FD,GW_PSU_AST_FD,GW_PSU_DRV_FD,GW_PSU_RL_FD,GW_PSU_RR_FD,OHCL_FD,PSB_FD,RCM_FD,RCS_FD,RWPC_FD,SCM_FD,SGU_FD,SHVU_3RD_FD,SHVU_CCS_FD,SHVU_FRNT_FD,SHVU_REAR_FD,SHVU_RL_FD,SHVU_RR_FD,WPC2_FD,WPC_FD
 SG_ PNI_GW_SAU_DRV_FD_2 : 128|64@1+ (1,0) [0|0] ""  ARS_FD,ATS_FD,BLTN_CAM_FD,CGW_CCU,DCM_FD,FCS_FD,FLLR_FD,GW_PSU_3RD_FD,GW_PSU_AST_FD,GW_PSU_DRV_FD,GW_PSU_RL_FD,GW_PSU_RR_FD,OHCL_FD,PSB_FD,RCM_FD,RCS_FD,RWPC_FD,SCM_FD,SGU_FD,SHVU_3RD_FD,SHVU_CCS_FD,SHVU_FRNT_FD,SHVU_REAR_FD,SHVU_RL_FD,SHVU_RR_FD,WPC2_FD,WPC_FD
 SG_ PNI_GW_SAU_DRV_FD_3 : 192|64@1+ (1,0) [0|0] ""  ARS_FD,ATS_FD,BLTN_CAM_FD,CGW_CCU,DCM_FD,FCS_FD,FLLR_FD,GW_PSU_3RD_FD,GW_PSU_AST_FD,GW_PSU_DRV_FD,GW_PSU_RL_FD,GW_PSU_RR_FD,OHCL_FD,PSB_FD,RCM_FD,RCS_FD,RWPC_FD,SCM_FD,SGU_FD,SHVU_3RD_FD,SHVU_CCS_FD,SHVU_FRNT_FD,SHVU_REAR_FD,SHVU_RL_FD,SHVU_RR_FD,WPC2_FD,WPC_FD

BO_ 2549874896 NM_ATS_FD: 32 ATS_FD
 SG_ SNI_ATS_FD : 0|8@1+ (1,0) [0|0] ""  ARS_FD,BLTN_CAM_FD,CGW_CCU,DCM_FD,FCS_FD,FLLR_FD,GW_PSU_3RD_FD,GW_PSU_AST_FD,GW_PSU_DRV_FD,GW_PSU_RL_FD,GW_PSU_RR_FD,GW_SAU_DRV_FD,OHCL_FD,PSB_FD,RCM_FD,RCS_FD,RWPC_FD,SCM_FD,SGU_FD,SHVU_3RD_FD,SHVU_CCS_FD,SHVU_FRNT_FD,SHVU_REAR_FD,SHVU_RL_FD,SHVU_RR_FD,WPC2_FD,WPC_FD
 SG_ CBV_RMR_ATS_FD : 8|1@1+ (1,0) [0|0] ""  ARS_FD,BLTN_CAM_FD,CGW_CCU,DCM_FD,FCS_FD,FLLR_FD,GW_PSU_3RD_FD,GW_PSU_AST_FD,GW_PSU_DRV_FD,GW_PSU_RL_FD,GW_PSU_RR_FD,GW_SAU_DRV_FD,OHCL_FD,PSB_FD,RCM_FD,RCS_FD,RWPC_FD,SCM_FD,SGU_FD,SHVU_3RD_FD,SHVU_CCS_FD,SHVU_FRNT_FD,SHVU_REAR_FD,SHVU_RL_FD,SHVU_RR_FD,WPC2_FD,WPC_FD
 SG_ CBV_NMCoID_ATS_FD : 9|2@1+ (1,0) [0|0] ""  ARS_FD,BLTN_CAM_FD,CGW_CCU,DCM_FD,FCS_FD,FLLR_FD,GW_PSU_3RD_FD,GW_PSU_AST_FD,GW_PSU_DRV_FD,GW_PSU_RL_FD,GW_PSU_RR_FD,GW_SAU_DRV_FD,OHCL_FD,PSB_FD,RCM_FD,RCS_FD,RWPC_FD,SCM_FD,SGU_FD,SHVU_3RD_FD,SHVU_CCS_FD,SHVU_FRNT_FD,SHVU_REAR_FD,SHVU_RL_FD,SHVU_RR_FD,WPC2_FD,WPC_FD
 SG_ CBV_NMCoSRB_ATS_FD : 11|1@1+ (1,0) [0|0] ""  ARS_FD,BLTN_CAM_FD,CGW_CCU,DCM_FD,FCS_FD,FLLR_FD,GW_PSU_3RD_FD,GW_PSU_AST_FD,GW_PSU_DRV_FD,GW_PSU_RL_FD,GW_PSU_RR_FD,GW_SAU_DRV_FD,OHCL_FD,PSB_FD,RCM_FD,RCS_FD,RWPC_FD,SCM_FD,SGU_FD,SHVU_3RD_FD,SHVU_CCS_FD,SHVU_FRNT_FD,SHVU_REAR_FD,SHVU_RL_FD,SHVU_RR_FD,WPC2_FD,WPC_FD
 SG_ CBV_AWB_ATS_FD : 12|1@1+ (1,0) [0|0] ""  ARS_FD,BLTN_CAM_FD,CGW_CCU,DCM_FD,FCS_FD,FLLR_FD,GW_PSU_3RD_FD,GW_PSU_AST_FD,GW_PSU_DRV_FD,GW_PSU_RL_FD,GW_PSU_RR_FD,GW_SAU_DRV_FD,OHCL_FD,PSB_FD,RCM_FD,RCS_FD,RWPC_FD,SCM_FD,SGU_FD,SHVU_3RD_FD,SHVU_CCS_FD,SHVU_FRNT_FD,SHVU_REAR_FD,SHVU_RL_FD,SHVU_RR_FD,WPC2_FD,WPC_FD
 SG_ CBV_PNIB_ATS_FD : 14|1@1+ (1,0) [0|0] ""  ARS_FD,BLTN_CAM_FD,CGW_CCU,DCM_FD,FCS_FD,FLLR_FD,GW_PSU_3RD_FD,GW_PSU_AST_FD,GW_PSU_DRV_FD,GW_PSU_RL_FD,GW_PSU_RR_FD,GW_SAU_DRV_FD,OHCL_FD,PSB_FD,RCM_FD,RCS_FD,RWPC_FD,SCM_FD,SGU_FD,SHVU_3RD_FD,SHVU_CCS_FD,SHVU_FRNT_FD,SHVU_REAR_FD,SHVU_RL_FD,SHVU_RR_FD,WPC2_FD,WPC_FD
 SG_ NRR_ATS_FD : 16|8@1+ (1,0) [0|0] ""  ARS_FD,BLTN_CAM_FD,CGW_CCU,DCM_FD,FCS_FD,FLLR_FD,GW_PSU_3RD_FD,GW_PSU_AST_FD,GW_PSU_DRV_FD,GW_PSU_RL_FD,GW_PSU_RR_FD,GW_SAU_DRV_FD,OHCL_FD,PSB_FD,RCM_FD,RCS_FD,RWPC_FD,SCM_FD,SGU_FD,SHVU_3RD_FD,SHVU_CCS_FD,SHVU_FRNT_FD,SHVU_REAR_FD,SHVU_RL_FD,SHVU_RR_FD,WPC2_FD,WPC_FD
 SG_ NM_State_ATS_FD : 24|8@1+ (1,0) [0|0] ""  ARS_FD,BLTN_CAM_FD,CGW_CCU,DCM_FD,FCS_FD,FLLR_FD,GW_PSU_3RD_FD,GW_PSU_AST_FD,GW_PSU_DRV_FD,GW_PSU_RL_FD,GW_PSU_RR_FD,GW_SAU_DRV_FD,OHCL_FD,PSB_FD,RCM_FD,RCS_FD,RWPC_FD,SCM_FD,SGU_FD,SHVU_3RD_FD,SHVU_CCS_FD,SHVU_FRNT_FD,SHVU_REAR_FD,SHVU_RL_FD,SHVU_RR_FD,WPC2_FD,WPC_FD
 SG_ PNI_ATS_FD : 32|32@1+ (1,0) [0|0] ""  ARS_FD,BLTN_CAM_FD,CGW_CCU,DCM_FD,FCS_FD,FLLR_FD,GW_PSU_3RD_FD,GW_PSU_AST_FD,GW_PSU_DRV_FD,GW_PSU_RL_FD,GW_PSU_RR_FD,GW_SAU_DRV_FD,OHCL_FD,PSB_FD,RCM_FD,RCS_FD,RWPC_FD,SCM_FD,SGU_FD,SHVU_3RD_FD,SHVU_CCS_FD,SHVU_FRNT_FD,SHVU_REAR_FD,SHVU_RL_FD,SHVU_RR_FD,WPC2_FD,WPC_FD
 SG_ PNI_ATS_FD_1 : 64|64@1+ (1,0) [0|0] ""  ARS_FD,BLTN_CAM_FD,CGW_CCU,DCM_FD,FCS_FD,FLLR_FD,GW_PSU_3RD_FD,GW_PSU_AST_FD,GW_PSU_DRV_FD,GW_PSU_RL_FD,GW_PSU_RR_FD,GW_SAU_DRV_FD,OHCL_FD,PSB_FD,RCM_FD,RCS_FD,RWPC_FD,SCM_FD,SGU_FD,SHVU_3RD_FD,SHVU_CCS_FD,SHVU_FRNT_FD,SHVU_REAR_FD,SHVU_RL_FD,SHVU_RR_FD,WPC2_FD,WPC_FD
 SG_ PNI_ATS_FD_2 : 128|64@1+ (1,0) [0|0] ""  ARS_FD,BLTN_CAM_FD,CGW_CCU,DCM_FD,FCS_FD,FLLR_FD,GW_PSU_3RD_FD,GW_PSU_AST_FD,GW_PSU_DRV_FD,GW_PSU_RL_FD,GW_PSU_RR_FD,GW_SAU_DRV_FD,OHCL_FD,PSB_FD,RCM_FD,RCS_FD,RWPC_FD,SCM_FD,SGU_FD,SHVU_3RD_FD,SHVU_CCS_FD,SHVU_FRNT_FD,SHVU_REAR_FD,SHVU_RL_FD,SHVU_RR_FD,WPC2_FD,WPC_FD
 SG_ PNI_ATS_FD_3 : 192|64@1+ (1,0) [0|0] ""  ARS_FD,BLTN_CAM_FD,CGW_CCU,DCM_FD,FCS_FD,FLLR_FD,GW_PSU_3RD_FD,GW_PSU_AST_FD,GW_PSU_DRV_FD,GW_PSU_RL_FD,GW_PSU_RR_FD,GW_SAU_DRV_FD,OHCL_FD,PSB_FD,RCM_FD,RCS_FD,RWPC_FD,SCM_FD,SGU_FD,SHVU_3RD_FD,SHVU_CCS_FD,SHVU_FRNT_FD,SHVU_REAR_FD,SHVU_RL_FD,SHVU_RR_FD,WPC2_FD,WPC_FD

BO_ 2549874881 NM_PSB_FD: 32 PSB_FD
 SG_ SNI_PSB_FD : 0|8@1+ (1,0) [0|0] ""  ARS_FD,ATS_FD,BLTN_CAM_FD,CGW_CCU,DCM_FD,FCS_FD,FLLR_FD,GW_PSU_3RD_FD,GW_PSU_AST_FD,GW_PSU_DRV_FD,GW_PSU_RL_FD,GW_PSU_RR_FD,GW_SAU_DRV_FD,OHCL_FD,RCM_FD,RCS_FD,RWPC_FD,SCM_FD,SGU_FD,SHVU_3RD_FD,SHVU_CCS_FD,SHVU_FRNT_FD,SHVU_REAR_FD,SHVU_RL_FD,SHVU_RR_FD,WPC2_FD,WPC_FD
 SG_ CBV_RMR_PSB_FD : 8|1@1+ (1,0) [0|0] ""  ARS_FD,ATS_FD,BLTN_CAM_FD,CGW_CCU,DCM_FD,FCS_FD,FLLR_FD,GW_PSU_3RD_FD,GW_PSU_AST_FD,GW_PSU_DRV_FD,GW_PSU_RL_FD,GW_PSU_RR_FD,GW_SAU_DRV_FD,OHCL_FD,RCM_FD,RCS_FD,RWPC_FD,SCM_FD,SGU_FD,SHVU_3RD_FD,SHVU_CCS_FD,SHVU_FRNT_FD,SHVU_REAR_FD,SHVU_RL_FD,SHVU_RR_FD,WPC2_FD,WPC_FD
 SG_ CBV_NMCoID_PSB_FD : 9|2@1+ (1,0) [0|0] ""  ARS_FD,ATS_FD,BLTN_CAM_FD,CGW_CCU,DCM_FD,FCS_FD,FLLR_FD,GW_PSU_3RD_FD,GW_PSU_AST_FD,GW_PSU_DRV_FD,GW_PSU_RL_FD,GW_PSU_RR_FD,GW_SAU_DRV_FD,OHCL_FD,RCM_FD,RCS_FD,RWPC_FD,SCM_FD,SGU_FD,SHVU_3RD_FD,SHVU_CCS_FD,SHVU_FRNT_FD,SHVU_REAR_FD,SHVU_RL_FD,SHVU_RR_FD,WPC2_FD,WPC_FD
 SG_ CBV_NMCoSRB_PSB_FD : 11|1@1+ (1,0) [0|0] ""  ARS_FD,ATS_FD,BLTN_CAM_FD,CGW_CCU,DCM_FD,FCS_FD,FLLR_FD,GW_PSU_3RD_FD,GW_PSU_AST_FD,GW_PSU_DRV_FD,GW_PSU_RL_FD,GW_PSU_RR_FD,GW_SAU_DRV_FD,OHCL_FD,RCM_FD,RCS_FD,RWPC_FD,SCM_FD,SGU_FD,SHVU_3RD_FD,SHVU_CCS_FD,SHVU_FRNT_FD,SHVU_REAR_FD,SHVU_RL_FD,SHVU_RR_FD,WPC2_FD,WPC_FD
 SG_ CBV_AWB_PSB_FD : 12|1@1+ (1,0) [0|0] ""  ARS_FD,ATS_FD,BLTN_CAM_FD,CGW_CCU,DCM_FD,FCS_FD,FLLR_FD,GW_PSU_3RD_FD,GW_PSU_AST_FD,GW_PSU_DRV_FD,GW_PSU_RL_FD,GW_PSU_RR_FD,GW_SAU_DRV_FD,OHCL_FD,RCM_FD,RCS_FD,RWPC_FD,SCM_FD,SGU_FD,SHVU_3RD_FD,SHVU_CCS_FD,SHVU_FRNT_FD,SHVU_REAR_FD,SHVU_RL_FD,SHVU_RR_FD,WPC2_FD,WPC_FD
 SG_ CBV_PNIB_PSB_FD : 14|1@1+ (1,0) [0|0] ""  ARS_FD,ATS_FD,BLTN_CAM_FD,CGW_CCU,DCM_FD,FCS_FD,FLLR_FD,GW_PSU_3RD_FD,GW_PSU_AST_FD,GW_PSU_DRV_FD,GW_PSU_RL_FD,GW_PSU_RR_FD,GW_SAU_DRV_FD,OHCL_FD,RCM_FD,RCS_FD,RWPC_FD,SCM_FD,SGU_FD,SHVU_3RD_FD,SHVU_CCS_FD,SHVU_FRNT_FD,SHVU_REAR_FD,SHVU_RL_FD,SHVU_RR_FD,WPC2_FD,WPC_FD
 SG_ NRR_PSB_FD : 16|8@1+ (1,0) [0|0] ""  ARS_FD,ATS_FD,BLTN_CAM_FD,CGW_CCU,DCM_FD,FCS_FD,FLLR_FD,GW_PSU_3RD_FD,GW_PSU_AST_FD,GW_PSU_DRV_FD,GW_PSU_RL_FD,GW_PSU_RR_FD,GW_SAU_DRV_FD,OHCL_FD,RCM_FD,RCS_FD,RWPC_FD,SCM_FD,SGU_FD,SHVU_3RD_FD,SHVU_CCS_FD,SHVU_FRNT_FD,SHVU_REAR_FD,SHVU_RL_FD,SHVU_RR_FD,WPC2_FD,WPC_FD
 SG_ NM_State_PSB_FD : 24|8@1+ (1,0) [0|0] ""  ARS_FD,ATS_FD,BLTN_CAM_FD,CGW_CCU,DCM_FD,FCS_FD,FLLR_FD,GW_PSU_3RD_FD,GW_PSU_AST_FD,GW_PSU_DRV_FD,GW_PSU_RL_FD,GW_PSU_RR_FD,GW_SAU_DRV_FD,OHCL_FD,RCM_FD,RCS_FD,RWPC_FD,SCM_FD,SGU_FD,SHVU_3RD_FD,SHVU_CCS_FD,SHVU_FRNT_FD,SHVU_REAR_FD,SHVU_RL_FD,SHVU_RR_FD,WPC2_FD,WPC_FD
 SG_ PNI_PSB_FD : 32|32@1+ (1,0) [0|0] ""  ARS_FD,ATS_FD,BLTN_CAM_FD,CGW_CCU,DCM_FD,FCS_FD,FLLR_FD,GW_PSU_3RD_FD,GW_PSU_AST_FD,GW_PSU_DRV_FD,GW_PSU_RL_FD,GW_PSU_RR_FD,GW_SAU_DRV_FD,OHCL_FD,RCM_FD,RCS_FD,RWPC_FD,SCM_FD,SGU_FD,SHVU_3RD_FD,SHVU_CCS_FD,SHVU_FRNT_FD,SHVU_REAR_FD,SHVU_RL_FD,SHVU_RR_FD,WPC2_FD,WPC_FD
 SG_ PNI_PSB_FD_1 : 64|64@1+ (1,0) [0|0] ""  ARS_FD,ATS_FD,BLTN_CAM_FD,CGW_CCU,DCM_FD,FCS_FD,FLLR_FD,GW_PSU_3RD_FD,GW_PSU_AST_FD,GW_PSU_DRV_FD,GW_PSU_RL_FD,GW_PSU_RR_FD,GW_SAU_DRV_FD,OHCL_FD,RCM_FD,RCS_FD,RWPC_FD,SCM_FD,SGU_FD,SHVU_3RD_FD,SHVU_CCS_FD,SHVU_FRNT_FD,SHVU_REAR_FD,SHVU_RL_FD,SHVU_RR_FD,WPC2_FD,WPC_FD
 SG_ PNI_PSB_FD_2 : 128|64@1+ (1,0) [0|0] ""  ARS_FD,ATS_FD,BLTN_CAM_FD,CGW_CCU,DCM_FD,FCS_FD,FLLR_FD,GW_PSU_3RD_FD,GW_PSU_AST_FD,GW_PSU_DRV_FD,GW_PSU_RL_FD,GW_PSU_RR_FD,GW_SAU_DRV_FD,OHCL_FD,RCM_FD,RCS_FD,RWPC_FD,SCM_FD,SGU_FD,SHVU_3RD_FD,SHVU_CCS_FD,SHVU_FRNT_FD,SHVU_REAR_FD,SHVU_RL_FD,SHVU_RR_FD,WPC2_FD,WPC_FD
 SG_ PNI_PSB_FD_3 : 192|64@1+ (1,0) [0|0] ""  ARS_FD,ATS_FD,BLTN_CAM_FD,CGW_CCU,DCM_FD,FCS_FD,FLLR_FD,GW_PSU_3RD_FD,GW_PSU_AST_FD,GW_PSU_DRV_FD,GW_PSU_RL_FD,GW_PSU_RR_FD,GW_SAU_DRV_FD,OHCL_FD,RCM_FD,RCS_FD,RWPC_FD,SCM_FD,SGU_FD,SHVU_3RD_FD,SHVU_CCS_FD,SHVU_FRNT_FD,SHVU_REAR_FD,SHVU_RL_FD,SHVU_RR_FD,WPC2_FD,WPC_FD

CM_ BO_ 250 "[P] Periodic";
CM_ SG_ 250 HCU_Crc3Val "HCU_CyclicRedundancyCheck3Value";
CM_ SG_ 250 HCU_SpdLimDeviceActSta "HCU_SpeedLimiterDeviceActivationStatus ##2G##HCU - HCU4 - CF_Vcu_SldAct";
CM_ SG_ 250 HCU_SpdLimDeviceOperSta "HCU_SpeedLimiterDeviceOperationStatus ##2G##HCU - HCU4 - CF_Hcu_SldOpr";
CM_ SG_ 250 HCU_SpdLimDeviceVehSpdVal "HCU_SpeedLimiterDeviceVehicleSpeedValue ##2G##HCU - HCU4 - CR_Vcu_SldVs";
CM_ SG_ 250 HCU_SrvModSta "HCU_ServiceModeStatus ##2G##HCU - HCU2 - CF_Hcu_ServiceMod";
CM_ SG_ 250 HCU_StrtInhbt2Sta "HCU_StartInhibit2Status ##2G##HCU - HCU3 - CF_Hcu_StartInh";
CM_ SG_ 250 HCU_StrtInhbtSta "HCU_StartInhibitStatus ##2G##HCU - HCU1 - CF_Hcu_StInhStat";
CM_ SG_ 250 HCU_PdlRgnCmpnRear "Request for hydraulic brake compensation in paddle regeneration braking mode for rear motor( when the coasting tq decrease rapidly )";
CM_ SG_ 250 HCU_VehStrtEnblSta "HCU_VehicleStartEnableStatus ##2G##HCU - HCU1 - CF_Hcu_Veh_ST";
CM_ SG_ 250 HCU_BrkLmpOnReq "HCU_BrakeLampOnRequest###2G####HCU - HCU5 - CF_Hcu_BrkLpReq";
CM_ SG_ 250 HCU_CcDrvAlrtDis "Driver display information of CC can not be engaged";
CM_ SG_ 250 HCU_SldDrvAlrtDis "SLD must be disengaged by system or cannot be engaged";
CM_ SG_ 250 HCU_WhlCrpCrpTqNmVal "HCU_WheelCreepTorqueNmValue ##2G##HCU - HCU2 - CR_Hcu_CrpTq_Nm";
CM_ SG_ 250 LHCU_EngCltchTrnsfrTqPcVal_Copy_ "##2G##HCU - HCU7 - CR_Hcu_EngCltTrnfTq_Pc";
CM_ SG_ 250 HCU_RspaAlvCntVal "RSPA HCU Alive Counter ##2G##HCU - HCU4 - CF_Hcu_RspaAliveCnt";
CM_ SG_ 250 HCU_RspaSta "HCU RSPA Cooperative control staus ##2G##HCU - HCU4 - CF_Hcu_RspaStat";
CM_ SG_ 250 HCU_AlvCnt3Val "HCU_AliveCounter3Value";
CM_ SG_ 250 HCU_RspaCanFailSta "HCU RSPA CAN Fail Status ##2G##HCU - HCU4 - CR_Hcu_RspaCanFailFlag";
CM_ SG_ 250 HCU_RForwardRq "R gear forward drive request";
CM_ SG_ 250 HCU_2ndStpSig "Vehicle Stop Signal at 2nd Gear";
CM_ SG_ 250 HCU_Mg3SpdCmdVal "MG3 Motor Speed Command";
CM_ SG_ 250 HCU_Mg3TqPcReq "MG3 Motor Torque Command";
CM_ SG_ 250 HCU_Mg3DisChrgTqCmdPcVal_FS "MG3 Motor Discharge Limit Torque Command for Anti-Jerk";
CM_ SG_ 250 HCU_Mg3ChrgTqCmdPcVal_FS "MG3 Motor Charge Limit Torque Command for Anti-Jerk";
CM_ SG_ 250 HCU_11sMaxSpdLimOperSta "HCU_11sMaxSpdLimOperSta";
CM_ SG_ 250 HCU_PMPDUsmSta "HCU PMPD set Value for USM";
CM_ SG_ 250 HCU_DrvWhlDmndTqNmVal "HCU_DriverWheelDemandTorqueNmValue ##2G##HCU - HCU2 - CR_Hcu_WhlDemTq_Nm";
CM_ SG_ 250 HCU_PMPDActSta "PMPD Function Active State";
CM_ SG_ 250 HCU_PMPDWarnSta "PMPD Function Warning State";
CM_ SG_ 250 HCU_STAYModReservationSta "0x0: Default(Off) 0x1 : Off 0x2 : On 0x3 : RESERVED";
CM_ SG_ 250 HCU_STAYModBattMngmntSta "0x0: Default(Off) 0x1 : Off 0x2 : On 0x3 : RESERVED";
CM_ SG_ 250 HCU_Mg3AntJrkInhbtReq "MG3 Motor AntiJerkInhibition";
CM_ SG_ 250 HCU_Mg3CtrlModReq "MG3 Motor Control Mode Command";
CM_ SG_ 250 HCU_Mg3PwmOffInhbtSta "MG3 Motor PWM Off Inhibit";
CM_ SG_ 250 HCU_Mg3PwrEnaSta "MG3 Motor Power Enable";
CM_ SG_ 250 HCU_EstAccelPdlPcVal "HCU_EstimatedAcceleratorPedalPcValue ##2G##HCU - HCU4 - CR_Hcu_EstAccPed_PC";
CM_ SG_ 250 HCU_EstApsSelSta "HCU_EstimatedApsSelectStatus ##2G##HCU - HCU4 - CF_HCU_EstApsSel";
CM_ SG_ 250 HCU_GreenZoneDrvModSta "0x0:Default (USM 미 표출 (메뉴삭제))
0x1:Off (USM 표출 Off 상태 표시) ##2G##HCU - HCU4 - CF_Hcu_GreenZoneDrv_Status";
CM_ SG_ 250 HCU_GreenZoneLmpDis "Indicate Green Zone Area ##2G##HCU - HCU4 - CF_Hcu_GreenZoneLamp";
CM_ SG_ 250 HCU_HcuRdySta "HCU_HybridControlUnitReadyStatus ##2G##HCU - HCU1 - CF_Hcu_Rdy";
CM_ SG_ 250 HCU_HEVRdyDis "HCU_HybridVehicleReadyDisplay ##2G##HCU - HCU1 - CF_Hcu_HevRdyClu";
CM_ SG_ 250 HCU_HevRdySta "HCU_HybridVehicleReadyStatus ##2G##HCU - HCU1 - CF_Hcu_HevRdy";
CM_ SG_ 250 HCU_LimpOffSta "HCU_LimpOffStatus ##2G##HCU - HCU22 - CF_Hcu_LimpOff";
CM_ SG_ 250 HCU_MILOnReq "HCU_MalfunctionIndicatorLampOnRequest ##2G##HCU - HCU1 - CF_Hcu_MILReq";
CM_ SG_ 250 HCU_PhevAutoModOnSta "HCU_PhevAutoModeOnStatus ##2G##HCU - HCU4 - CF_Hcu_AutoCdCs";
CM_ SG_ 250 HCU_SccDrvOvrdReq "HCU_SccDriverOverrideRequest ##2G##HCU - HCU2 - CF_Hcu_Ovrride";
CM_ SG_ 250 HCU_SccEnblSta "HCU_SmartCruiseControlEnableStatus ##2G##HCU - HCU2 - CF_Hcu_SccEna";
CM_ SG_ 250 HCU_SlwDnSta "HCU_SlowDownStatus ##2G##HCU - HCU1 - CF_Hcu_SlwDwnStat";
CM_ SG_ 250 HCU_SmrtEcoGdDis "HCU_SmartEcoGuideDisplay ##2G##HCU - HCU4 - CF_Hcu_SmartEcoDisp";
CM_ SG_ 250 HCU_SmrtEcoLvlDis "HCU_SmartEcoLevelDisplay ##2G##HCU - HCU4 - CR_Hcu_SmartEcoLvl";
CM_ SG_ 250 HCU_SmrtEcoRngDis "HCU_SmartEcoRangeDisplay ##2G##HCU - HCU4 - CR_Hcu_SmartEcoRng";
CM_ BO_ 1325 "[PE] Periodic and On Event";
CM_ SG_ 1325 BLTN_CAM_ADAS_PRK_Crc0Val "BLTN_CAM_ADAS_PRK_CyclicRedundancyCheck0Value";
CM_ SG_ 1325 BLTN_CAM_ADAS_PRK_AlvCnt0Val "BLTN_CAM_ADAS_PRK_AliveCounter0Value";
CM_ SG_ 1325 BLTN_CAM_I2CMasterSta_Left "The indication of I2C master device for SVM LH camera";
CM_ SG_ 1325 BLTN_CAM_I2CMasterSta_Right "The indication of I2C master device for SVM RH camera";
CM_ SG_ 1325 BLTN_CAM_CamSta_Left "The state of the SVM LH camera";
CM_ SG_ 1325 BLTN_CAM_CamSta_Right "The state of the SVM RH camera";
CM_ BO_ 112 "[P] Periodic";
CM_ SG_ 112 HTCU_Crc5Val "HTCU_CyclicRedundancyCheck5Value";
CM_ SG_ 112 HDCT_TqIncReq "Torque Increase Request ## TCU11 - CF_Tcu_TqIncReq";
CM_ SG_ 112 HDCT_TqIncVal "Torque Increase Value ## TCU11 - CR_Tcu_TqIncReq_Pc";
CM_ SG_ 112 HDCT_EOLReq "EOL Request ## DCT_TCU1 - CF_Tcu_DCT_EOLReq";
CM_ SG_ 112 HDCT_CltchSta "Clutch Status ## DCT_TCU1 - CF_Tcu_CltStat";
CM_ SG_ 112 HDCT_DblCltchSta "Double Clutch Status ## DCT_TCU1 - CF_Tcu_DCT_CltState";
CM_ SG_ 112 HDCT_AcnChrgInhbtReq "Aircon Change Inhibit Request ## DCT_TCU1 - CF_Tcu_ChgInhAC";
CM_ SG_ 112 HDCT_SlipCrnkAllw "Slip Crank Allow ## DCT_TCU1 - CF_Tcu_SlipCrk_Allow";
CM_ SG_ 112 HDCT_KckDnSkpShftCnt "Kick Down Skip Shift Count ## DCT_TCU1 - CF_Tcu_KD_SkipShft_Cnt";
CM_ SG_ 112 HDCT_FuelCutReq "Fuel Cut Request ## DCT_TCU1 - CF_Tcu_FuelCutReq";
CM_ SG_ 112 HDCT_NCoastTrgtGear "N Coast Target Gear ## DCT_TCU1 - CR_Tcu_NCoastTgtGear";
CM_ SG_ 112 HDCT_NCoastDnReq "N Coast Down Request ## DCT_TCU1 - CF_Tcu_NcoastDwnReq";
CM_ SG_ 112 HDCT_CLUEngSpd "Clutster Engine Speed ## DCT_TCU1 - Cluster_Engine_RPM";
CM_ SG_ 112 HDCT_CLUEngSpdFlag "Cluster Engine Speed Flag ## DCT_TCU1 - Cluster_Engine_RPM_Flag";
CM_ SG_ 112 HDCT_CLUTrgtGear "Clutster Target Gear ## DCT_TCU1 - CF_Tcu_TarGeforCLU";
CM_ SG_ 112 HDCT_GSITrgtGear "GSI Target Gear ## DCT_TCU1 - CF_Tcu_GSITgtGear";
CM_ SG_ 112 HDCT_PtrnGear "Pattern Gear from TCU";
CM_ SG_ 112 HTCU_AlvCnt5Val "HTCU_AliveCounter5Value";
CM_ SG_ 112 HDCT_AddtnlTqLssVal "Additional Torque Loss Value ## TCU16 - CR_Tcu_AddTqLoss_Pc";
CM_ SG_ 112 HDCT_OBDSta "OBD Status ## TCU16 - CF_Tcu_ObdStat";
CM_ SG_ 112 HDCT_OBDErrSta "OBD Error Status ## TCU16 - CF_Tcu_ObdRelErr";
CM_ SG_ 112 HDCT_StcShftLrchCtrl "Static Shift Lurch Control ## TCU16 - CF_Tcu_StaticLurchCtl";
CM_ SG_ 112 HDCT_EngCltchLmphmMod "Engine Clutch Limphome Mode ## TCU16 - CF_Tcu_CltLimAct";
CM_ SG_ 112 HDCT_CurrPrgrm "Current Program ## TCU16 - CF_Tcu_CurProgram";
CM_ SG_ 112 HDCT_FltSta "TCU fault status ## TCU16 - CF_Tcu_Flt";
CM_ SG_ 112 HDCT_MCUAntJrkInhbt "MCU Anti-Jerk Inhibition ## TCU16 - CF_Tcu_MCUAntiJerkInh";
CM_ SG_ 112 HDCT_TrgtGear "Target Gear ## TCU11 - CF_Tcu_TarGe";
CM_ SG_ 112 HDCT_CurrGear "Current Gear ## TCU11 - HDCT_CurrGear";
CM_ SG_ 112 HDCT_GearSelDis "Gear Select Display ## TCU11 - CF_Tcu_GarSelDisp";
CM_ SG_ 112 HDCT_TCURdySta "TCU Ready Status ## TCU11 - CF_Tcu_Rdy";
CM_ SG_ 112 HDCT_CtrlablSta "Controllable Status ## TCU11 - CF_Tcu_Cont";
CM_ SG_ 112 HDCT_TrgtShftCls "Target Shift Class ## TCU11 - CF_Tcu_ShiftClass";
CM_ SG_ 112 HDCT_ShftPhase "Shift Phase ## TCU11 - CF_Tcu_ShiftPhase";
CM_ SG_ 112 HDCT_NetrlCtrlSta "Neutralize Control Status ## TCU11 - CF_Tcu_NeutAck";
CM_ SG_ 112 HDCT_GearShftSta "Gear Shfit Status ## TCU11 - CF_Tcu_GarChange";
CM_ SG_ 112 HDCT_TqRdctnVal "Torque Reduction Value ## TCU11 - CR_Tcu_TqRedReq_Pc";
CM_ SG_ 112 HTCU_SlwTqRdctnVal "Slow Torque Reduction Value ## TCU11 - CR_Tcu_TqRedReqSlw_Pc";
CM_ BO_ 126 "[EC] On Event and On Change";
CM_ SG_ 126 HU_BLTN_CAM_Crc1Val "HU_BLTN_CAM_CyclicRedundancyCheck1Value";
CM_ SG_ 126 BLTN_CAM_EV_BfrTime_NvalueSet "Driving Event Time Setting - Before, Resolution : sec";
CM_ SG_ 126 BLTN_CAM_EV_AftTime_NvalueSet "Driving Event Time Setting - After, Resolution : sec";
CM_ SG_ 126 BLTN_CAM_TML_Int_NvalueSet "Record Set of Time-lapse Interval, Resolution : sec";
CM_ SG_ 126 BLTN_CAM_Sen_DEV_NvalueSet "Set of Event  Detection Sensitivity of Driving Mode";
CM_ SG_ 126 BLTN_CAM_Sen_PEV_NvalueSet "Set of Event  Detection Sensitivity of Parking Mode";
CM_ SG_ 126 BLTN_CAM_FR_VerPos_NvalueSet "Front Camera Vertical position setting value.";
CM_ SG_ 126 BLTN_CAM_RR_VerPos_NvalueSet "Rear Camera Vertical position setting value.";
CM_ SG_ 126 BLTN_CAM_AppNoti_PEV_NvalueSet "Parked Event notification to Connectivity Phone App. On/Off";
CM_ SG_ 126 BLTN_CAM_WiFi_AutoOn_NvalueSet "Wifi On/Off User setting";
CM_ SG_ 126 BLTN_CAM_StoProp_NvalueSet "Propotion of built-in Cam SD card Propotion set of the Recording Categories";
CM_ SG_ 126 CF_AVN_BLTN_CAM_USMReset "Buit-in Cam USM Reset Request.";
CM_ SG_ 126 CF_AVN_BLTN_CAM_RecReset "Buit-in Cam format(all file delete/Reset) Request.";
CM_ SG_ 126 BLTN_CAM_File_DEL_CPY_Cmd "Buit-in Cam operation control of copying and deleting.";
CM_ SG_ 126 BLTN_CAM_LVDS_Mode_Cmd "This Signal is for LVDS output commend to BLTN_CAM";
CM_ SG_ 126 HU_BLTN_CAM_Disp_Touch_Pos_X "X position of touch of display when BLTN-in CAM Engineer mode in";
CM_ SG_ 126 HU_BLTN_CAM_AlvCnt1Val "HU_BLTN_CAM_AliveCounter1Value";
CM_ SG_ 126 HU_BLTN_CAM_Disp_Touch_Pos_Y "Y position of touch of display when BLTN-in CAM Engineer mode in";
CM_ SG_ 126 MEV_Rec_Req "0x1(On) : MEV Record Request.";
CM_ SG_ 126 TML_Rec_Req "0x1 : Start Request, 0x2 : End Request";
CM_ SG_ 126 BLTN_CAM_SD_Card_UnMt_Mt_Req "0x0(Default), 0x1(UnMount Request), 0x2(Mount Request), 0x3(Invalid)";
CM_ SG_ 126 BLTN_CAM_PMD_NvalueSet "Parked Motion Detection Record On/Off Set";
CM_ SG_ 126 BLTN_CAM_PMDEV_NvalueSet "Parked Motion Detection Event Record On/Off Set";
CM_ SG_ 126 BLTN_CAM_Ran_PMDR_NvalueSet "Set of Range level of Parked Motion Detection Record Mode";
CM_ SG_ 126 BLTN_CAM_PMDTime_NvalueSet "Set the hours of Parked Motion Detection Mode";
CM_ SG_ 126 BLTN_CAM_BPR_TM_NvalueSet "Built-inCAM Performance Recorder Track Mode Set";
CM_ SG_ 126 BLTN_CAM_BPR_RE_NvalueSet "Built-inCAM Performance Recorder Resolution Set";
CM_ SG_ 126 BLTN_CAM_BPR_SndRec_NvalueSet "Built-inCAM Performance Recorder Sound Recording Set";
CM_ SG_ 126 BLTN_CAM_BPR_AutRec_NvalueSet "Built-inCAM Performance Recorder Automatic Record Set";
CM_ SG_ 126 BLTN_CAM_BPR_Rec_Req "0x0: Default 0x1:Start Request 0x2:End Request 0x3:Invalid";
CM_ SG_ 126 BLTN_CAM_Rec_LPE_NvalueSet "Low power mode's Tx signal applied to built-in cam 3.0";
CM_ SG_ 126 BLTN_CAM_Distort_NvalueSet "Distort prevention setting's Tx signal applied to built-in cam 3.0";
CM_ SG_ 126 BLTN_CAM_Pollution_NvalueSet "Pollution prevention setting's Tx signal applied to built-in cam 3.0";
CM_ SG_ 126 BLTN_CAM_Crash_Pos_NvalueSet "Indicate the direction of impact detection setting's Tx signal applied to built-in cam 3.0";
CM_ SG_ 126 BLTN_CAM_Rear_Flip_NvalueSet "Rear image inversion setting's Tx signal applied to built-in cam 3.0";
CM_ SG_ 126 BLTN_CAM_Stm_all_NvalueSet "All stamp setting's Tx signal applied to built-in cam 3.0";
CM_ SG_ 126 BLTN_CAM_Rec_OWD_NvalueSet "Record On/Off Set of On While Driving";
CM_ SG_ 126 BLTN_CAM_Rec_DEV_NvalueSet "Record On/Off Set of Driving Event";
CM_ SG_ 126 BLTN_CAM_Rec_OWP_NvalueSet "Record On/Off Set of On While Parked, 0x0(Default) : Parking recording function not supported";
CM_ SG_ 126 BLTN_CAM_Rec_PEV_NvalueSet "Record Set of Parked Event, 0x0(Default) : Parking recording function not supported";
CM_ SG_ 126 BLTN_CAM_AudRec_NvalueSet "Audio Record On/Off Set";
CM_ SG_ 126 BLTN_CAM_Time_Stm_NvalueSet "Record Set of Date and Time Stamp";
CM_ SG_ 126 BLTN_CAM_Spd_Stm_NvalueSet "Record Set of Speed Stamp";
CM_ SG_ 126 BLTN_CAM_Locatn_Stm_NvalueSet "Record Set of Location Stamp";
CM_ SG_ 126 BLTN_CAM_TrnSig_Stm_NvalueSet "Record Set of Turn Signal Stamp";
CM_ SG_ 126 BLTN_CAM_AclBrk_Stm_NvalueSet "Record Set of Accelerator Brake Stamp";
CM_ SG_ 126 BLTN_CAM_GearPos_Stm_NvalueSet "Record Set of Gear Position Stamp";
CM_ SG_ 126 BLTN_CAM_EVSen_Stm_NvalueSet "Record Set of Event Sensitivity Stamp";
CM_ SG_ 126 BLTN_CAM_Strangl_Stm_NvalueSet "Record Set of Steering Angle Stamp";
CM_ SG_ 126 BLTN_CAM_EV_RecMaxTime_NvalueSet "Record Set of  EV Parking Rec Max Time On/Off";
CM_ SG_ 126 BLTN_CAM_Rec_STRM_NvalueSet "0x0:Default 0x1:Off 0x2:On 0x3:Invalid";
CM_ SG_ 126 BLTN_CAM_PrkTime_NvalueSet "Parking Operation Setting Time, Resolution : hr";
CM_ SG_ 2549874789 SNI_SHVU_CCS_FD "ASR NM Source Node Identifier";
CM_ SG_ 2549874789 CBV_RMR_SHVU_CCS_FD "ASR NM Control Bit Vector - Repeat Message Request";
CM_ SG_ 2549874789 CBV_NMCoID_SHVU_CCS_FD "ASR NM Control Bit Vector - ASR NM Coordinator ID";
CM_ SG_ 2549874789 CBV_NMCoSRB_SHVU_CCS_FD "ASR NM Control Bit Vector - ASR NM Coordinator Sleep Ready Bit";
CM_ SG_ 2549874789 CBV_AWB_SHVU_CCS_FD "ASR NM Control Bit Vector - Active Wakeup Bit";
CM_ SG_ 2549874789 CBV_PNIB_SHVU_CCS_FD "ASR NM Control Bit Vector - PN Info Bit";
CM_ SG_ 2549874789 NRR_SHVU_CCS_FD "ASR NM Network Request Reason";
CM_ SG_ 2549874789 NM_State_SHVU_CCS_FD "ASR NM State_Current State_Previous State";
CM_ SG_ 2549874789 PNI_SHVU_CCS_FD "ASR NM Partial Networking Information";
CM_ SG_ 2549874789 PNI_SHVU_CCS_FD_1 "ASR NM Partial Networking Information";
CM_ SG_ 2549874789 PNI_SHVU_CCS_FD_2 "ASR NM Partial Networking Information";
CM_ SG_ 2549874789 PNI_SHVU_CCS_FD_3 "ASR NM Partial Networking Information";
CM_ SG_ 2549874826 SNI_ARS_FD "ASR NM Source Node Identifier";
CM_ SG_ 2549874826 CBV_RMR_ARS_FD "ASR NM Control Bit Vector - Repeat Message Request";
CM_ SG_ 2549874826 CBV_NMCoID_ARS_FD "ASR NM Control Bit Vector - ASR NM Coordinator ID";
CM_ SG_ 2549874826 CBV_NMCoSRB_ARS_FD "ASR NM Control Bit Vector - ASR NM Coordinator Sleep Ready Bit";
CM_ SG_ 2549874826 CBV_AWB_ARS_FD "ASR NM Control Bit Vector - Active Wakeup Bit";
CM_ SG_ 2549874826 CBV_PNIB_ARS_FD "ASR NM Control Bit Vector - PN Info Bit";
CM_ SG_ 2549874826 NRR_ARS_FD "ASR NM Network Request Reason";
CM_ SG_ 2549874826 NM_State_ARS_FD "ASR NM State_Current State_Previous State";
CM_ SG_ 2549874826 PNI_ARS_FD "ASR NM Partial Networking Information";
CM_ SG_ 2549874826 PNI_ARS_FD_1 "ASR NM Partial Networking Information";
CM_ SG_ 2549874826 PNI_ARS_FD_2 "ASR NM Partial Networking Information";
CM_ SG_ 2549874826 PNI_ARS_FD_3 "ASR NM Partial Networking Information";
CM_ SG_ 2549874846 SNI_WPC_FD "ASR NM Source Node Identifier";
CM_ SG_ 2549874846 CBV_RMR_WPC_FD "ASR NM Control Bit Vector - Repeat Message Request";
CM_ SG_ 2549874846 CBV_NMCoID_WPC_FD "ASR NM Control Bit Vector - ASR NM Coordinator ID";
CM_ SG_ 2549874846 CBV_NMCoSRB_WPC_FD "ASR NM Control Bit Vector - ASR NM Coordinator Sleep Ready Bit";
CM_ SG_ 2549874846 CBV_AWB_WPC_FD "ASR NM Control Bit Vector - Active Wakeup Bit";
CM_ SG_ 2549874846 CBV_PNIB_WPC_FD "ASR NM Control Bit Vector - PN Info Bit";
CM_ SG_ 2549874846 NRR_WPC_FD "ASR NM Network Request Reason";
CM_ SG_ 2549874846 NM_State_WPC_FD "ASR NM State_Current State_Previous State";
CM_ SG_ 2549874846 PNI_WPC_FD "ASR NM Partial Networking Information";
CM_ SG_ 2549874846 PNI_WPC_FD_1 "ASR NM Partial Networking Information";
CM_ SG_ 2549874846 PNI_WPC_FD_2 "ASR NM Partial Networking Information";
CM_ SG_ 2549874846 PNI_WPC_FD_3 "ASR NM Partial Networking Information";
CM_ SG_ 2549874837 SNI_WPC2_FD "ASR NM Source Node Identifier";
CM_ SG_ 2549874837 CBV_RMR_WPC2_FD "ASR NM Control Bit Vector - Repeat Message Request";
CM_ SG_ 2549874837 CBV_NMCoID_WPC2_FD "ASR NM Control Bit Vector - ASR NM Coordinator ID";
CM_ SG_ 2549874837 CBV_NMCoSRB_WPC2_FD "ASR NM Control Bit Vector - ASR NM Coordinator Sleep Ready Bit";
CM_ SG_ 2549874837 CBV_AWB_WPC2_FD "ASR NM Control Bit Vector - Active Wakeup Bit";
CM_ SG_ 2549874837 CBV_PNIB_WPC2_FD "ASR NM Control Bit Vector - PN Info Bit";
CM_ SG_ 2549874837 NRR_WPC2_FD "ASR NM Network Request Reason";
CM_ SG_ 2549874837 NM_State_WPC2_FD "ASR NM State_Current State_Previous State";
CM_ SG_ 2549874837 PNI_WPC2_FD "ASR NM Partial Networking Information";
CM_ SG_ 2549874837 PNI_WPC2_FD_1 "ASR NM Partial Networking Information";
CM_ SG_ 2549874837 PNI_WPC2_FD_2 "ASR NM Partial Networking Information";
CM_ SG_ 2549874837 PNI_WPC2_FD_3 "ASR NM Partial Networking Information";
CM_ SG_ 2549874823 SNI_SCM_FD "ASR NM Source Node Identifier";
CM_ SG_ 2549874823 CBV_RMR_SCM_FD "ASR NM Control Bit Vector - Repeat Message Request";
CM_ SG_ 2549874823 CBV_NMCoID_SCM_FD "ASR NM Control Bit Vector - ASR NM Coordinator ID";
CM_ SG_ 2549874823 CBV_NMCoSRB_SCM_FD "ASR NM Control Bit Vector - ASR NM Coordinator Sleep Ready Bit";
CM_ SG_ 2549874823 CBV_AWB_SCM_FD "ASR NM Control Bit Vector - Active Wakeup Bit";
CM_ SG_ 2549874823 CBV_PNIB_SCM_FD "ASR NM Control Bit Vector - PN Info Bit";
CM_ SG_ 2549874823 NRR_SCM_FD "ASR NM Network Request Reason";
CM_ SG_ 2549874823 NM_State_SCM_FD "ASR NM State_Current State_Previous State";
CM_ SG_ 2549874823 PNI_SCM_FD "ASR NM Partial Networking Information";
CM_ SG_ 2549874823 PNI_SCM_FD_1 "ASR NM Partial Networking Information";
CM_ SG_ 2549874823 PNI_SCM_FD_2 "ASR NM Partial Networking Information";
CM_ SG_ 2549874823 PNI_SCM_FD_3 "ASR NM Partial Networking Information";
CM_ SG_ 2549874858 SNI_SHVU_FRNT_FD "ASR NM Source Node Identifier";
CM_ SG_ 2549874858 CBV_RMR_SHVU_FRNT_FD "ASR NM Control Bit Vector - Repeat Message Request";
CM_ SG_ 2549874858 CBV_NMCoID_SHVU_FRNT_FD "ASR NM Control Bit Vector - ASR NM Coordinator ID";
CM_ SG_ 2549874858 CBV_NMCoSRB_SHVU_FRNT_FD "ASR NM Control Bit Vector - ASR NM Coordinator Sleep Ready Bit";
CM_ SG_ 2549874858 CBV_AWB_SHVU_FRNT_FD "ASR NM Control Bit Vector - Active Wakeup Bit";
CM_ SG_ 2549874858 CBV_PNIB_SHVU_FRNT_FD "ASR NM Control Bit Vector - PN Info Bit";
CM_ SG_ 2549874858 NRR_SHVU_FRNT_FD "ASR NM Network Request Reason";
CM_ SG_ 2549874858 NM_State_SHVU_FRNT_FD "ASR NM State_Current State_Previous State";
CM_ SG_ 2549874858 PNI_SHVU_FRNT_FD "ASR NM Partial Networking Information";
CM_ SG_ 2549874858 PNI_SHVU_FRNT_FD_1 "ASR NM Partial Networking Information";
CM_ SG_ 2549874858 PNI_SHVU_FRNT_FD_2 "ASR NM Partial Networking Information";
CM_ SG_ 2549874858 PNI_SHVU_FRNT_FD_3 "ASR NM Partial Networking Information";
CM_ SG_ 2549874750 SNI_FLLR_FD "ASR NM Source Node Identifier";
CM_ SG_ 2549874750 CBV_RMR_FLLR_FD "ASR NM Control Bit Vector - Repeat Message Request";
CM_ SG_ 2549874750 CBV_NMCoID_FLLR_FD "ASR NM Control Bit Vector - ASR NM Coordinator ID";
CM_ SG_ 2549874750 CBV_NMCoSRB_FLLR_FD "ASR NM Control Bit Vector - ASR NM Coordinator Sleep Ready Bit";
CM_ SG_ 2549874750 CBV_AWB_FLLR_FD "ASR NM Control Bit Vector - Active Wakeup Bit";
CM_ SG_ 2549874750 CBV_PNIB_FLLR_FD "ASR NM Control Bit Vector - PN Info Bit";
CM_ SG_ 2549874750 NRR_FLLR_FD "ASR NM Network Request Reason";
CM_ SG_ 2549874750 NM_State_FLLR_FD "ASR NM State_Current State_Previous State";
CM_ SG_ 2549874750 PNI_FLLR_FD "ASR NM Partial Networking Information";
CM_ SG_ 2549874750 PNI_FLLR_FD_1 "ASR NM Partial Networking Information";
CM_ SG_ 2549874750 PNI_FLLR_FD_2 "ASR NM Partial Networking Information";
CM_ SG_ 2549874750 PNI_FLLR_FD_3 "ASR NM Partial Networking Information";
CM_ SG_ 2549874905 SNI_GW_SAU_DRV_FD "ASR NM Source Node Identifier";
CM_ SG_ 2549874905 CBV_RMR_GW_SAU_DRV_FD "ASR NM Control Bit Vector - Repeat Message Request";
CM_ SG_ 2549874905 CBV_NMCoID_GW_SAU_DRV_FD "ASR NM Control Bit Vector - ASR NM Coordinator ID";
CM_ SG_ 2549874905 CBV_NMCoSRB_GW_SAU_DRV_FD "ASR NM Control Bit Vector - ASR NM Coordinator Sleep Ready Bit";
CM_ SG_ 2549874905 CBV_AWB_GW_SAU_DRV_FD "ASR NM Control Bit Vector - Active Wakeup Bit";
CM_ SG_ 2549874905 CBV_PNIB_GW_SAU_DRV_FD "ASR NM Control Bit Vector - PN Info Bit";
CM_ SG_ 2549874905 NRR_GW_SAU_DRV_FD "ASR NM Network Request Reason";
CM_ SG_ 2549874905 NM_State_GW_SAU_DRV_FD "ASR NM State_Current State_Previous State";
CM_ SG_ 2549874905 PNI_GW_SAU_DRV_FD "ASR NM Partial Networking Information";
CM_ SG_ 2549874905 PNI_GW_SAU_DRV_FD_1 "ASR NM Partial Networking Information";
CM_ SG_ 2549874905 PNI_GW_SAU_DRV_FD_2 "ASR NM Partial Networking Information";
CM_ SG_ 2549874905 PNI_GW_SAU_DRV_FD_3 "ASR NM Partial Networking Information";
CM_ SG_ 2549874896 SNI_ATS_FD "ASR NM Source Node Identifier";
CM_ SG_ 2549874896 CBV_RMR_ATS_FD "ASR NM Control Bit Vector - Repeat Message Request";
CM_ SG_ 2549874896 CBV_NMCoID_ATS_FD "ASR NM Control Bit Vector - ASR NM Coordinator ID";
CM_ SG_ 2549874896 CBV_NMCoSRB_ATS_FD "ASR NM Control Bit Vector - ASR NM Coordinator Sleep Ready Bit";
CM_ SG_ 2549874896 CBV_AWB_ATS_FD "ASR NM Control Bit Vector - Active Wakeup Bit";
CM_ SG_ 2549874896 CBV_PNIB_ATS_FD "ASR NM Control Bit Vector - PN Info Bit";
CM_ SG_ 2549874896 NRR_ATS_FD "ASR NM Network Request Reason";
CM_ SG_ 2549874896 NM_State_ATS_FD "ASR NM State_Current State_Previous State";
CM_ SG_ 2549874896 PNI_ATS_FD "ASR NM Partial Networking Information";
CM_ SG_ 2549874896 PNI_ATS_FD_1 "ASR NM Partial Networking Information";
CM_ SG_ 2549874896 PNI_ATS_FD_2 "ASR NM Partial Networking Information";
CM_ SG_ 2549874896 PNI_ATS_FD_3 "ASR NM Partial Networking Information";
CM_ SG_ 2549874881 SNI_PSB_FD "ASR NM Source Node Identifier";
CM_ SG_ 2549874881 CBV_RMR_PSB_FD "ASR NM Control Bit Vector - Repeat Message Request";
CM_ SG_ 2549874881 CBV_NMCoID_PSB_FD "ASR NM Control Bit Vector - ASR NM Coordinator ID";
CM_ SG_ 2549874881 CBV_NMCoSRB_PSB_FD "ASR NM Control Bit Vector - ASR NM Coordinator Sleep Ready Bit";
CM_ SG_ 2549874881 CBV_AWB_PSB_FD "ASR NM Control Bit Vector - Active Wakeup Bit";
CM_ SG_ 2549874881 CBV_PNIB_PSB_FD "ASR NM Control Bit Vector - PN Info Bit";
CM_ SG_ 2549874881 NRR_PSB_FD "ASR NM Network Request Reason";
CM_ SG_ 2549874881 NM_State_PSB_FD "ASR NM State_Current State_Previous State";
CM_ SG_ 2549874881 PNI_PSB_FD "ASR NM Partial Networking Information";
CM_ SG_ 2549874881 PNI_PSB_FD_1 "ASR NM Partial Networking Information";
CM_ SG_ 2549874881 PNI_PSB_FD_2 "ASR NM Partial Networking Information";
CM_ SG_ 2549874881 PNI_PSB_FD_3 "ASR NM Partial Networking Information";
BA_DEF_ BO_  "GenMsgEVName" STRING ;
BA_DEF_ BO_  "NmAsrMessage" ENUM  "No","Yes";
BA_DEF_ BO_  "DiagState" ENUM  "No","Yes";
BA_DEF_ BO_  "DiagRequest" ENUM  "No","Yes";
BA_DEF_ BO_  "TpMessage" ENUM  "No","Yes";
BA_DEF_ BO_  "UsrMsgIDSforwardDeviation" INT 0 100;
BA_DEF_ BO_  "UsrMsgIDSbackwardDeviation" INT 50 1000;
BA_DEF_ BO_  "GenMsgCycleTime" INT 0 2000;
BA_DEF_ BO_  "GenMsgStartDelayTime" INT 0 2000;
BA_DEF_ BO_  "GenMsgSendType" ENUM  "Cyclic","NoMsgSendType";
BA_DEF_ BO_  "GenMsgCycleTimeFast" INT 0 500;
BA_DEF_ BO_  "GenMsgDelayTime" INT 0 20;
BA_DEF_ BO_  "GenMsgILSupport" ENUM  "No","Yes";
BA_DEF_ BO_  "GenMsgNrOfRepetition" INT 0 3;
BA_DEF_ BO_  "VFrameFormat" ENUM  "StandardCAN","ExtendedCAN","reserved","reserved","reserved","reserved","reserved","reserved","reserved","reserved","reserved","reserved","reserved","reserved","StandardCAN_FD","ExtendedCAN_FD";
BA_DEF_ SG_  "UserSigValidity" ENUM  "B+","ACC","IG","IG1","IG2","IG3","IG1 or IG2","IG1 or IG3","Undef";
BA_DEF_ SG_  "TimeoutValue" STRING ;
BA_DEF_ SG_  "UsrSigPurpose" ENUM  "Undef","FN","DIAG","DIAG(Req)","DIAG(Res)","DIAG(Func)","DEV","CCP","NM","TP";
BA_DEF_ SG_  "GenSigStartValue" INT 0 1215752192;
BA_DEF_ SG_  "NetworkRequest" ENUM  "Yes","No";
BA_DEF_ SG_  "NetworkRequestHoldingTime" INT 0 65535;
BA_DEF_ SG_  "Description" STRING ;
BA_DEF_ SG_  "Version" STRING ;
BA_DEF_ SG_  "GenSigEnvVarType" ENUM  "Int","Float","Undef";
BA_DEF_ SG_  "GenSigSendType" ENUM  "Cyclic","OnWrite","OnWriteWithRepetition","OnChange","OnChangeWithRepetition","IfActive","IfActiveWithRepetition","NoSigSendType","OnChangeAndIfActive","OnChangeAndIfActiveWithRepetition";
BA_DEF_ SG_  "GwSigLatencyTime" INT 0 65536;
BA_DEF_ SG_  "GwSigMissingSourceType" ENUM  "Undef","OldValue","DefaultValue","InitialValue";
BA_DEF_ SG_  "NWM-WakeupAllowed" ENUM  "<n.a.>";
BA_DEF_ SG_  "RoutingFactor" INT 1 1215752192;
BA_DEF_ SG_  "SystemSignalLongSymbol" STRING ;
BA_DEF_REL_ BU_SG_REL_  "GenSigTimeoutTime" INT 0 7000;
BA_DEF_DEF_  "GenMsgEVName" "@Signame";
BA_DEF_DEF_  "NmAsrMessage" "No";
BA_DEF_DEF_  "DiagState" "No";
BA_DEF_DEF_  "DiagRequest" "No";
BA_DEF_DEF_  "TpMessage" "No";
BA_DEF_DEF_  "UsrMsgIDSforwardDeviation" 10;
BA_DEF_DEF_  "UsrMsgIDSbackwardDeviation" 100;
BA_DEF_DEF_  "GenMsgCycleTime" 200;
BA_DEF_DEF_  "GenMsgStartDelayTime" 0;
BA_DEF_DEF_  "GenMsgSendType" "NoMsgSendType";
BA_DEF_DEF_  "GenMsgCycleTimeFast" 40;
BA_DEF_DEF_  "GenMsgDelayTime" 20;
BA_DEF_DEF_  "GenMsgILSupport" "Yes";
BA_DEF_DEF_  "GenMsgNrOfRepetition" 3;
BA_DEF_DEF_  "VFrameFormat" "StandardCAN";
BA_DEF_DEF_  "UserSigValidity" "IG";
BA_DEF_DEF_  "TimeoutValue" "";
BA_DEF_DEF_  "UsrSigPurpose" "FN";
BA_DEF_DEF_  "GenSigStartValue" 0;
BA_DEF_DEF_  "NetworkRequest" "No";
BA_DEF_DEF_  "NetworkRequestHoldingTime" 0;
BA_DEF_DEF_  "Description" "";
BA_DEF_DEF_  "Version" "";
BA_DEF_DEF_  "GenSigEnvVarType" "Undef";
BA_DEF_DEF_  "GenSigSendType" "NoSigSendType";
BA_DEF_DEF_  "GwSigLatencyTime" 40;
BA_DEF_DEF_  "GwSigMissingSourceType" "Undef";
BA_DEF_DEF_  "NWM-WakeupAllowed" "<n.a.>";
BA_DEF_DEF_  "RoutingFactor" 1;
BA_DEF_DEF_REL_ "GenSigTimeoutTime" 500;
BA_DEF_DEF_  "SystemSignalLongSymbol" "";
BA_ "GenMsgSendType" BO_ 250 0;
BA_ "GenMsgCycleTime" BO_ 250 50;
BA_ "GenMsgCycleTimeFast" BO_ 250 0;
BA_ "GenMsgNrOfRepetition" BO_ 250 0;
BA_ "VFrameFormat" BO_ 250 14;
BA_ "GenMsgSendType" BO_ 1325 0;
BA_ "GenMsgCycleTime" BO_ 1325 500;
BA_ "VFrameFormat" BO_ 1325 14;
BA_ "GenMsgSendType" BO_ 112 0;
BA_ "GenMsgCycleTime" BO_ 112 50;
BA_ "GenMsgCycleTimeFast" BO_ 112 0;
BA_ "GenMsgNrOfRepetition" BO_ 112 0;
BA_ "VFrameFormat" BO_ 112 14;
BA_ "GenMsgCycleTime" BO_ 126 0;
BA_ "VFrameFormat" BO_ 126 14;
BA_ "GenMsgCycleTime" BO_ 2549874789 100;
BA_ "GenMsgCycleTimeFast" BO_ 2549874789 0;
BA_ "GenMsgDelayTime" BO_ 2549874789 10;
BA_ "GenMsgILSupport" BO_ 2549874789 0;
BA_ "GenMsgNrOfRepetition" BO_ 2549874789 0;
BA_ "NmAsrMessage" BO_ 2549874789 1;
BA_ "VFrameFormat" BO_ 2549874789 15;
BA_ "GenMsgCycleTime" BO_ 2549874826 100;
BA_ "GenMsgCycleTimeFast" BO_ 2549874826 0;
BA_ "GenMsgDelayTime" BO_ 2549874826 10;
BA_ "GenMsgILSupport" BO_ 2549874826 0;
BA_ "GenMsgNrOfRepetition" BO_ 2549874826 0;
BA_ "NmAsrMessage" BO_ 2549874826 1;
BA_ "VFrameFormat" BO_ 2549874826 15;
BA_ "GenMsgCycleTime" BO_ 2549874846 100;
BA_ "GenMsgCycleTimeFast" BO_ 2549874846 0;
BA_ "GenMsgDelayTime" BO_ 2549874846 10;
BA_ "GenMsgILSupport" BO_ 2549874846 0;
BA_ "GenMsgNrOfRepetition" BO_ 2549874846 0;
BA_ "NmAsrMessage" BO_ 2549874846 1;
BA_ "VFrameFormat" BO_ 2549874846 15;
BA_ "GenMsgCycleTime" BO_ 2549874837 100;
BA_ "GenMsgCycleTimeFast" BO_ 2549874837 0;
BA_ "GenMsgDelayTime" BO_ 2549874837 10;
BA_ "GenMsgILSupport" BO_ 2549874837 0;
BA_ "GenMsgNrOfRepetition" BO_ 2549874837 0;
BA_ "NmAsrMessage" BO_ 2549874837 1;
BA_ "VFrameFormat" BO_ 2549874837 15;
BA_ "GenMsgCycleTime" BO_ 2549874823 100;
BA_ "GenMsgCycleTimeFast" BO_ 2549874823 0;
BA_ "GenMsgDelayTime" BO_ 2549874823 10;
BA_ "GenMsgILSupport" BO_ 2549874823 0;
BA_ "GenMsgNrOfRepetition" BO_ 2549874823 0;
BA_ "NmAsrMessage" BO_ 2549874823 1;
BA_ "VFrameFormat" BO_ 2549874823 15;
BA_ "GenMsgCycleTime" BO_ 2549874858 100;
BA_ "GenMsgCycleTimeFast" BO_ 2549874858 0;
BA_ "GenMsgDelayTime" BO_ 2549874858 10;
BA_ "GenMsgILSupport" BO_ 2549874858 0;
BA_ "GenMsgNrOfRepetition" BO_ 2549874858 0;
BA_ "NmAsrMessage" BO_ 2549874858 1;
BA_ "VFrameFormat" BO_ 2549874858 15;
BA_ "GenMsgCycleTime" BO_ 2549874750 100;
BA_ "GenMsgCycleTimeFast" BO_ 2549874750 0;
BA_ "GenMsgDelayTime" BO_ 2549874750 10;
BA_ "GenMsgILSupport" BO_ 2549874750 0;
BA_ "GenMsgNrOfRepetition" BO_ 2549874750 0;
BA_ "NmAsrMessage" BO_ 2549874750 1;
BA_ "VFrameFormat" BO_ 2549874750 15;
BA_ "GenMsgCycleTime" BO_ 2549874905 100;
BA_ "GenMsgCycleTimeFast" BO_ 2549874905 0;
BA_ "GenMsgDelayTime" BO_ 2549874905 10;
BA_ "GenMsgILSupport" BO_ 2549874905 0;
BA_ "GenMsgNrOfRepetition" BO_ 2549874905 0;
BA_ "NmAsrMessage" BO_ 2549874905 1;
BA_ "VFrameFormat" BO_ 2549874905 15;
BA_ "GenMsgCycleTime" BO_ 2549874896 100;
BA_ "GenMsgCycleTimeFast" BO_ 2549874896 0;
BA_ "GenMsgDelayTime" BO_ 2549874896 10;
BA_ "GenMsgILSupport" BO_ 2549874896 0;
BA_ "GenMsgNrOfRepetition" BO_ 2549874896 0;
BA_ "NmAsrMessage" BO_ 2549874896 1;
BA_ "VFrameFormat" BO_ 2549874896 15;
BA_ "GenMsgCycleTime" BO_ 2549874881 100;
BA_ "GenMsgCycleTimeFast" BO_ 2549874881 0;
BA_ "GenMsgDelayTime" BO_ 2549874881 10;
BA_ "GenMsgILSupport" BO_ 2549874881 0;
BA_ "GenMsgNrOfRepetition" BO_ 2549874881 0;
BA_ "NmAsrMessage" BO_ 2549874881 1;
BA_ "VFrameFormat" BO_ 2549874881 15;
BA_ "Description" SG_ 250 HCU_Crc3Val "The data area for CRC calculation is based on the data length (DLC) of the message DB.

The CRC shall be calculated over the entire data block (excluding the CRC bytes) including the user data, alive counter and Data ID



- CRC Polynomial (0x1021) , Ini";
BA_ "GenSigStartValue" SG_ 250 HCU_Crc3Val 65535;
BA_ "UserSigValidity" SG_ 250 HCU_Crc3Val 3;
BA_ "RoutingFactor" SG_ 250 HCU_Crc3Val 5;
BA_ "Version" SG_ 250 HCU_Crc3Val "21.09.03";
BA_ "Description" SG_ 250 HCU_SpdLimDeviceActSta "Speed Limiter Device in Activation";
BA_ "UserSigValidity" SG_ 250 HCU_SpdLimDeviceActSta 3;
BA_ "RoutingFactor" SG_ 250 HCU_SpdLimDeviceActSta 5;
BA_ "Version" SG_ 250 HCU_SpdLimDeviceActSta "18.08.02";
BA_ "Description" SG_ 250 HCU_SpdLimDeviceOperSta "Speed Limiter Device in Operation";
BA_ "UserSigValidity" SG_ 250 HCU_SpdLimDeviceOperSta 3;
BA_ "RoutingFactor" SG_ 250 HCU_SpdLimDeviceOperSta 5;
BA_ "Version" SG_ 250 HCU_SpdLimDeviceOperSta "20.05.02";
BA_ "Description" SG_ 250 HCU_SpdLimDeviceVehSpdVal "Speed Limiter Vehicle Speed

This signal should be sent in km/h or MPH according to the “SPEED_UNIT” signal.

SPEED_UNIT = 0 : [km/h]

SPEED_UNIT = 1 : [MPH]";
BA_ "UserSigValidity" SG_ 250 HCU_SpdLimDeviceVehSpdVal 3;
BA_ "RoutingFactor" SG_ 250 HCU_SpdLimDeviceVehSpdVal 5;
BA_ "Version" SG_ 250 HCU_SpdLimDeviceVehSpdVal "21.07.05";
BA_ "Description" SG_ 250 HCU_SrvModSta "Service Test Mode";
BA_ "UserSigValidity" SG_ 250 HCU_SrvModSta 3;
BA_ "RoutingFactor" SG_ 250 HCU_SrvModSta 5;
BA_ "Version" SG_ 250 HCU_SrvModSta "18.08.02";
BA_ "Description" SG_ 250 HCU_StrtInhbt2Sta "Start Inhibit";
BA_ "UserSigValidity" SG_ 250 HCU_StrtInhbt2Sta 3;
BA_ "RoutingFactor" SG_ 250 HCU_StrtInhbt2Sta 5;
BA_ "Version" SG_ 250 HCU_StrtInhbt2Sta "18.08.02";
BA_ "Description" SG_ 250 HCU_StrtInhbtSta "HCU determine Start Inhibit state when HCU received Start Inhibit command from TMU";
BA_ "UserSigValidity" SG_ 250 HCU_StrtInhbtSta 3;
BA_ "RoutingFactor" SG_ 250 HCU_StrtInhbtSta 5;
BA_ "Version" SG_ 250 HCU_StrtInhbtSta "18.08.02";
BA_ "Description" SG_ 250 HCU_PdlRgnCmpnRear "Request for hydraulic brake compensation in paddle regeneration braking mode for rear motor";
BA_ "UserSigValidity" SG_ 250 HCU_PdlRgnCmpnRear 3;
BA_ "RoutingFactor" SG_ 250 HCU_PdlRgnCmpnRear 5;
BA_ "Version" SG_ 250 HCU_PdlRgnCmpnRear "23.03.00";
BA_ "Description" SG_ 250 HCU_VehStrtEnblSta "Start";
BA_ "UserSigValidity" SG_ 250 HCU_VehStrtEnblSta 3;
BA_ "RoutingFactor" SG_ 250 HCU_VehStrtEnblSta 5;
BA_ "Version" SG_ 250 HCU_VehStrtEnblSta "18.08.02";
BA_ "Description" SG_ 250 HCU_BrkLmpOnReq "Brake Lamp On Request";
BA_ "UserSigValidity" SG_ 250 HCU_BrkLmpOnReq 3;
BA_ "RoutingFactor" SG_ 250 HCU_BrkLmpOnReq 5;
BA_ "Version" SG_ 250 HCU_BrkLmpOnReq "19.06.02";
BA_ "Description" SG_ 250 HCU_CcDrvAlrtDis "CC must be disengaged by system or can not be engaged";
BA_ "UserSigValidity" SG_ 250 HCU_CcDrvAlrtDis 3;
BA_ "RoutingFactor" SG_ 250 HCU_CcDrvAlrtDis 5;
BA_ "Version" SG_ 250 HCU_CcDrvAlrtDis "19.12.07";
BA_ "Description" SG_ 250 HCU_SldDrvAlrtDis "SLD must be disengaged by system or cannot be engaged";
BA_ "UserSigValidity" SG_ 250 HCU_SldDrvAlrtDis 3;
BA_ "RoutingFactor" SG_ 250 HCU_SldDrvAlrtDis 5;
BA_ "Version" SG_ 250 HCU_SldDrvAlrtDis "20.01.01";
BA_ "Description" SG_ 250 HCU_WhlCrpCrpTqNmVal "Creep Torque at wheel (If MSB of high byte is 1, (PH) = 1 * (HEX) ? 65536 [Nm]

else (PH) = 1 * (HEX) [Nm])";
BA_ "UserSigValidity" SG_ 250 HCU_WhlCrpCrpTqNmVal 3;
BA_ "RoutingFactor" SG_ 250 HCU_WhlCrpCrpTqNmVal 5;
BA_ "Version" SG_ 250 HCU_WhlCrpCrpTqNmVal "18.08.02";
BA_ "Description" SG_ 250 LHCU_EngCltchTrnsfrTqPcVal_Copy_ "This signal indicates Engine Clutch Transfer Torque (If MSB of high byte is 1, (PH) = 0.1953125 * (HEX) -200 [%] Else (PH) = 0.1953125 * HEX) [%])";
BA_ "UserSigValidity" SG_ 250 LHCU_EngCltchTrnsfrTqPcVal_Copy_ 3;
BA_ "RoutingFactor" SG_ 250 LHCU_EngCltchTrnsfrTqPcVal_Copy_ 5;
BA_ "Version" SG_ 250 LHCU_EngCltchTrnsfrTqPcVal_Copy_ "18.08.12";
BA_ "SystemSignalLongSymbol" SG_ 250 LHCU_EngCltchTrnsfrTqPcVal_Copy_ "LHCU_EngCltchTrnsfrTqPcVal_Copy_1";
BA_ "Description" SG_ 250 HCU_RspaAlvCntVal "RSPA HCU Alive Counter";
BA_ "UserSigValidity" SG_ 250 HCU_RspaAlvCntVal 3;
BA_ "RoutingFactor" SG_ 250 HCU_RspaAlvCntVal 5;
BA_ "Version" SG_ 250 HCU_RspaAlvCntVal "19.01.12";
BA_ "Description" SG_ 250 HCU_RspaSta "HCU RSPA Cooperative control state";
BA_ "UserSigValidity" SG_ 250 HCU_RspaSta 3;
BA_ "RoutingFactor" SG_ 250 HCU_RspaSta 5;
BA_ "Version" SG_ 250 HCU_RspaSta "19.01.12";
BA_ "Description" SG_ 250 HCU_AlvCnt3Val "For the first transmission request for a data element the counter shall be initialized with 0 and shall be incremented by 1 for every subsequent send request. 

When the counter reaches the maximum value(0xFF), then it shall restart with 0 for the next s";
BA_ "UserSigValidity" SG_ 250 HCU_AlvCnt3Val 3;
BA_ "RoutingFactor" SG_ 250 HCU_AlvCnt3Val 5;
BA_ "Version" SG_ 250 HCU_AlvCnt3Val "21.09.03";
BA_ "Description" SG_ 250 HCU_RspaCanFailSta "HCU RSPA CAN Fail Status";
BA_ "UserSigValidity" SG_ 250 HCU_RspaCanFailSta 3;
BA_ "RoutingFactor" SG_ 250 HCU_RspaCanFailSta 5;
BA_ "Version" SG_ 250 HCU_RspaCanFailSta "19.01.12";
BA_ "Description" SG_ 250 HCU_PdlStopCtrlSta "Request Signal for Paddle B Stop Control";
BA_ "UserSigValidity" SG_ 250 HCU_PdlStopCtrlSta 3;
BA_ "RoutingFactor" SG_ 250 HCU_PdlStopCtrlSta 5;
BA_ "Version" SG_ 250 HCU_PdlStopCtrlSta "20.08.02";
BA_ "Description" SG_ 250 HCU_PdlRgnCmpn "Request for hydraulic brake compensation in paddle regeneration braking mode

( when the coasting tq decrease rapidly )";
BA_ "UserSigValidity" SG_ 250 HCU_PdlRgnCmpn 3;
BA_ "RoutingFactor" SG_ 250 HCU_PdlRgnCmpn 5;
BA_ "Version" SG_ 250 HCU_PdlRgnCmpn "21.07.05";
BA_ "Description" SG_ 250 HCU_RForwardRq "R gear forward drive request";
BA_ "UserSigValidity" SG_ 250 HCU_RForwardRq 3;
BA_ "RoutingFactor" SG_ 250 HCU_RForwardRq 5;
BA_ "Version" SG_ 250 HCU_RForwardRq "23.04.07";
BA_ "Description" SG_ 250 HCU_PdlStopReqTqNmVal "Request Brake tq for Paddle B Stop Control";
BA_ "UserSigValidity" SG_ 250 HCU_PdlStopReqTqNmVal 3;
BA_ "RoutingFactor" SG_ 250 HCU_PdlStopReqTqNmVal 5;
BA_ "Version" SG_ 250 HCU_PdlStopReqTqNmVal "20.08.02";
BA_ "Description" SG_ 250 HCU_GearRInhbtSta "Drive inhibit flag in reverse gear.";
BA_ "UserSigValidity" SG_ 250 HCU_GearRInhbtSta 3;
BA_ "RoutingFactor" SG_ 250 HCU_GearRInhbtSta 5;
BA_ "Version" SG_ 250 HCU_GearRInhbtSta "20.11.03";
BA_ "Description" SG_ 250 HCU_GreenzoneDistinctGen "Distict of an GDM's generation (including of function's activating)";
BA_ "UserSigValidity" SG_ 250 HCU_GreenzoneDistinctGen 3;
BA_ "NetworkRequest" SG_ 250 HCU_GreenzoneDistinctGen 0;
BA_ "NetworkRequestHoldingTime" SG_ 250 HCU_GreenzoneDistinctGen 1000;
BA_ "RoutingFactor" SG_ 250 HCU_GreenzoneDistinctGen 5;
BA_ "Version" SG_ 250 HCU_GreenzoneDistinctGen "22.10.20";
BA_ "Description" SG_ 250 HCU_2ndStpSig "Vehicle Stop Signal at 2nd Gear";
BA_ "UserSigValidity" SG_ 250 HCU_2ndStpSig 3;
BA_ "RoutingFactor" SG_ 250 HCU_2ndStpSig 5;
BA_ "Version" SG_ 250 HCU_2ndStpSig "24.08.08";
BA_ "Description" SG_ 250 HCU_Mg3SpdCmdVal "MG3 Motor Speed Control";
BA_ "UserSigValidity" SG_ 250 HCU_Mg3SpdCmdVal 3;
BA_ "RoutingFactor" SG_ 250 HCU_Mg3SpdCmdVal 5;
BA_ "Version" SG_ 250 HCU_Mg3SpdCmdVal "23.02.09";
BA_ "Description" SG_ 250 HCU_Mg3TqPcReq "MG3 Motor Torque Control command (If MSB of high byte is 1, (PH) = 0.1953125 * (HEX) -200 [%] Else (PH) = 0.1953125 * (HEX) [%])";
BA_ "UserSigValidity" SG_ 250 HCU_Mg3TqPcReq 3;
BA_ "RoutingFactor" SG_ 250 HCU_Mg3TqPcReq 5;
BA_ "Version" SG_ 250 HCU_Mg3TqPcReq "23.02.09";
BA_ "Description" SG_ 250 HCU_Mg3DisChrgTqCmdPcVal_FS "This signal indicates to control MG3 motor discharge limit torque for Anti-Jerk. (If MSB of high byte is 1, (PH) = 0.1953125 * (HEX) ? 200 [%] Else (PH) = 0.1953125 * (HEX) [%])";
BA_ "UserSigValidity" SG_ 250 HCU_Mg3DisChrgTqCmdPcVal_FS 3;
BA_ "RoutingFactor" SG_ 250 HCU_Mg3DisChrgTqCmdPcVal_FS 5;
BA_ "Version" SG_ 250 HCU_Mg3DisChrgTqCmdPcVal_FS "23.04.00";
BA_ "Description" SG_ 250 HCU_Mg3ChrgTqCmdPcVal_FS "This signal indicates to control MG3 motor charge limit torque for Anti-Jerk (If MSB of high byte is 1, (PH) = 0.1953125 * (HEX) ? 200 [%] Else (PH) = 0.1953125 * (HEX) [%])";
BA_ "UserSigValidity" SG_ 250 HCU_Mg3ChrgTqCmdPcVal_FS 3;
BA_ "RoutingFactor" SG_ 250 HCU_Mg3ChrgTqCmdPcVal_FS 5;
BA_ "Version" SG_ 250 HCU_Mg3ChrgTqCmdPcVal_FS "23.04.00";
BA_ "Description" SG_ 250 HCU_11sMaxSpdLimOperSta "110kph Max Speed Limitation Status for 11 passenger vehicle";
BA_ "UserSigValidity" SG_ 250 HCU_11sMaxSpdLimOperSta 3;
BA_ "RoutingFactor" SG_ 250 HCU_11sMaxSpdLimOperSta 5;
BA_ "Version" SG_ 250 HCU_11sMaxSpdLimOperSta "23.09.04";
BA_ "Description" SG_ 250 HCU_PMPDUsmSta "HCU PMPD set Value for USM";
BA_ "UserSigValidity" SG_ 250 HCU_PMPDUsmSta 3;
BA_ "RoutingFactor" SG_ 250 HCU_PMPDUsmSta 5;
BA_ "Version" SG_ 250 HCU_PMPDUsmSta "24.10.03";
BA_ "Description" SG_ 250 HCU_DrvWhlDmndTqNmVal "Driver's Demand Torque Restricted by Battery Limit and HHT Temperature (If MSB of high byte is 1, (PH) = 1 * (HEX) ? 65536 [Nm]

else (PH) = 1 * (HEX) [Nm])";
BA_ "UserSigValidity" SG_ 250 HCU_DrvWhlDmndTqNmVal 3;
BA_ "RoutingFactor" SG_ 250 HCU_DrvWhlDmndTqNmVal 5;
BA_ "Version" SG_ 250 HCU_DrvWhlDmndTqNmVal "18.08.02";
BA_ "Description" SG_ 250 HCU_PMPDActSta "PMPD Function Active State";
BA_ "UserSigValidity" SG_ 250 HCU_PMPDActSta 3;
BA_ "RoutingFactor" SG_ 250 HCU_PMPDActSta 5;
BA_ "Version" SG_ 250 HCU_PMPDActSta "24.10.03";
BA_ "Description" SG_ 250 HCU_PMPDWarnSta "PMPD Function Warning State";
BA_ "UserSigValidity" SG_ 250 HCU_PMPDWarnSta 3;
BA_ "RoutingFactor" SG_ 250 HCU_PMPDWarnSta 5;
BA_ "Version" SG_ 250 HCU_PMPDWarnSta "25.01.00";
BA_ "Description" SG_ 250 HCU_STAYModSta "STAY MODE operation status";
BA_ "UserSigValidity" SG_ 250 HCU_STAYModSta 3;
BA_ "RoutingFactor" SG_ 250 HCU_STAYModSta 5;
BA_ "Version" SG_ 250 HCU_STAYModSta "24.06.00";
BA_ "Description" SG_ 250 HCU_STAYModWarnSta "Determining the Warning Status for STAY MODE Operation";
BA_ "UserSigValidity" SG_ 250 HCU_STAYModWarnSta 3;
BA_ "RoutingFactor" SG_ 250 HCU_STAYModWarnSta 5;
BA_ "Version" SG_ 250 HCU_STAYModWarnSta "24.07.01";
BA_ "Description" SG_ 250 HCU_STAYModReservationSta "This signal is the USM status feedback signal for the STAY MODE reservation request";
BA_ "UserSigValidity" SG_ 250 HCU_STAYModReservationSta 3;
BA_ "RoutingFactor" SG_ 250 HCU_STAYModReservationSta 5;
BA_ "Version" SG_ 250 HCU_STAYModReservationSta "24.07.01";
BA_ "Description" SG_ 250 HCU_STAYModBattMngmntSta "This signal is the cluster alarm signal for pre-charge mode condition";
BA_ "UserSigValidity" SG_ 250 HCU_STAYModBattMngmntSta 3;
BA_ "RoutingFactor" SG_ 250 HCU_STAYModBattMngmntSta 5;
BA_ "Version" SG_ 250 HCU_STAYModBattMngmntSta "24.07.01";
BA_ "Description" SG_ 250 HCU_Mg3AntJrkInhbtReq "MG3 Motor Anti-jerk Inhibition";
BA_ "GenSigStartValue" SG_ 250 HCU_Mg3AntJrkInhbtReq 1;
BA_ "UserSigValidity" SG_ 250 HCU_Mg3AntJrkInhbtReq 3;
BA_ "RoutingFactor" SG_ 250 HCU_Mg3AntJrkInhbtReq 5;
BA_ "Version" SG_ 250 HCU_Mg3AntJrkInhbtReq "23.02.09";
BA_ "Description" SG_ 250 HCU_Mg3CtrlModReq "MG3 Motor Control Mode Command";
BA_ "GenSigStartValue" SG_ 250 HCU_Mg3CtrlModReq 1;
BA_ "UserSigValidity" SG_ 250 HCU_Mg3CtrlModReq 3;
BA_ "RoutingFactor" SG_ 250 HCU_Mg3CtrlModReq 5;
BA_ "Version" SG_ 250 HCU_Mg3CtrlModReq "23.02.09";
BA_ "Description" SG_ 250 HCU_Mg3PwmOffInhbtSta "HCU_Mg3PwmOffInhbtSta indicates precise MG3 motor torque control is necessary.

If this signal is on, MCU should generate torque accordance with HCU torque command.";
BA_ "UserSigValidity" SG_ 250 HCU_Mg3PwmOffInhbtSta 3;
BA_ "RoutingFactor" SG_ 250 HCU_Mg3PwmOffInhbtSta 5;
BA_ "Version" SG_ 250 HCU_Mg3PwmOffInhbtSta "23.02.09";
BA_ "Description" SG_ 250 HCU_Mg3PwrEnaSta "MG3 Motor Power Enable";
BA_ "UserSigValidity" SG_ 250 HCU_Mg3PwrEnaSta 3;
BA_ "RoutingFactor" SG_ 250 HCU_Mg3PwrEnaSta 5;
BA_ "Version" SG_ 250 HCU_Mg3PwrEnaSta "23.02.09";
BA_ "Description" SG_ 250 HCU_SmartRegen_HeadwayDstSet "Smart regen distance user set level";
BA_ "UserSigValidity" SG_ 250 HCU_SmartRegen_HeadwayDstSet 7;
BA_ "RoutingFactor" SG_ 250 HCU_SmartRegen_HeadwayDstSet 5;
BA_ "Version" SG_ 250 HCU_SmartRegen_HeadwayDstSet "25.01.00";
BA_ "Description" SG_ 250 HCU_EstAccelPdlPcVal "Speed Control Status";
BA_ "UserSigValidity" SG_ 250 HCU_EstAccelPdlPcVal 3;
BA_ "RoutingFactor" SG_ 250 HCU_EstAccelPdlPcVal 5;
BA_ "Version" SG_ 250 HCU_EstAccelPdlPcVal "18.08.02";
BA_ "Description" SG_ 250 HCU_EstApsSelSta "HCU Estimated APS Select when Cruise Mode";
BA_ "UserSigValidity" SG_ 250 HCU_EstApsSelSta 3;
BA_ "RoutingFactor" SG_ 250 HCU_EstApsSelSta 5;
BA_ "Version" SG_ 250 HCU_EstApsSelSta "18.08.02";
BA_ "Description" SG_ 250 HCU_GreenZoneDrvModSta "0x0:Default (USM 미 표출 (메뉴삭제))

0x1:Off (USM 표출 Off 상태 표시)

0x2:On (USM 표출 On 상태 표시

0x3:reserved";
BA_ "UserSigValidity" SG_ 250 HCU_GreenZoneDrvModSta 3;
BA_ "RoutingFactor" SG_ 250 HCU_GreenZoneDrvModSta 5;
BA_ "Version" SG_ 250 HCU_GreenZoneDrvModSta "18.08.02";
BA_ "Description" SG_ 250 HCU_GreenZoneLmpDis "Indicate Green Zone Area";
BA_ "UserSigValidity" SG_ 250 HCU_GreenZoneLmpDis 3;
BA_ "RoutingFactor" SG_ 250 HCU_GreenZoneLmpDis 5;
BA_ "Version" SG_ 250 HCU_GreenZoneLmpDis "18.08.02";
BA_ "Description" SG_ 250 HCU_HcuRdySta "Hybrid Control Unit ready";
BA_ "UserSigValidity" SG_ 250 HCU_HcuRdySta 3;
BA_ "RoutingFactor" SG_ 250 HCU_HcuRdySta 5;
BA_ "Version" SG_ 250 HCU_HcuRdySta "18.08.02";
BA_ "Description" SG_ 250 HCU_HEVRdyDis "This signal indicates whether “READY” lamp on cluster turns on or off.";
BA_ "UserSigValidity" SG_ 250 HCU_HEVRdyDis 3;
BA_ "RoutingFactor" SG_ 250 HCU_HEVRdyDis 5;
BA_ "Version" SG_ 250 HCU_HEVRdyDis "19.09.02";
BA_ "Description" SG_ 250 HCU_HevRdySta "Hybrid Vehicle Drivable ready";
BA_ "UserSigValidity" SG_ 250 HCU_HevRdySta 3;
BA_ "RoutingFactor" SG_ 250 HCU_HevRdySta 5;
BA_ "Version" SG_ 250 HCU_HevRdySta "18.08.02";
BA_ "Description" SG_ 250 HCU_LimpOffSta "Limp off the road";
BA_ "UserSigValidity" SG_ 250 HCU_LimpOffSta 3;
BA_ "RoutingFactor" SG_ 250 HCU_LimpOffSta 5;
BA_ "Version" SG_ 250 HCU_LimpOffSta "18.08.02";
BA_ "Description" SG_ 250 HCU_MILOnReq "HCU sends this signal to turn on the Malfunction Indicator Lamp (MIL).";
BA_ "UserSigValidity" SG_ 250 HCU_MILOnReq 3;
BA_ "RoutingFactor" SG_ 250 HCU_MILOnReq 5;
BA_ "Version" SG_ 250 HCU_MILOnReq "18.08.02";
BA_ "Description" SG_ 250 HCU_PhevAutoModOnSta "PHEV Auto CD CS Mode";
BA_ "UserSigValidity" SG_ 250 HCU_PhevAutoModOnSta 3;
BA_ "RoutingFactor" SG_ 250 HCU_PhevAutoModOnSta 5;
BA_ "Version" SG_ 250 HCU_PhevAutoModOnSta "20.04.02";
BA_ "Description" SG_ 250 HCU_SccDrvOvrdReq "CF_Hcu_Ovrride ※ Start Value : set bit 

Override Drive by driver request during SCC";
BA_ "UserSigValidity" SG_ 250 HCU_SccDrvOvrdReq 3;
BA_ "RoutingFactor" SG_ 250 HCU_SccDrvOvrdReq 5;
BA_ "Version" SG_ 250 HCU_SccDrvOvrdReq "18.08.02";
BA_ "Description" SG_ 250 HCU_SccEnblSta "Smart Cruise Control Enable";
BA_ "UserSigValidity" SG_ 250 HCU_SccEnblSta 3;
BA_ "RoutingFactor" SG_ 250 HCU_SccEnblSta 5;
BA_ "Version" SG_ 250 HCU_SccEnblSta "18.08.02";
BA_ "Description" SG_ 250 HCU_SlwDnSta "HCU determine slowdown state when HCU received slowdown command from TMU";
BA_ "UserSigValidity" SG_ 250 HCU_SlwDnSta 3;
BA_ "RoutingFactor" SG_ 250 HCU_SlwDnSta 5;
BA_ "Version" SG_ 250 HCU_SlwDnSta "18.08.02";
BA_ "Description" SG_ 250 HCU_SmrtEcoGdDis "This signal indicates whether Smart eco guide displays or not. Display equipment(clutster) follows the direction of the value of this signal.";
BA_ "UserSigValidity" SG_ 250 HCU_SmrtEcoGdDis 3;
BA_ "RoutingFactor" SG_ 250 HCU_SmrtEcoGdDis 5;
BA_ "Version" SG_ 250 HCU_SmrtEcoGdDis "18.08.02";
BA_ "Description" SG_ 250 HCU_SmrtEcoLvlDis "This signal is used on the cluster which displays the current driver's demand for Smart eco guide.";
BA_ "UserSigValidity" SG_ 250 HCU_SmrtEcoLvlDis 3;
BA_ "RoutingFactor" SG_ 250 HCU_SmrtEcoLvlDis 5;
BA_ "Version" SG_ 250 HCU_SmrtEcoLvlDis "18.08.02";
BA_ "Description" SG_ 250 HCU_SmrtEcoRngDis "This signal is used on the cluster which guides a driver to drive the car economically.It is variable regarding driving condition such as the road, traffic and so on.";
BA_ "UserSigValidity" SG_ 250 HCU_SmrtEcoRngDis 3;
BA_ "RoutingFactor" SG_ 250 HCU_SmrtEcoRngDis 5;
BA_ "Version" SG_ 250 HCU_SmrtEcoRngDis "18.08.02";
BA_ "Description" SG_ 1325 BLTN_CAM_ADAS_PRK_Crc0Val "The data area for CRC calculation is based on the data length (DLC) of the message DB.

The CRC shall be calculated over the entire data block (excluding the CRC bytes) including the user data, alive counter and Data ID



- CRC Polynomial (0x1021) , Ini";
BA_ "GenSigSendType" SG_ 1325 BLTN_CAM_ADAS_PRK_Crc0Val 4;
BA_ "GenSigStartValue" SG_ 1325 BLTN_CAM_ADAS_PRK_Crc0Val 65535;
BA_ "UserSigValidity" SG_ 1325 BLTN_CAM_ADAS_PRK_Crc0Val 0;
BA_ "RoutingFactor" SG_ 1325 BLTN_CAM_ADAS_PRK_Crc0Val 0;
BA_ "Version" SG_ 1325 BLTN_CAM_ADAS_PRK_Crc0Val "25.07.04";
BA_ "Description" SG_ 1325 BLTN_CAM_ADAS_PRK_AlvCnt0Val "For the first transmission request for a data element the counter shall be initialized with 0 and shall be incremented by 1 for every subsequent send request. 

When the counter reaches the maximum value(0xFF), then it shall restart with 0 for the next s";
BA_ "GenSigSendType" SG_ 1325 BLTN_CAM_ADAS_PRK_AlvCnt0Val 4;
BA_ "UserSigValidity" SG_ 1325 BLTN_CAM_ADAS_PRK_AlvCnt0Val 0;
BA_ "RoutingFactor" SG_ 1325 BLTN_CAM_ADAS_PRK_AlvCnt0Val 0;
BA_ "Version" SG_ 1325 BLTN_CAM_ADAS_PRK_AlvCnt0Val "25.07.04";
BA_ "Description" SG_ 1325 BLTN_CAM_I2CMasterSta_Left "This signal indicates a I²C master device in order to control SVM LH camera.



0x0: Default

0x1: BLTN_CAM is a master device on I²C bus

0x2: ADAS_PRK is a master device on I²C bus

0x3: Invalid";
BA_ "GenSigSendType" SG_ 1325 BLTN_CAM_I2CMasterSta_Left 4;
BA_ "UserSigValidity" SG_ 1325 BLTN_CAM_I2CMasterSta_Left 0;
BA_ "RoutingFactor" SG_ 1325 BLTN_CAM_I2CMasterSta_Left 0;
BA_ "Version" SG_ 1325 BLTN_CAM_I2CMasterSta_Left "25.07.04";
BA_ "Description" SG_ 1325 BLTN_CAM_I2CMasterSta_Right "This signal indicates a I²C master device in order to control SVM RH camera.



0x0: Default

0x1: BLTN_CAM is a master device on I²C bus

0x2: ADAS_PRK is a master device on I²C bus

0x3: Invalid";
BA_ "GenSigSendType" SG_ 1325 BLTN_CAM_I2CMasterSta_Right 4;
BA_ "UserSigValidity" SG_ 1325 BLTN_CAM_I2CMasterSta_Right 0;
BA_ "RoutingFactor" SG_ 1325 BLTN_CAM_I2CMasterSta_Right 0;
BA_ "Version" SG_ 1325 BLTN_CAM_I2CMasterSta_Right "25.07.04";
BA_ "Description" SG_ 1325 BLTN_CAM_CamSta_Left "The signal indicates status of SVM LH camera.";
BA_ "GenSigSendType" SG_ 1325 BLTN_CAM_CamSta_Left 4;
BA_ "UserSigValidity" SG_ 1325 BLTN_CAM_CamSta_Left 0;
BA_ "RoutingFactor" SG_ 1325 BLTN_CAM_CamSta_Left 0;
BA_ "Version" SG_ 1325 BLTN_CAM_CamSta_Left "25.07.04";
BA_ "Description" SG_ 1325 BLTN_CAM_CamSta_Right "The signal indicates status of SVM RH camera.";
BA_ "GenSigSendType" SG_ 1325 BLTN_CAM_CamSta_Right 4;
BA_ "UserSigValidity" SG_ 1325 BLTN_CAM_CamSta_Right 0;
BA_ "RoutingFactor" SG_ 1325 BLTN_CAM_CamSta_Right 0;
BA_ "Version" SG_ 1325 BLTN_CAM_CamSta_Right "25.07.04";
BA_ "Description" SG_ 112 HTCU_Crc5Val "The data area for CRC calculation is based on the data length (DLC) of the message DB.

The CRC shall be calculated over the entire data block (excluding the CRC bytes) including the user data, alive counter and Data ID

 

- CRC Polynomial (0x1021) , In";
BA_ "GenSigStartValue" SG_ 112 HTCU_Crc5Val 65535;
BA_ "UserSigValidity" SG_ 112 HTCU_Crc5Val 3;
BA_ "RoutingFactor" SG_ 112 HTCU_Crc5Val 5;
BA_ "Version" SG_ 112 HTCU_Crc5Val "19.10.00";
BA_ "Description" SG_ 112 HDCT_TqIncReq "An Identifier of a DCT HTCU controller for increasing torque intervention. 



This bit is to prevent the triggering of unintended DCT HTCU interventions.";
BA_ "UserSigValidity" SG_ 112 HDCT_TqIncReq 3;
BA_ "RoutingFactor" SG_ 112 HDCT_TqIncReq 5;
BA_ "Version" SG_ 112 HDCT_TqIncReq "19.10.01";
BA_ "Description" SG_ 112 HDCT_TqIncVal "The HTCU requests the engine RPM increase via the signal HTCU_TqIncPcVal to the EMS..

The requested torque HTCU_TqIncPcVal refers to maximum torque CR_Ems_TqStd_Nm. This conversion into a physical quantity provides a range of CR_Ems_TqStd_Nm of 0..99.60";
BA_ "UserSigValidity" SG_ 112 HDCT_TqIncVal 3;
BA_ "RoutingFactor" SG_ 112 HDCT_TqIncVal 5;
BA_ "Version" SG_ 112 HDCT_TqIncVal "20.05.02";
BA_ "UserSigValidity" SG_ 112 HDCT_EOLReq 3;
BA_ "RoutingFactor" SG_ 112 HDCT_EOLReq 5;
BA_ "Version" SG_ 112 HDCT_EOLReq "19.10.01";
BA_ "Description" SG_ 112 HDCT_CltchSta "Status of DCT clutches. This signal gives information about the frictional connection between the engine and the drive train.";
BA_ "UserSigValidity" SG_ 112 HDCT_CltchSta 3;
BA_ "RoutingFactor" SG_ 112 HDCT_CltchSta 5;
BA_ "Version" SG_ 112 HDCT_CltchSta "19.10.01";
BA_ "UserSigValidity" SG_ 112 HDCT_DblCltchSta 3;
BA_ "RoutingFactor" SG_ 112 HDCT_DblCltchSta 5;
BA_ "Version" SG_ 112 HDCT_DblCltchSta "19.10.01";
BA_ "Description" SG_ 112 HDCT_AcnChrgInhbtReq "Inhibit changes of engine torque. e.g. by changing status of the air condition.";
BA_ "UserSigValidity" SG_ 112 HDCT_AcnChrgInhbtReq 3;
BA_ "RoutingFactor" SG_ 112 HDCT_AcnChrgInhbtReq 5;
BA_ "Version" SG_ 112 HDCT_AcnChrgInhbtReq "19.10.01";
BA_ "UserSigValidity" SG_ 112 HDCT_SlipCrnkAllw 3;
BA_ "RoutingFactor" SG_ 112 HDCT_SlipCrnkAllw 5;
BA_ "Version" SG_ 112 HDCT_SlipCrnkAllw "19.10.01";
BA_ "UserSigValidity" SG_ 112 HDCT_KckDnSkpShftCnt 3;
BA_ "RoutingFactor" SG_ 112 HDCT_KckDnSkpShftCnt 5;
BA_ "Version" SG_ 112 HDCT_KckDnSkpShftCnt "19.10.01";
BA_ "Description" SG_ 112 HDCT_FuelCutReq "Fuel Cut request bit signal to let EMS perform ‘Fuel Cut torque intervention’ during shift.";
BA_ "UserSigValidity" SG_ 112 HDCT_FuelCutReq 3;
BA_ "RoutingFactor" SG_ 112 HDCT_FuelCutReq 5;
BA_ "Version" SG_ 112 HDCT_FuelCutReq "19.10.02";
BA_ "Description" SG_ 112 HDCT_NCoastTrgtGear "Target Gear Information to Control of gN Coast Down";
BA_ "UserSigValidity" SG_ 112 HDCT_NCoastTrgtGear 3;
BA_ "RoutingFactor" SG_ 112 HDCT_NCoastTrgtGear 5;
BA_ "Version" SG_ 112 HDCT_NCoastTrgtGear "19.10.02";
BA_ "Description" SG_ 112 HDCT_NCoastDnReq "Act of gN Coast Down 

(Requested of Not Requested)";
BA_ "UserSigValidity" SG_ 112 HDCT_NCoastDnReq 3;
BA_ "RoutingFactor" SG_ 112 HDCT_NCoastDnReq 5;
BA_ "Version" SG_ 112 HDCT_NCoastDnReq "19.10.02";
BA_ "Description" SG_ 112 HDCT_CLUEngSpd "Engine RPM from TCU(only for the display on Cluster)";
BA_ "UserSigValidity" SG_ 112 HDCT_CLUEngSpd 3;
BA_ "RoutingFactor" SG_ 112 HDCT_CLUEngSpd 5;
BA_ "Version" SG_ 112 HDCT_CLUEngSpd "19.10.02";
BA_ "Description" SG_ 112 HDCT_CLUEngSpdFlag "Flag for Engine RPM(from ECU) Display on Cluster, Only when this flag is set to 1, Cluster shall display the Engine RPM from TCU";
BA_ "UserSigValidity" SG_ 112 HDCT_CLUEngSpdFlag 3;
BA_ "RoutingFactor" SG_ 112 HDCT_CLUEngSpdFlag 5;
BA_ "Version" SG_ 112 HDCT_CLUEngSpdFlag "19.10.02";
BA_ "Description" SG_ 112 HDCT_CLUTrgtGear "This target gear signal is only for Cluster.



It is different with HTCU_TrgtGearSta.";
BA_ "UserSigValidity" SG_ 112 HDCT_CLUTrgtGear 3;
BA_ "RoutingFactor" SG_ 112 HDCT_CLUTrgtGear 5;
BA_ "Version" SG_ 112 HDCT_CLUTrgtGear "19.10.02";
BA_ "Description" SG_ 112 HDCT_GSITrgtGear "Target Gear Information for Gear Shift Indicator";
BA_ "UserSigValidity" SG_ 112 HDCT_GSITrgtGear 3;
BA_ "RoutingFactor" SG_ 112 HDCT_GSITrgtGear 5;
BA_ "Version" SG_ 112 HDCT_GSITrgtGear "19.10.02";
BA_ "Description" SG_ 112 HDCT_PtrnGear "Pattern Gear from Transsmision";
BA_ "UserSigValidity" SG_ 112 HDCT_PtrnGear 3;
BA_ "RoutingFactor" SG_ 112 HDCT_PtrnGear 5;
BA_ "Version" SG_ 112 HDCT_PtrnGear "25.06.00";
BA_ "Description" SG_ 112 HTCU_AlvCnt5Val "For the first transmission request for a data element the counter shall be initialized with 0 and shall be incremented by 1 for every subsequent send request. 

When the counter reaches the maximum value(0xFF), then it shall restart with 0 for the next s";
BA_ "UserSigValidity" SG_ 112 HTCU_AlvCnt5Val 3;
BA_ "RoutingFactor" SG_ 112 HTCU_AlvCnt5Val 5;
BA_ "Version" SG_ 112 HTCU_AlvCnt5Val "19.10.00";
BA_ "Description" SG_ 112 HDCT_AddtnlTqLssVal "Additional torque loss";
BA_ "UserSigValidity" SG_ 112 HDCT_AddtnlTqLssVal 3;
BA_ "RoutingFactor" SG_ 112 HDCT_AddtnlTqLssVal 5;
BA_ "Version" SG_ 112 HDCT_AddtnlTqLssVal "19.10.01";
BA_ "Description" SG_ 112 HDCT_OBDSta "The signal HDCT_ObdSta is used to inform the OBD master (EMS-ECU) in case a OBD relevant fault is detected. According to the OBD regulations the HTCU could request MIL on, MIL blinking and freeze frame storage. If a freeze frame request by the HTCU has n";
BA_ "UserSigValidity" SG_ 112 HDCT_OBDSta 3;
BA_ "RoutingFactor" SG_ 112 HDCT_OBDSta 5;
BA_ "Version" SG_ 112 HDCT_OBDSta "19.10.01";
BA_ "Description" SG_ 112 HDCT_OBDErrSta "Informs about the presence of an OBD-relevant error in the HTCU.

When an OBD-relevant error detected HDCT_ObdErrSta is set to 1 and the related DTC(s) would be recorded into non-volatile memory. Even if the error is not detected currently, HDCT_ObdErrSt";
BA_ "UserSigValidity" SG_ 112 HDCT_OBDErrSta 3;
BA_ "RoutingFactor" SG_ 112 HDCT_OBDErrSta 5;
BA_ "Version" SG_ 112 HDCT_OBDErrSta "19.10.01";
BA_ "Description" SG_ 112 HDCT_StcShftLrchCtrl "Static shift DR or RD lurch control";
BA_ "UserSigValidity" SG_ 112 HDCT_StcShftLrchCtrl 3;
BA_ "RoutingFactor" SG_ 112 HDCT_StcShftLrchCtrl 5;
BA_ "Version" SG_ 112 HDCT_StcShftLrchCtrl "19.10.01";
BA_ "Description" SG_ 112 HDCT_EngCltchLmphmMod "Engine clutch limp-home control activation";
BA_ "UserSigValidity" SG_ 112 HDCT_EngCltchLmphmMod 3;
BA_ "RoutingFactor" SG_ 112 HDCT_EngCltchLmphmMod 5;
BA_ "Version" SG_ 112 HDCT_EngCltchLmphmMod "19.10.01";
BA_ "UserSigValidity" SG_ 112 HDCT_CurrPrgrm 3;
BA_ "RoutingFactor" SG_ 112 HDCT_CurrPrgrm 5;
BA_ "Version" SG_ 112 HDCT_CurrPrgrm "19.10.01";
BA_ "Description" SG_ 112 HDCT_FltSta "informs about status of transmission control.



<Value Description>

Bit 0: TCU Diagnostic failure

Bit 1: TCU Diagnostic failure ? Limphome activated

Bit 2: OPU/EOP Diagnostic failure";
BA_ "UserSigValidity" SG_ 112 HDCT_FltSta 3;
BA_ "RoutingFactor" SG_ 112 HDCT_FltSta 5;
BA_ "Version" SG_ 112 HDCT_FltSta "20.02.00";
BA_ "Description" SG_ 112 HDCT_MCUAntJrkInhbt "MCU anti-jerk inhibition";
BA_ "UserSigValidity" SG_ 112 HDCT_MCUAntJrkInhbt 3;
BA_ "RoutingFactor" SG_ 112 HDCT_MCUAntJrkInhbt 5;
BA_ "Version" SG_ 112 HDCT_MCUAntJrkInhbt "19.10.01";
BA_ "Description" SG_ 112 HDCT_TrgtGear "HTCU_TrgtGearSta informs about the speed, which is currently engaged in the gearbox, or, in case of a gear change (HTCU_GearChgSta), which speed is reached.

Note: Gear changes covering more than one speed are also possible.

In the P and N positions, th";
BA_ "UserSigValidity" SG_ 112 HDCT_TrgtGear 3;
BA_ "RoutingFactor" SG_ 112 HDCT_TrgtGear 5;
BA_ "Version" SG_ 112 HDCT_TrgtGear "19.10.01";
BA_ "Description" SG_ 112 HDCT_CurrGear "CUR_GR indicates the gear speed which is currently engaged in the gearbox.";
BA_ "UserSigValidity" SG_ 112 HDCT_CurrGear 3;
BA_ "RoutingFactor" SG_ 112 HDCT_CurrGear 5;
BA_ "Version" SG_ 112 HDCT_CurrGear "19.10.01";
BA_ "Description" SG_ 112 HDCT_GearSelDis "Position (P, R, N..), which was identified by the gear selector.

In case the gear selector is in a intermediate position, the last clear recognized position is used.

There is no specific phase relationship between the output and any other signal.";
BA_ "GenSigStartValue" SG_ 112 HDCT_GearSelDis 9;
BA_ "UserSigValidity" SG_ 112 HDCT_GearSelDis 3;
BA_ "RoutingFactor" SG_ 112 HDCT_GearSelDis 5;
BA_ "Version" SG_ 112 HDCT_GearSelDis "25.02.03";
BA_ "Description" SG_ 112 HDCT_TCURdySta "Flag that the HTCU is ready to work. (In fact, this flag is true from the moment that CAN is working. So, normally no “false” will be sent on CAN.) This flag does not show that everything is alright in the HTCU. This information is given in the warning";
BA_ "UserSigValidity" SG_ 112 HDCT_TCURdySta 3;
BA_ "RoutingFactor" SG_ 112 HDCT_TCURdySta 5;
BA_ "Version" SG_ 112 HDCT_TCURdySta "19.10.01";
BA_ "Description" SG_ 112 HDCT_CtrlablSta "CF_Tcu_Cont indicates the status of the HTCU control which normally works by hydraulic pressure in the T/M";
BA_ "UserSigValidity" SG_ 112 HDCT_CtrlablSta 3;
BA_ "RoutingFactor" SG_ 112 HDCT_CtrlablSta 5;
BA_ "Version" SG_ 112 HDCT_CtrlablSta "19.10.01";
BA_ "Description" SG_ 112 HDCT_TrgtShftCls "HTCU Shift Target Class";
BA_ "UserSigValidity" SG_ 112 HDCT_TrgtShftCls 3;
BA_ "RoutingFactor" SG_ 112 HDCT_TrgtShftCls 5;
BA_ "Version" SG_ 112 HDCT_TrgtShftCls "19.10.01";
BA_ "Description" SG_ 112 HDCT_ShftPhase "HDCT_ShftPhaseSta informs about control shift phase of the release element or apply element during shifting.";
BA_ "UserSigValidity" SG_ 112 HDCT_ShftPhase 3;
BA_ "RoutingFactor" SG_ 112 HDCT_ShftPhase 5;
BA_ "Version" SG_ 112 HDCT_ShftPhase "19.10.01";
BA_ "Description" SG_ 112 HDCT_NetrlCtrlSta "This signal indicates the status of Neutral Control Response.";
BA_ "UserSigValidity" SG_ 112 HDCT_NetrlCtrlSta 3;
BA_ "RoutingFactor" SG_ 112 HDCT_NetrlCtrlSta 5;
BA_ "Version" SG_ 112 HDCT_NetrlCtrlSta "19.10.01";
BA_ "Description" SG_ 112 HDCT_GearShftSta "HTCU_GearChgSta indicates whether a gear change is being executed in the gearbox.

Note : Gear change means a gear shift at D-range and Garage shift(PRND).";
BA_ "UserSigValidity" SG_ 112 HDCT_GearShftSta 3;
BA_ "RoutingFactor" SG_ 112 HDCT_GearShftSta 5;
BA_ "Version" SG_ 112 HDCT_GearShftSta "19.10.01";
BA_ "Description" SG_ 112 HDCT_TqRdctnVal "The HTCU requests a torque reduction via the signal CR_Tcu_TqInt_Pc to the ECU and MCU.

The requested torque HTCU_TqRdctnPcVal refers to a maximum torque CR_Ems_TqStd_Nm. This conversion into a physical quantity provides a range of CR_Ems_TqStd_Nm of 0 ";
BA_ "GenSigStartValue" SG_ 112 HDCT_TqRdctnVal 1023;
BA_ "UserSigValidity" SG_ 112 HDCT_TqRdctnVal 3;
BA_ "RoutingFactor" SG_ 112 HDCT_TqRdctnVal 5;
BA_ "Version" SG_ 112 HDCT_TqRdctnVal "20.05.02";
BA_ "Description" SG_ 112 HTCU_SlwTqRdctnVal "The HTCU requests a slow torque reduction via the signal HTCU_TqRdctnPcVal to the ECU and MCU.";
BA_ "GenSigStartValue" SG_ 112 HTCU_SlwTqRdctnVal 511;
BA_ "UserSigValidity" SG_ 112 HTCU_SlwTqRdctnVal 3;
BA_ "RoutingFactor" SG_ 112 HTCU_SlwTqRdctnVal 5;
BA_ "Version" SG_ 112 HTCU_SlwTqRdctnVal "19.10.01";
BA_ "Description" SG_ 126 HU_BLTN_CAM_Crc1Val "The data area for CRC calculation is based on the data length (DLC) of the message DB.

The CRC shall be calculated over the entire data block (excluding the CRC bytes) including the user data, alive counter and Data ID



- CRC Polynomial (0x1021) , Ini";
BA_ "GenSigSendType" SG_ 126 HU_BLTN_CAM_Crc1Val 4;
BA_ "GenSigStartValue" SG_ 126 HU_BLTN_CAM_Crc1Val 65535;
BA_ "UserSigValidity" SG_ 126 HU_BLTN_CAM_Crc1Val 3;
BA_ "Version" SG_ 126 HU_BLTN_CAM_Crc1Val "22.10.20";
BA_ "Description" SG_ 126 BLTN_CAM_EV_BfrTime_NvalueSet "Driving Event Time Setting - Before, Resolution : sec";
BA_ "GenSigSendType" SG_ 126 BLTN_CAM_EV_BfrTime_NvalueSet 4;
BA_ "GenSigStartValue" SG_ 126 BLTN_CAM_EV_BfrTime_NvalueSet 31;
BA_ "UserSigValidity" SG_ 126 BLTN_CAM_EV_BfrTime_NvalueSet 0;
BA_ "Version" SG_ 126 BLTN_CAM_EV_BfrTime_NvalueSet "23.04.02";
BA_ "Description" SG_ 126 BLTN_CAM_EV_AftTime_NvalueSet "Driving Event Time Setting - After, Resolution : sec";
BA_ "GenSigSendType" SG_ 126 BLTN_CAM_EV_AftTime_NvalueSet 4;
BA_ "GenSigStartValue" SG_ 126 BLTN_CAM_EV_AftTime_NvalueSet 31;
BA_ "UserSigValidity" SG_ 126 BLTN_CAM_EV_AftTime_NvalueSet 0;
BA_ "Version" SG_ 126 BLTN_CAM_EV_AftTime_NvalueSet "23.04.02";
BA_ "Description" SG_ 126 BLTN_CAM_TML_Int_NvalueSet "Record Set of Time-lapse Interval, Resolution : sec";
BA_ "GenSigSendType" SG_ 126 BLTN_CAM_TML_Int_NvalueSet 4;
BA_ "UserSigValidity" SG_ 126 BLTN_CAM_TML_Int_NvalueSet 0;
BA_ "Version" SG_ 126 BLTN_CAM_TML_Int_NvalueSet "21.05.02";
BA_ "Description" SG_ 126 BLTN_CAM_Sen_DEV_NvalueSet "Set of Event  Detection Sensitivity of Driving Mode";
BA_ "GenSigSendType" SG_ 126 BLTN_CAM_Sen_DEV_NvalueSet 4;
BA_ "UserSigValidity" SG_ 126 BLTN_CAM_Sen_DEV_NvalueSet 0;
BA_ "Version" SG_ 126 BLTN_CAM_Sen_DEV_NvalueSet "21.05.02";
BA_ "Description" SG_ 126 BLTN_CAM_Sen_PEV_NvalueSet "Set of Event  Detection Sensitivity of Parking Mode";
BA_ "GenSigSendType" SG_ 126 BLTN_CAM_Sen_PEV_NvalueSet 4;
BA_ "UserSigValidity" SG_ 126 BLTN_CAM_Sen_PEV_NvalueSet 0;
BA_ "Version" SG_ 126 BLTN_CAM_Sen_PEV_NvalueSet "21.05.02";
BA_ "Description" SG_ 126 BLTN_CAM_FR_VerPos_NvalueSet "Front Camera Vertical position setting value.";
BA_ "GenSigSendType" SG_ 126 BLTN_CAM_FR_VerPos_NvalueSet 4;
BA_ "GenSigStartValue" SG_ 126 BLTN_CAM_FR_VerPos_NvalueSet 31;
BA_ "UserSigValidity" SG_ 126 BLTN_CAM_FR_VerPos_NvalueSet 0;
BA_ "Version" SG_ 126 BLTN_CAM_FR_VerPos_NvalueSet "23.04.02";
BA_ "Description" SG_ 126 BLTN_CAM_RR_VerPos_NvalueSet "Rear Camera Vertical position setting value.";
BA_ "GenSigSendType" SG_ 126 BLTN_CAM_RR_VerPos_NvalueSet 4;
BA_ "GenSigStartValue" SG_ 126 BLTN_CAM_RR_VerPos_NvalueSet 31;
BA_ "UserSigValidity" SG_ 126 BLTN_CAM_RR_VerPos_NvalueSet 0;
BA_ "Version" SG_ 126 BLTN_CAM_RR_VerPos_NvalueSet "23.04.02";
BA_ "Description" SG_ 126 BLTN_CAM_AppNoti_PEV_NvalueSet "Parked Event notification to Connectivity Phone App. On/Off";
BA_ "GenSigSendType" SG_ 126 BLTN_CAM_AppNoti_PEV_NvalueSet 4;
BA_ "UserSigValidity" SG_ 126 BLTN_CAM_AppNoti_PEV_NvalueSet 0;
BA_ "Version" SG_ 126 BLTN_CAM_AppNoti_PEV_NvalueSet "21.05.02";
BA_ "Description" SG_ 126 BLTN_CAM_WiFi_AutoOn_NvalueSet "Wifi On/Off User setting";
BA_ "GenSigSendType" SG_ 126 BLTN_CAM_WiFi_AutoOn_NvalueSet 4;
BA_ "UserSigValidity" SG_ 126 BLTN_CAM_WiFi_AutoOn_NvalueSet 0;
BA_ "Version" SG_ 126 BLTN_CAM_WiFi_AutoOn_NvalueSet "21.05.02";
BA_ "Description" SG_ 126 BLTN_CAM_StoProp_NvalueSet "Propotion of built-in Cam SD card Propotion set of the Recording Categories";
BA_ "GenSigSendType" SG_ 126 BLTN_CAM_StoProp_NvalueSet 4;
BA_ "UserSigValidity" SG_ 126 BLTN_CAM_StoProp_NvalueSet 0;
BA_ "Version" SG_ 126 BLTN_CAM_StoProp_NvalueSet "21.05.02";
BA_ "Description" SG_ 126 CF_AVN_BLTN_CAM_USMReset "Buit-in Cam USM Reset Request.";
BA_ "GenSigSendType" SG_ 126 CF_AVN_BLTN_CAM_USMReset 4;
BA_ "UserSigValidity" SG_ 126 CF_AVN_BLTN_CAM_USMReset 0;
BA_ "Version" SG_ 126 CF_AVN_BLTN_CAM_USMReset "21.05.02";
BA_ "Description" SG_ 126 CF_AVN_BLTN_CAM_RecReset "Buit-in Cam format(all file delete/Reset) Request.";
BA_ "GenSigSendType" SG_ 126 CF_AVN_BLTN_CAM_RecReset 4;
BA_ "UserSigValidity" SG_ 126 CF_AVN_BLTN_CAM_RecReset 0;
BA_ "Version" SG_ 126 CF_AVN_BLTN_CAM_RecReset "21.05.02";
BA_ "Description" SG_ 126 BLTN_CAM_File_DEL_CPY_Cmd "Buit-in Cam operation control of copying and deleting.";
BA_ "GenSigSendType" SG_ 126 BLTN_CAM_File_DEL_CPY_Cmd 4;
BA_ "UserSigValidity" SG_ 126 BLTN_CAM_File_DEL_CPY_Cmd 0;
BA_ "Version" SG_ 126 BLTN_CAM_File_DEL_CPY_Cmd "21.05.02";
BA_ "Description" SG_ 126 BLTN_CAM_LVDS_Mode_Cmd "This Signal is for LVDS output commend to BLTN_CAM";
BA_ "GenSigSendType" SG_ 126 BLTN_CAM_LVDS_Mode_Cmd 4;
BA_ "UserSigValidity" SG_ 126 BLTN_CAM_LVDS_Mode_Cmd 0;
BA_ "Version" SG_ 126 BLTN_CAM_LVDS_Mode_Cmd "21.05.02";
BA_ "Description" SG_ 126 HU_BLTN_CAM_Disp_Touch_Pos_X "X position of touch of display when BLTN-in CAM Engineer mode in";
BA_ "GenSigSendType" SG_ 126 HU_BLTN_CAM_Disp_Touch_Pos_X 4;
BA_ "UserSigValidity" SG_ 126 HU_BLTN_CAM_Disp_Touch_Pos_X 0;
BA_ "Version" SG_ 126 HU_BLTN_CAM_Disp_Touch_Pos_X "21.05.02";
BA_ "Description" SG_ 126 HU_BLTN_CAM_AlvCnt1Val "For the first transmission request for a data element the counter shall be initialized with 0 and shall be incremented by 1 for every subsequent send request. 

When the counter reaches the maximum value(0xFF), then it shall restart with 0 for the next s";
BA_ "GenSigSendType" SG_ 126 HU_BLTN_CAM_AlvCnt1Val 4;
BA_ "UserSigValidity" SG_ 126 HU_BLTN_CAM_AlvCnt1Val 3;
BA_ "Version" SG_ 126 HU_BLTN_CAM_AlvCnt1Val "22.10.20";
BA_ "Description" SG_ 126 HU_BLTN_CAM_Disp_Touch_Pos_Y "Y position of touch of display when BLTN-in CAM Engineer mode in";
BA_ "GenSigSendType" SG_ 126 HU_BLTN_CAM_Disp_Touch_Pos_Y 4;
BA_ "UserSigValidity" SG_ 126 HU_BLTN_CAM_Disp_Touch_Pos_Y 0;
BA_ "Version" SG_ 126 HU_BLTN_CAM_Disp_Touch_Pos_Y "21.05.02";
BA_ "Description" SG_ 126 MEV_Rec_Req "HU → BLTN_CAM Manual Event Record request.";
BA_ "GenSigSendType" SG_ 126 MEV_Rec_Req 4;
BA_ "UserSigValidity" SG_ 126 MEV_Rec_Req 0;
BA_ "Version" SG_ 126 MEV_Rec_Req "22.04.02";
BA_ "Description" SG_ 126 TML_Rec_Req "HU → BLTN_CAM Time lapse Start and End Request.";
BA_ "GenSigSendType" SG_ 126 TML_Rec_Req 4;
BA_ "UserSigValidity" SG_ 126 TML_Rec_Req 0;
BA_ "Version" SG_ 126 TML_Rec_Req "22.04.02";
BA_ "Description" SG_ 126 BLTN_CAM_SD_Card_UnMt_Mt_Req "Built-in Cam Unmount and Mount Request.";
BA_ "GenSigSendType" SG_ 126 BLTN_CAM_SD_Card_UnMt_Mt_Req 4;
BA_ "UserSigValidity" SG_ 126 BLTN_CAM_SD_Card_UnMt_Mt_Req 0;
BA_ "Version" SG_ 126 BLTN_CAM_SD_Card_UnMt_Mt_Req "22.05.02";
BA_ "Description" SG_ 126 BLTN_CAM_PMD_NvalueSet "Parked Motion Detection Record On/Off Set";
BA_ "GenSigSendType" SG_ 126 BLTN_CAM_PMD_NvalueSet 4;
BA_ "UserSigValidity" SG_ 126 BLTN_CAM_PMD_NvalueSet 0;
BA_ "Version" SG_ 126 BLTN_CAM_PMD_NvalueSet "24.01.05";
BA_ "Description" SG_ 126 BLTN_CAM_PMDEV_NvalueSet "Parked Motion Detection Event Record On/Off Set";
BA_ "GenSigSendType" SG_ 126 BLTN_CAM_PMDEV_NvalueSet 4;
BA_ "UserSigValidity" SG_ 126 BLTN_CAM_PMDEV_NvalueSet 0;
BA_ "Version" SG_ 126 BLTN_CAM_PMDEV_NvalueSet "24.01.05";
BA_ "Description" SG_ 126 BLTN_CAM_Ran_PMDR_NvalueSet "Set of Range level of Parked Motion Detection Record Mode";
BA_ "GenSigSendType" SG_ 126 BLTN_CAM_Ran_PMDR_NvalueSet 4;
BA_ "UserSigValidity" SG_ 126 BLTN_CAM_Ran_PMDR_NvalueSet 0;
BA_ "Version" SG_ 126 BLTN_CAM_Ran_PMDR_NvalueSet "24.01.05";
BA_ "Description" SG_ 126 BLTN_CAM_PMDTime_NvalueSet "Set the hours of Parked Motion Detection Mode";
BA_ "GenSigSendType" SG_ 126 BLTN_CAM_PMDTime_NvalueSet 4;
BA_ "UserSigValidity" SG_ 126 BLTN_CAM_PMDTime_NvalueSet 0;
BA_ "Version" SG_ 126 BLTN_CAM_PMDTime_NvalueSet "24.01.05";
BA_ "Description" SG_ 126 BLTN_CAM_BPR_TM_NvalueSet "Built-inCAM Performance Recorder Track Mode Set";
BA_ "GenSigSendType" SG_ 126 BLTN_CAM_BPR_TM_NvalueSet 4;
BA_ "UserSigValidity" SG_ 126 BLTN_CAM_BPR_TM_NvalueSet 0;
BA_ "Version" SG_ 126 BLTN_CAM_BPR_TM_NvalueSet "24.04.03";
BA_ "Description" SG_ 126 BLTN_CAM_BPR_RE_NvalueSet "Built-inCAM Performance Recorder Resolution Set";
BA_ "GenSigSendType" SG_ 126 BLTN_CAM_BPR_RE_NvalueSet 4;
BA_ "UserSigValidity" SG_ 126 BLTN_CAM_BPR_RE_NvalueSet 0;
BA_ "Version" SG_ 126 BLTN_CAM_BPR_RE_NvalueSet "24.04.03";
BA_ "Description" SG_ 126 BLTN_CAM_BPR_SndRec_NvalueSet "Built-inCAM Performance Recorder Sound Recording Set";
BA_ "GenSigSendType" SG_ 126 BLTN_CAM_BPR_SndRec_NvalueSet 4;
BA_ "UserSigValidity" SG_ 126 BLTN_CAM_BPR_SndRec_NvalueSet 0;
BA_ "Version" SG_ 126 BLTN_CAM_BPR_SndRec_NvalueSet "24.04.03";
BA_ "Description" SG_ 126 BLTN_CAM_BPR_AutRec_NvalueSet "Built-inCAM Performance Recorder Automatic Record Set";
BA_ "GenSigSendType" SG_ 126 BLTN_CAM_BPR_AutRec_NvalueSet 4;
BA_ "UserSigValidity" SG_ 126 BLTN_CAM_BPR_AutRec_NvalueSet 0;
BA_ "Version" SG_ 126 BLTN_CAM_BPR_AutRec_NvalueSet "24.04.03";
BA_ "Description" SG_ 126 BLTN_CAM_BPR_Rec_Req "Request Record Built-inCAM Performance Recorder";
BA_ "GenSigSendType" SG_ 126 BLTN_CAM_BPR_Rec_Req 4;
BA_ "UserSigValidity" SG_ 126 BLTN_CAM_BPR_Rec_Req 0;
BA_ "Version" SG_ 126 BLTN_CAM_BPR_Rec_Req "24.04.03";
BA_ "Description" SG_ 126 BLTN_CAM_Rec_LPE_NvalueSet "Low power mode's Tx signal applied to built-in cam 3.0";
BA_ "GenSigSendType" SG_ 126 BLTN_CAM_Rec_LPE_NvalueSet 4;
BA_ "UserSigValidity" SG_ 126 BLTN_CAM_Rec_LPE_NvalueSet 3;
BA_ "Version" SG_ 126 BLTN_CAM_Rec_LPE_NvalueSet "25.01.00";
BA_ "Description" SG_ 126 BLTN_CAM_Distort_NvalueSet "Distort prevention setting's Tx signal applied to built-in cam 3.0";
BA_ "GenSigSendType" SG_ 126 BLTN_CAM_Distort_NvalueSet 4;
BA_ "UserSigValidity" SG_ 126 BLTN_CAM_Distort_NvalueSet 3;
BA_ "Version" SG_ 126 BLTN_CAM_Distort_NvalueSet "25.01.00";
BA_ "Description" SG_ 126 BLTN_CAM_Pollution_NvalueSet "Pollution prevention setting's Tx signal applied to built-in cam 3.0";
BA_ "GenSigSendType" SG_ 126 BLTN_CAM_Pollution_NvalueSet 4;
BA_ "UserSigValidity" SG_ 126 BLTN_CAM_Pollution_NvalueSet 3;
BA_ "Version" SG_ 126 BLTN_CAM_Pollution_NvalueSet "25.01.00";
BA_ "Description" SG_ 126 BLTN_CAM_Crash_Pos_NvalueSet "Indicate the direction of impact detection setting's Tx signal applied to built-in cam 3.0";
BA_ "GenSigSendType" SG_ 126 BLTN_CAM_Crash_Pos_NvalueSet 4;
BA_ "UserSigValidity" SG_ 126 BLTN_CAM_Crash_Pos_NvalueSet 3;
BA_ "Version" SG_ 126 BLTN_CAM_Crash_Pos_NvalueSet "25.01.00";
BA_ "Description" SG_ 126 BLTN_CAM_Rear_Flip_NvalueSet "Rear image inversion setting's Tx signal applied to built-in cam 3.0";
BA_ "GenSigSendType" SG_ 126 BLTN_CAM_Rear_Flip_NvalueSet 4;
BA_ "UserSigValidity" SG_ 126 BLTN_CAM_Rear_Flip_NvalueSet 3;
BA_ "Version" SG_ 126 BLTN_CAM_Rear_Flip_NvalueSet "25.01.00";
BA_ "Description" SG_ 126 BLTN_CAM_Stm_all_NvalueSet "All stamp setting's Tx signal applied to built-in cam 3.0";
BA_ "GenSigSendType" SG_ 126 BLTN_CAM_Stm_all_NvalueSet 4;
BA_ "UserSigValidity" SG_ 126 BLTN_CAM_Stm_all_NvalueSet 3;
BA_ "Version" SG_ 126 BLTN_CAM_Stm_all_NvalueSet "25.01.00";
BA_ "Description" SG_ 126 BLTN_CAM_Rec_OWD_NvalueSet "Record On/Off Set of On While Driving";
BA_ "GenSigSendType" SG_ 126 BLTN_CAM_Rec_OWD_NvalueSet 4;
BA_ "UserSigValidity" SG_ 126 BLTN_CAM_Rec_OWD_NvalueSet 0;
BA_ "Version" SG_ 126 BLTN_CAM_Rec_OWD_NvalueSet "21.05.02";
BA_ "Description" SG_ 126 BLTN_CAM_Rec_DEV_NvalueSet "Record On/Off Set of Driving Event";
BA_ "GenSigSendType" SG_ 126 BLTN_CAM_Rec_DEV_NvalueSet 4;
BA_ "UserSigValidity" SG_ 126 BLTN_CAM_Rec_DEV_NvalueSet 0;
BA_ "Version" SG_ 126 BLTN_CAM_Rec_DEV_NvalueSet "21.05.02";
BA_ "Description" SG_ 126 BLTN_CAM_Rec_OWP_NvalueSet "Record On/Off Set of On While Parked, 0x0(Default) : Parking recording function not supported";
BA_ "GenSigSendType" SG_ 126 BLTN_CAM_Rec_OWP_NvalueSet 4;
BA_ "UserSigValidity" SG_ 126 BLTN_CAM_Rec_OWP_NvalueSet 0;
BA_ "Version" SG_ 126 BLTN_CAM_Rec_OWP_NvalueSet "21.05.02";
BA_ "Description" SG_ 126 BLTN_CAM_Rec_PEV_NvalueSet "Record Set of Parked Event, 0x0(Default) : Parking recording function not supported";
BA_ "GenSigSendType" SG_ 126 BLTN_CAM_Rec_PEV_NvalueSet 4;
BA_ "UserSigValidity" SG_ 126 BLTN_CAM_Rec_PEV_NvalueSet 0;
BA_ "Version" SG_ 126 BLTN_CAM_Rec_PEV_NvalueSet "21.05.02";
BA_ "Description" SG_ 126 BLTN_CAM_AudRec_NvalueSet "Audio Record On/Off Set";
BA_ "GenSigSendType" SG_ 126 BLTN_CAM_AudRec_NvalueSet 4;
BA_ "UserSigValidity" SG_ 126 BLTN_CAM_AudRec_NvalueSet 0;
BA_ "Version" SG_ 126 BLTN_CAM_AudRec_NvalueSet "21.06.10";
BA_ "Description" SG_ 126 BLTN_CAM_Time_Stm_NvalueSet "Record Set of Date and Time Stamp";
BA_ "GenSigSendType" SG_ 126 BLTN_CAM_Time_Stm_NvalueSet 4;
BA_ "UserSigValidity" SG_ 126 BLTN_CAM_Time_Stm_NvalueSet 0;
BA_ "Version" SG_ 126 BLTN_CAM_Time_Stm_NvalueSet "21.05.02";
BA_ "Description" SG_ 126 BLTN_CAM_Spd_Stm_NvalueSet "Record Set of Speed Stamp";
BA_ "GenSigSendType" SG_ 126 BLTN_CAM_Spd_Stm_NvalueSet 4;
BA_ "UserSigValidity" SG_ 126 BLTN_CAM_Spd_Stm_NvalueSet 0;
BA_ "Version" SG_ 126 BLTN_CAM_Spd_Stm_NvalueSet "21.11.07";
BA_ "Description" SG_ 126 BLTN_CAM_Locatn_Stm_NvalueSet "Record Set of Location Stamp";
BA_ "GenSigSendType" SG_ 126 BLTN_CAM_Locatn_Stm_NvalueSet 4;
BA_ "UserSigValidity" SG_ 126 BLTN_CAM_Locatn_Stm_NvalueSet 0;
BA_ "Version" SG_ 126 BLTN_CAM_Locatn_Stm_NvalueSet "21.05.02";
BA_ "Description" SG_ 126 BLTN_CAM_TrnSig_Stm_NvalueSet "Record Set of Turn Signal Stamp";
BA_ "GenSigSendType" SG_ 126 BLTN_CAM_TrnSig_Stm_NvalueSet 4;
BA_ "UserSigValidity" SG_ 126 BLTN_CAM_TrnSig_Stm_NvalueSet 0;
BA_ "Version" SG_ 126 BLTN_CAM_TrnSig_Stm_NvalueSet "21.05.02";
BA_ "Description" SG_ 126 BLTN_CAM_AclBrk_Stm_NvalueSet "Record Set of Accelerator Brake Stamp";
BA_ "GenSigSendType" SG_ 126 BLTN_CAM_AclBrk_Stm_NvalueSet 4;
BA_ "UserSigValidity" SG_ 126 BLTN_CAM_AclBrk_Stm_NvalueSet 0;
BA_ "Version" SG_ 126 BLTN_CAM_AclBrk_Stm_NvalueSet "21.11.07";
BA_ "Description" SG_ 126 BLTN_CAM_GearPos_Stm_NvalueSet "Record Set of Gear Position Stamp";
BA_ "GenSigSendType" SG_ 126 BLTN_CAM_GearPos_Stm_NvalueSet 4;
BA_ "UserSigValidity" SG_ 126 BLTN_CAM_GearPos_Stm_NvalueSet 0;
BA_ "Version" SG_ 126 BLTN_CAM_GearPos_Stm_NvalueSet "21.11.07";
BA_ "Description" SG_ 126 BLTN_CAM_EVSen_Stm_NvalueSet "Record Set of Event Sensitivity Stamp";
BA_ "GenSigSendType" SG_ 126 BLTN_CAM_EVSen_Stm_NvalueSet 4;
BA_ "UserSigValidity" SG_ 126 BLTN_CAM_EVSen_Stm_NvalueSet 0;
BA_ "Version" SG_ 126 BLTN_CAM_EVSen_Stm_NvalueSet "21.05.02";
BA_ "Description" SG_ 126 BLTN_CAM_Strangl_Stm_NvalueSet "Record Set of Steering Angle Stamp";
BA_ "GenSigSendType" SG_ 126 BLTN_CAM_Strangl_Stm_NvalueSet 4;
BA_ "UserSigValidity" SG_ 126 BLTN_CAM_Strangl_Stm_NvalueSet 0;
BA_ "Version" SG_ 126 BLTN_CAM_Strangl_Stm_NvalueSet "21.07.05";
BA_ "Description" SG_ 126 BLTN_CAM_EV_RecMaxTime_NvalueSet "BLTN_CAM EV Parking Rec Max Time NvalueSet";
BA_ "GenSigSendType" SG_ 126 BLTN_CAM_EV_RecMaxTime_NvalueSet 4;
BA_ "UserSigValidity" SG_ 126 BLTN_CAM_EV_RecMaxTime_NvalueSet 0;
BA_ "Version" SG_ 126 BLTN_CAM_EV_RecMaxTime_NvalueSet "23.02.02";
BA_ "Description" SG_ 126 BLTN_CAM_Rec_STRM_NvalueSet "Built-in Cam Live Video Streaming On/Off Set";
BA_ "GenSigSendType" SG_ 126 BLTN_CAM_Rec_STRM_NvalueSet 4;
BA_ "UserSigValidity" SG_ 126 BLTN_CAM_Rec_STRM_NvalueSet 0;
BA_ "Version" SG_ 126 BLTN_CAM_Rec_STRM_NvalueSet "25.04.01";
BA_ "Description" SG_ 126 BLTN_CAM_PrkTime_NvalueSet "Parking Operation Setting Time, Resolution : hr";
BA_ "GenSigSendType" SG_ 126 BLTN_CAM_PrkTime_NvalueSet 4;
BA_ "UserSigValidity" SG_ 126 BLTN_CAM_PrkTime_NvalueSet 0;
BA_ "Version" SG_ 126 BLTN_CAM_PrkTime_NvalueSet "21.11.07";
BA_ "UsrSigPurpose" SG_ 2549874789 SNI_SHVU_CCS_FD 8;
BA_ "UserSigValidity" SG_ 2549874789 SNI_SHVU_CCS_FD 0;
BA_ "UsrSigPurpose" SG_ 2549874789 CBV_RMR_SHVU_CCS_FD 8;
BA_ "UserSigValidity" SG_ 2549874789 CBV_RMR_SHVU_CCS_FD 0;
BA_ "UsrSigPurpose" SG_ 2549874789 CBV_NMCoID_SHVU_CCS_FD 8;
BA_ "UserSigValidity" SG_ 2549874789 CBV_NMCoID_SHVU_CCS_FD 0;
BA_ "UsrSigPurpose" SG_ 2549874789 CBV_NMCoSRB_SHVU_CCS_FD 8;
BA_ "UserSigValidity" SG_ 2549874789 CBV_NMCoSRB_SHVU_CCS_FD 0;
BA_ "UsrSigPurpose" SG_ 2549874789 CBV_AWB_SHVU_CCS_FD 8;
BA_ "UserSigValidity" SG_ 2549874789 CBV_AWB_SHVU_CCS_FD 0;
BA_ "UsrSigPurpose" SG_ 2549874789 CBV_PNIB_SHVU_CCS_FD 8;
BA_ "UserSigValidity" SG_ 2549874789 CBV_PNIB_SHVU_CCS_FD 0;
BA_ "UsrSigPurpose" SG_ 2549874789 NRR_SHVU_CCS_FD 8;
BA_ "UserSigValidity" SG_ 2549874789 NRR_SHVU_CCS_FD 0;
BA_ "UsrSigPurpose" SG_ 2549874789 NM_State_SHVU_CCS_FD 8;
BA_ "UserSigValidity" SG_ 2549874789 NM_State_SHVU_CCS_FD 0;
BA_ "UsrSigPurpose" SG_ 2549874789 PNI_SHVU_CCS_FD 8;
BA_ "UserSigValidity" SG_ 2549874789 PNI_SHVU_CCS_FD 0;
BA_ "UsrSigPurpose" SG_ 2549874789 PNI_SHVU_CCS_FD_1 8;
BA_ "UserSigValidity" SG_ 2549874789 PNI_SHVU_CCS_FD_1 0;
BA_ "UsrSigPurpose" SG_ 2549874789 PNI_SHVU_CCS_FD_2 8;
BA_ "UserSigValidity" SG_ 2549874789 PNI_SHVU_CCS_FD_2 0;
BA_ "UsrSigPurpose" SG_ 2549874789 PNI_SHVU_CCS_FD_3 8;
BA_ "UserSigValidity" SG_ 2549874789 PNI_SHVU_CCS_FD_3 0;
BA_ "UsrSigPurpose" SG_ 2549874826 SNI_ARS_FD 8;
BA_ "UserSigValidity" SG_ 2549874826 SNI_ARS_FD 0;
BA_ "UsrSigPurpose" SG_ 2549874826 CBV_RMR_ARS_FD 8;
BA_ "UserSigValidity" SG_ 2549874826 CBV_RMR_ARS_FD 0;
BA_ "UsrSigPurpose" SG_ 2549874826 CBV_NMCoID_ARS_FD 8;
BA_ "UserSigValidity" SG_ 2549874826 CBV_NMCoID_ARS_FD 0;
BA_ "UsrSigPurpose" SG_ 2549874826 CBV_NMCoSRB_ARS_FD 8;
BA_ "UserSigValidity" SG_ 2549874826 CBV_NMCoSRB_ARS_FD 0;
BA_ "UsrSigPurpose" SG_ 2549874826 CBV_AWB_ARS_FD 8;
BA_ "UserSigValidity" SG_ 2549874826 CBV_AWB_ARS_FD 0;
BA_ "UsrSigPurpose" SG_ 2549874826 CBV_PNIB_ARS_FD 8;
BA_ "UserSigValidity" SG_ 2549874826 CBV_PNIB_ARS_FD 0;
BA_ "UsrSigPurpose" SG_ 2549874826 NRR_ARS_FD 8;
BA_ "UserSigValidity" SG_ 2549874826 NRR_ARS_FD 0;
BA_ "UsrSigPurpose" SG_ 2549874826 NM_State_ARS_FD 8;
BA_ "UserSigValidity" SG_ 2549874826 NM_State_ARS_FD 0;
BA_ "UsrSigPurpose" SG_ 2549874826 PNI_ARS_FD 8;
BA_ "UserSigValidity" SG_ 2549874826 PNI_ARS_FD 0;
BA_ "UsrSigPurpose" SG_ 2549874826 PNI_ARS_FD_1 8;
BA_ "UserSigValidity" SG_ 2549874826 PNI_ARS_FD_1 0;
BA_ "UsrSigPurpose" SG_ 2549874826 PNI_ARS_FD_2 8;
BA_ "UserSigValidity" SG_ 2549874826 PNI_ARS_FD_2 0;
BA_ "UsrSigPurpose" SG_ 2549874826 PNI_ARS_FD_3 8;
BA_ "UserSigValidity" SG_ 2549874826 PNI_ARS_FD_3 0;
BA_ "UsrSigPurpose" SG_ 2549874846 SNI_WPC_FD 8;
BA_ "UserSigValidity" SG_ 2549874846 SNI_WPC_FD 0;
BA_ "UsrSigPurpose" SG_ 2549874846 CBV_RMR_WPC_FD 8;
BA_ "UserSigValidity" SG_ 2549874846 CBV_RMR_WPC_FD 0;
BA_ "UsrSigPurpose" SG_ 2549874846 CBV_NMCoID_WPC_FD 8;
BA_ "UserSigValidity" SG_ 2549874846 CBV_NMCoID_WPC_FD 0;
BA_ "UsrSigPurpose" SG_ 2549874846 CBV_NMCoSRB_WPC_FD 8;
BA_ "UserSigValidity" SG_ 2549874846 CBV_NMCoSRB_WPC_FD 0;
BA_ "UsrSigPurpose" SG_ 2549874846 CBV_AWB_WPC_FD 8;
BA_ "UserSigValidity" SG_ 2549874846 CBV_AWB_WPC_FD 0;
BA_ "UsrSigPurpose" SG_ 2549874846 CBV_PNIB_WPC_FD 8;
BA_ "UserSigValidity" SG_ 2549874846 CBV_PNIB_WPC_FD 0;
BA_ "UsrSigPurpose" SG_ 2549874846 NRR_WPC_FD 8;
BA_ "UserSigValidity" SG_ 2549874846 NRR_WPC_FD 0;
BA_ "UsrSigPurpose" SG_ 2549874846 NM_State_WPC_FD 8;
BA_ "UserSigValidity" SG_ 2549874846 NM_State_WPC_FD 0;
BA_ "UsrSigPurpose" SG_ 2549874846 PNI_WPC_FD 8;
BA_ "UserSigValidity" SG_ 2549874846 PNI_WPC_FD 0;
BA_ "UsrSigPurpose" SG_ 2549874846 PNI_WPC_FD_1 8;
BA_ "UserSigValidity" SG_ 2549874846 PNI_WPC_FD_1 0;
BA_ "UsrSigPurpose" SG_ 2549874846 PNI_WPC_FD_2 8;
BA_ "UserSigValidity" SG_ 2549874846 PNI_WPC_FD_2 0;
BA_ "UsrSigPurpose" SG_ 2549874846 PNI_WPC_FD_3 8;
BA_ "UserSigValidity" SG_ 2549874846 PNI_WPC_FD_3 0;
BA_ "UsrSigPurpose" SG_ 2549874837 SNI_WPC2_FD 8;
BA_ "UserSigValidity" SG_ 2549874837 SNI_WPC2_FD 0;
BA_ "UsrSigPurpose" SG_ 2549874837 CBV_RMR_WPC2_FD 8;
BA_ "UserSigValidity" SG_ 2549874837 CBV_RMR_WPC2_FD 0;
BA_ "UsrSigPurpose" SG_ 2549874837 CBV_NMCoID_WPC2_FD 8;
BA_ "UserSigValidity" SG_ 2549874837 CBV_NMCoID_WPC2_FD 0;
BA_ "UsrSigPurpose" SG_ 2549874837 CBV_NMCoSRB_WPC2_FD 8;
BA_ "UserSigValidity" SG_ 2549874837 CBV_NMCoSRB_WPC2_FD 0;
BA_ "UsrSigPurpose" SG_ 2549874837 CBV_AWB_WPC2_FD 8;
BA_ "UserSigValidity" SG_ 2549874837 CBV_AWB_WPC2_FD 0;
BA_ "UsrSigPurpose" SG_ 2549874837 CBV_PNIB_WPC2_FD 8;
BA_ "UserSigValidity" SG_ 2549874837 CBV_PNIB_WPC2_FD 0;
BA_ "UsrSigPurpose" SG_ 2549874837 NRR_WPC2_FD 8;
BA_ "UserSigValidity" SG_ 2549874837 NRR_WPC2_FD 0;
BA_ "UsrSigPurpose" SG_ 2549874837 NM_State_WPC2_FD 8;
BA_ "UserSigValidity" SG_ 2549874837 NM_State_WPC2_FD 0;
BA_ "UsrSigPurpose" SG_ 2549874837 PNI_WPC2_FD 8;
BA_ "UserSigValidity" SG_ 2549874837 PNI_WPC2_FD 0;
BA_ "UsrSigPurpose" SG_ 2549874837 PNI_WPC2_FD_1 8;
BA_ "UserSigValidity" SG_ 2549874837 PNI_WPC2_FD_1 0;
BA_ "UsrSigPurpose" SG_ 2549874837 PNI_WPC2_FD_2 8;
BA_ "UserSigValidity" SG_ 2549874837 PNI_WPC2_FD_2 0;
BA_ "UsrSigPurpose" SG_ 2549874837 PNI_WPC2_FD_3 8;
BA_ "UserSigValidity" SG_ 2549874837 PNI_WPC2_FD_3 0;
BA_ "UsrSigPurpose" SG_ 2549874823 SNI_SCM_FD 8;
BA_ "UserSigValidity" SG_ 2549874823 SNI_SCM_FD 0;
BA_ "UsrSigPurpose" SG_ 2549874823 CBV_RMR_SCM_FD 8;
BA_ "UserSigValidity" SG_ 2549874823 CBV_RMR_SCM_FD 0;
BA_ "UsrSigPurpose" SG_ 2549874823 CBV_NMCoID_SCM_FD 8;
BA_ "UserSigValidity" SG_ 2549874823 CBV_NMCoID_SCM_FD 0;
BA_ "UsrSigPurpose" SG_ 2549874823 CBV_NMCoSRB_SCM_FD 8;
BA_ "UserSigValidity" SG_ 2549874823 CBV_NMCoSRB_SCM_FD 0;
BA_ "UsrSigPurpose" SG_ 2549874823 CBV_AWB_SCM_FD 8;
BA_ "UserSigValidity" SG_ 2549874823 CBV_AWB_SCM_FD 0;
BA_ "UsrSigPurpose" SG_ 2549874823 CBV_PNIB_SCM_FD 8;
BA_ "UserSigValidity" SG_ 2549874823 CBV_PNIB_SCM_FD 0;
BA_ "UsrSigPurpose" SG_ 2549874823 NRR_SCM_FD 8;
BA_ "UserSigValidity" SG_ 2549874823 NRR_SCM_FD 0;
BA_ "UsrSigPurpose" SG_ 2549874823 NM_State_SCM_FD 8;
BA_ "UserSigValidity" SG_ 2549874823 NM_State_SCM_FD 0;
BA_ "UsrSigPurpose" SG_ 2549874823 PNI_SCM_FD 8;
BA_ "UserSigValidity" SG_ 2549874823 PNI_SCM_FD 0;
BA_ "UsrSigPurpose" SG_ 2549874823 PNI_SCM_FD_1 8;
BA_ "UserSigValidity" SG_ 2549874823 PNI_SCM_FD_1 0;
BA_ "UsrSigPurpose" SG_ 2549874823 PNI_SCM_FD_2 8;
BA_ "UserSigValidity" SG_ 2549874823 PNI_SCM_FD_2 0;
BA_ "UsrSigPurpose" SG_ 2549874823 PNI_SCM_FD_3 8;
BA_ "UserSigValidity" SG_ 2549874823 PNI_SCM_FD_3 0;
BA_ "UsrSigPurpose" SG_ 2549874858 SNI_SHVU_FRNT_FD 8;
BA_ "UserSigValidity" SG_ 2549874858 SNI_SHVU_FRNT_FD 0;
BA_ "UsrSigPurpose" SG_ 2549874858 CBV_RMR_SHVU_FRNT_FD 8;
BA_ "UserSigValidity" SG_ 2549874858 CBV_RMR_SHVU_FRNT_FD 0;
BA_ "UsrSigPurpose" SG_ 2549874858 CBV_NMCoID_SHVU_FRNT_FD 8;
BA_ "UserSigValidity" SG_ 2549874858 CBV_NMCoID_SHVU_FRNT_FD 0;
BA_ "UsrSigPurpose" SG_ 2549874858 CBV_NMCoSRB_SHVU_FRNT_FD 8;
BA_ "UserSigValidity" SG_ 2549874858 CBV_NMCoSRB_SHVU_FRNT_FD 0;
BA_ "UsrSigPurpose" SG_ 2549874858 CBV_AWB_SHVU_FRNT_FD 8;
BA_ "UserSigValidity" SG_ 2549874858 CBV_AWB_SHVU_FRNT_FD 0;
BA_ "UsrSigPurpose" SG_ 2549874858 CBV_PNIB_SHVU_FRNT_FD 8;
BA_ "UserSigValidity" SG_ 2549874858 CBV_PNIB_SHVU_FRNT_FD 0;
BA_ "UsrSigPurpose" SG_ 2549874858 NRR_SHVU_FRNT_FD 8;
BA_ "UserSigValidity" SG_ 2549874858 NRR_SHVU_FRNT_FD 0;
BA_ "UsrSigPurpose" SG_ 2549874858 NM_State_SHVU_FRNT_FD 8;
BA_ "UserSigValidity" SG_ 2549874858 NM_State_SHVU_FRNT_FD 0;
BA_ "UsrSigPurpose" SG_ 2549874858 PNI_SHVU_FRNT_FD 8;
BA_ "UserSigValidity" SG_ 2549874858 PNI_SHVU_FRNT_FD 0;
BA_ "UsrSigPurpose" SG_ 2549874858 PNI_SHVU_FRNT_FD_1 8;
BA_ "UserSigValidity" SG_ 2549874858 PNI_SHVU_FRNT_FD_1 0;
BA_ "UsrSigPurpose" SG_ 2549874858 PNI_SHVU_FRNT_FD_2 8;
BA_ "UserSigValidity" SG_ 2549874858 PNI_SHVU_FRNT_FD_2 0;
BA_ "UsrSigPurpose" SG_ 2549874858 PNI_SHVU_FRNT_FD_3 8;
BA_ "UserSigValidity" SG_ 2549874858 PNI_SHVU_FRNT_FD_3 0;
BA_ "UsrSigPurpose" SG_ 2549874750 SNI_FLLR_FD 8;
BA_ "UserSigValidity" SG_ 2549874750 SNI_FLLR_FD 0;
BA_ "UsrSigPurpose" SG_ 2549874750 CBV_RMR_FLLR_FD 8;
BA_ "UserSigValidity" SG_ 2549874750 CBV_RMR_FLLR_FD 0;
BA_ "UsrSigPurpose" SG_ 2549874750 CBV_NMCoID_FLLR_FD 8;
BA_ "UserSigValidity" SG_ 2549874750 CBV_NMCoID_FLLR_FD 0;
BA_ "UsrSigPurpose" SG_ 2549874750 CBV_NMCoSRB_FLLR_FD 8;
BA_ "UserSigValidity" SG_ 2549874750 CBV_NMCoSRB_FLLR_FD 0;
BA_ "UsrSigPurpose" SG_ 2549874750 CBV_AWB_FLLR_FD 8;
BA_ "UserSigValidity" SG_ 2549874750 CBV_AWB_FLLR_FD 0;
BA_ "UsrSigPurpose" SG_ 2549874750 CBV_PNIB_FLLR_FD 8;
BA_ "UserSigValidity" SG_ 2549874750 CBV_PNIB_FLLR_FD 0;
BA_ "UsrSigPurpose" SG_ 2549874750 NRR_FLLR_FD 8;
BA_ "UserSigValidity" SG_ 2549874750 NRR_FLLR_FD 0;
BA_ "UsrSigPurpose" SG_ 2549874750 NM_State_FLLR_FD 8;
BA_ "UserSigValidity" SG_ 2549874750 NM_State_FLLR_FD 0;
BA_ "UsrSigPurpose" SG_ 2549874750 PNI_FLLR_FD 8;
BA_ "UserSigValidity" SG_ 2549874750 PNI_FLLR_FD 0;
BA_ "UsrSigPurpose" SG_ 2549874750 PNI_FLLR_FD_1 8;
BA_ "UserSigValidity" SG_ 2549874750 PNI_FLLR_FD_1 0;
BA_ "UsrSigPurpose" SG_ 2549874750 PNI_FLLR_FD_2 8;
BA_ "UserSigValidity" SG_ 2549874750 PNI_FLLR_FD_2 0;
BA_ "UsrSigPurpose" SG_ 2549874750 PNI_FLLR_FD_3 8;
BA_ "UserSigValidity" SG_ 2549874750 PNI_FLLR_FD_3 0;
BA_ "UsrSigPurpose" SG_ 2549874905 SNI_GW_SAU_DRV_FD 8;
BA_ "UserSigValidity" SG_ 2549874905 SNI_GW_SAU_DRV_FD 0;
BA_ "UsrSigPurpose" SG_ 2549874905 CBV_RMR_GW_SAU_DRV_FD 8;
BA_ "UserSigValidity" SG_ 2549874905 CBV_RMR_GW_SAU_DRV_FD 0;
BA_ "UsrSigPurpose" SG_ 2549874905 CBV_NMCoID_GW_SAU_DRV_FD 8;
BA_ "UserSigValidity" SG_ 2549874905 CBV_NMCoID_GW_SAU_DRV_FD 0;
BA_ "UsrSigPurpose" SG_ 2549874905 CBV_NMCoSRB_GW_SAU_DRV_FD 8;
BA_ "UserSigValidity" SG_ 2549874905 CBV_NMCoSRB_GW_SAU_DRV_FD 0;
BA_ "UsrSigPurpose" SG_ 2549874905 CBV_AWB_GW_SAU_DRV_FD 8;
BA_ "UserSigValidity" SG_ 2549874905 CBV_AWB_GW_SAU_DRV_FD 0;
BA_ "UsrSigPurpose" SG_ 2549874905 CBV_PNIB_GW_SAU_DRV_FD 8;
BA_ "UserSigValidity" SG_ 2549874905 CBV_PNIB_GW_SAU_DRV_FD 0;
BA_ "UsrSigPurpose" SG_ 2549874905 NRR_GW_SAU_DRV_FD 8;
BA_ "UserSigValidity" SG_ 2549874905 NRR_GW_SAU_DRV_FD 0;
BA_ "UsrSigPurpose" SG_ 2549874905 NM_State_GW_SAU_DRV_FD 8;
BA_ "UserSigValidity" SG_ 2549874905 NM_State_GW_SAU_DRV_FD 0;
BA_ "UsrSigPurpose" SG_ 2549874905 PNI_GW_SAU_DRV_FD 8;
BA_ "UserSigValidity" SG_ 2549874905 PNI_GW_SAU_DRV_FD 0;
BA_ "UsrSigPurpose" SG_ 2549874905 PNI_GW_SAU_DRV_FD_1 8;
BA_ "UserSigValidity" SG_ 2549874905 PNI_GW_SAU_DRV_FD_1 0;
BA_ "UsrSigPurpose" SG_ 2549874905 PNI_GW_SAU_DRV_FD_2 8;
BA_ "UserSigValidity" SG_ 2549874905 PNI_GW_SAU_DRV_FD_2 0;
BA_ "UsrSigPurpose" SG_ 2549874905 PNI_GW_SAU_DRV_FD_3 8;
BA_ "UserSigValidity" SG_ 2549874905 PNI_GW_SAU_DRV_FD_3 0;
BA_ "UsrSigPurpose" SG_ 2549874896 SNI_ATS_FD 8;
BA_ "UserSigValidity" SG_ 2549874896 SNI_ATS_FD 0;
BA_ "UsrSigPurpose" SG_ 2549874896 CBV_RMR_ATS_FD 8;
BA_ "UserSigValidity" SG_ 2549874896 CBV_RMR_ATS_FD 0;
BA_ "UsrSigPurpose" SG_ 2549874896 CBV_NMCoID_ATS_FD 8;
BA_ "UserSigValidity" SG_ 2549874896 CBV_NMCoID_ATS_FD 0;
BA_ "UsrSigPurpose" SG_ 2549874896 CBV_NMCoSRB_ATS_FD 8;
BA_ "UserSigValidity" SG_ 2549874896 CBV_NMCoSRB_ATS_FD 0;
BA_ "UsrSigPurpose" SG_ 2549874896 CBV_AWB_ATS_FD 8;
BA_ "UserSigValidity" SG_ 2549874896 CBV_AWB_ATS_FD 0;
BA_ "UsrSigPurpose" SG_ 2549874896 CBV_PNIB_ATS_FD 8;
BA_ "UserSigValidity" SG_ 2549874896 CBV_PNIB_ATS_FD 0;
BA_ "UsrSigPurpose" SG_ 2549874896 NRR_ATS_FD 8;
BA_ "UserSigValidity" SG_ 2549874896 NRR_ATS_FD 0;
BA_ "UsrSigPurpose" SG_ 2549874896 NM_State_ATS_FD 8;
BA_ "UserSigValidity" SG_ 2549874896 NM_State_ATS_FD 0;
BA_ "UsrSigPurpose" SG_ 2549874896 PNI_ATS_FD 8;
BA_ "UserSigValidity" SG_ 2549874896 PNI_ATS_FD 0;
BA_ "UsrSigPurpose" SG_ 2549874896 PNI_ATS_FD_1 8;
BA_ "UserSigValidity" SG_ 2549874896 PNI_ATS_FD_1 0;
BA_ "UsrSigPurpose" SG_ 2549874896 PNI_ATS_FD_2 8;
BA_ "UserSigValidity" SG_ 2549874896 PNI_ATS_FD_2 0;
BA_ "UsrSigPurpose" SG_ 2549874896 PNI_ATS_FD_3 8;
BA_ "UserSigValidity" SG_ 2549874896 PNI_ATS_FD_3 0;
BA_ "UsrSigPurpose" SG_ 2549874881 SNI_PSB_FD 8;
BA_ "UserSigValidity" SG_ 2549874881 SNI_PSB_FD 0;
BA_ "UsrSigPurpose" SG_ 2549874881 CBV_RMR_PSB_FD 8;
BA_ "UserSigValidity" SG_ 2549874881 CBV_RMR_PSB_FD 0;
BA_ "UsrSigPurpose" SG_ 2549874881 CBV_NMCoID_PSB_FD 8;
BA_ "UserSigValidity" SG_ 2549874881 CBV_NMCoID_PSB_FD 0;
BA_ "UsrSigPurpose" SG_ 2549874881 CBV_NMCoSRB_PSB_FD 8;
BA_ "UserSigValidity" SG_ 2549874881 CBV_NMCoSRB_PSB_FD 0;
BA_ "UsrSigPurpose" SG_ 2549874881 CBV_AWB_PSB_FD 8;
BA_ "UserSigValidity" SG_ 2549874881 CBV_AWB_PSB_FD 0;
BA_ "UsrSigPurpose" SG_ 2549874881 CBV_PNIB_PSB_FD 8;
BA_ "UserSigValidity" SG_ 2549874881 CBV_PNIB_PSB_FD 0;
BA_ "UsrSigPurpose" SG_ 2549874881 NRR_PSB_FD 8;
BA_ "UserSigValidity" SG_ 2549874881 NRR_PSB_FD 0;
BA_ "UsrSigPurpose" SG_ 2549874881 NM_State_PSB_FD 8;
BA_ "UserSigValidity" SG_ 2549874881 NM_State_PSB_FD 0;
BA_ "UsrSigPurpose" SG_ 2549874881 PNI_PSB_FD 8;
BA_ "UserSigValidity" SG_ 2549874881 PNI_PSB_FD 0;
BA_ "UsrSigPurpose" SG_ 2549874881 PNI_PSB_FD_1 8;
BA_ "UserSigValidity" SG_ 2549874881 PNI_PSB_FD_1 0;
BA_ "UsrSigPurpose" SG_ 2549874881 PNI_PSB_FD_2 8;
BA_ "UserSigValidity" SG_ 2549874881 PNI_PSB_FD_2 0;
BA_ "UsrSigPurpose" SG_ 2549874881 PNI_PSB_FD_3 8;
BA_ "UserSigValidity" SG_ 2549874881 PNI_PSB_FD_3 0;
BA_REL_ "GenSigTimeoutTime" BU_SG_REL_ CGW_CCU SG_ 1325 BLTN_CAM_I2CMasterSta_Left 5000;
BA_REL_ "GenSigTimeoutTime" BU_SG_REL_ CGW_CCU SG_ 1325 BLTN_CAM_I2CMasterSta_Right 5000;
BA_REL_ "GenSigTimeoutTime" BU_SG_REL_ CGW_CCU SG_ 1325 BLTN_CAM_CamSta_Left 5000;
BA_REL_ "GenSigTimeoutTime" BU_SG_REL_ CGW_CCU SG_ 1325 BLTN_CAM_CamSta_Right 5000;
BA_REL_ "GenSigTimeoutTime" BU_SG_REL_ BLTN_CAM_FD SG_ 126 BLTN_CAM_EV_BfrTime_NvalueSet 0;
BA_REL_ "GenSigTimeoutTime" BU_SG_REL_ BLTN_CAM_FD SG_ 126 BLTN_CAM_EV_AftTime_NvalueSet 0;
BA_REL_ "GenSigTimeoutTime" BU_SG_REL_ BLTN_CAM_FD SG_ 126 BLTN_CAM_TML_Int_NvalueSet 0;
BA_REL_ "GenSigTimeoutTime" BU_SG_REL_ BLTN_CAM_FD SG_ 126 BLTN_CAM_Sen_DEV_NvalueSet 0;
BA_REL_ "GenSigTimeoutTime" BU_SG_REL_ BLTN_CAM_FD SG_ 126 BLTN_CAM_Sen_PEV_NvalueSet 0;
BA_REL_ "GenSigTimeoutTime" BU_SG_REL_ BLTN_CAM_FD SG_ 126 BLTN_CAM_FR_VerPos_NvalueSet 0;
BA_REL_ "GenSigTimeoutTime" BU_SG_REL_ BLTN_CAM_FD SG_ 126 BLTN_CAM_RR_VerPos_NvalueSet 0;
BA_REL_ "GenSigTimeoutTime" BU_SG_REL_ BLTN_CAM_FD SG_ 126 BLTN_CAM_AppNoti_PEV_NvalueSet 0;
BA_REL_ "GenSigTimeoutTime" BU_SG_REL_ BLTN_CAM_FD SG_ 126 BLTN_CAM_WiFi_AutoOn_NvalueSet 0;
BA_REL_ "GenSigTimeoutTime" BU_SG_REL_ BLTN_CAM_FD SG_ 126 BLTN_CAM_StoProp_NvalueSet 0;
BA_REL_ "GenSigTimeoutTime" BU_SG_REL_ BLTN_CAM_FD SG_ 126 CF_AVN_BLTN_CAM_USMReset 0;
BA_REL_ "GenSigTimeoutTime" BU_SG_REL_ BLTN_CAM_FD SG_ 126 CF_AVN_BLTN_CAM_RecReset 0;
BA_REL_ "GenSigTimeoutTime" BU_SG_REL_ BLTN_CAM_FD SG_ 126 BLTN_CAM_File_DEL_CPY_Cmd 0;
BA_REL_ "GenSigTimeoutTime" BU_SG_REL_ BLTN_CAM_FD SG_ 126 BLTN_CAM_LVDS_Mode_Cmd 0;
BA_REL_ "GenSigTimeoutTime" BU_SG_REL_ BLTN_CAM_FD SG_ 126 HU_BLTN_CAM_Disp_Touch_Pos_X 0;
BA_REL_ "GenSigTimeoutTime" BU_SG_REL_ BLTN_CAM_FD SG_ 126 HU_BLTN_CAM_Disp_Touch_Pos_Y 0;
BA_REL_ "GenSigTimeoutTime" BU_SG_REL_ BLTN_CAM_FD SG_ 126 MEV_Rec_Req 0;
BA_REL_ "GenSigTimeoutTime" BU_SG_REL_ BLTN_CAM_FD SG_ 126 TML_Rec_Req 0;
BA_REL_ "GenSigTimeoutTime" BU_SG_REL_ BLTN_CAM_FD SG_ 126 BLTN_CAM_SD_Card_UnMt_Mt_Req 0;
BA_REL_ "GenSigTimeoutTime" BU_SG_REL_ BLTN_CAM_FD SG_ 126 BLTN_CAM_PMD_NvalueSet 0;
BA_REL_ "GenSigTimeoutTime" BU_SG_REL_ BLTN_CAM_FD SG_ 126 BLTN_CAM_PMDEV_NvalueSet 0;
BA_REL_ "GenSigTimeoutTime" BU_SG_REL_ BLTN_CAM_FD SG_ 126 BLTN_CAM_Ran_PMDR_NvalueSet 0;
BA_REL_ "GenSigTimeoutTime" BU_SG_REL_ BLTN_CAM_FD SG_ 126 BLTN_CAM_PMDTime_NvalueSet 0;
BA_REL_ "GenSigTimeoutTime" BU_SG_REL_ BLTN_CAM_FD SG_ 126 BLTN_CAM_BPR_TM_NvalueSet 0;
BA_REL_ "GenSigTimeoutTime" BU_SG_REL_ BLTN_CAM_FD SG_ 126 BLTN_CAM_BPR_RE_NvalueSet 0;
BA_REL_ "GenSigTimeoutTime" BU_SG_REL_ BLTN_CAM_FD SG_ 126 BLTN_CAM_BPR_SndRec_NvalueSet 0;
BA_REL_ "GenSigTimeoutTime" BU_SG_REL_ BLTN_CAM_FD SG_ 126 BLTN_CAM_BPR_AutRec_NvalueSet 0;
BA_REL_ "GenSigTimeoutTime" BU_SG_REL_ BLTN_CAM_FD SG_ 126 BLTN_CAM_BPR_Rec_Req 0;
BA_REL_ "GenSigTimeoutTime" BU_SG_REL_ BLTN_CAM_FD SG_ 126 BLTN_CAM_Rec_LPE_NvalueSet 0;
BA_REL_ "GenSigTimeoutTime" BU_SG_REL_ BLTN_CAM_FD SG_ 126 BLTN_CAM_Distort_NvalueSet 0;
BA_REL_ "GenSigTimeoutTime" BU_SG_REL_ BLTN_CAM_FD SG_ 126 BLTN_CAM_Pollution_NvalueSet 0;
BA_REL_ "GenSigTimeoutTime" BU_SG_REL_ BLTN_CAM_FD SG_ 126 BLTN_CAM_Crash_Pos_NvalueSet 0;
BA_REL_ "GenSigTimeoutTime" BU_SG_REL_ BLTN_CAM_FD SG_ 126 BLTN_CAM_Rear_Flip_NvalueSet 0;
BA_REL_ "GenSigTimeoutTime" BU_SG_REL_ BLTN_CAM_FD SG_ 126 BLTN_CAM_Stm_all_NvalueSet 0;
BA_REL_ "GenSigTimeoutTime" BU_SG_REL_ BLTN_CAM_FD SG_ 126 BLTN_CAM_Rec_OWD_NvalueSet 0;
BA_REL_ "GenSigTimeoutTime" BU_SG_REL_ BLTN_CAM_FD SG_ 126 BLTN_CAM_Rec_DEV_NvalueSet 0;
BA_REL_ "GenSigTimeoutTime" BU_SG_REL_ BLTN_CAM_FD SG_ 126 BLTN_CAM_Rec_OWP_NvalueSet 0;
BA_REL_ "GenSigTimeoutTime" BU_SG_REL_ BLTN_CAM_FD SG_ 126 BLTN_CAM_Rec_PEV_NvalueSet 0;
BA_REL_ "GenSigTimeoutTime" BU_SG_REL_ BLTN_CAM_FD SG_ 126 BLTN_CAM_AudRec_NvalueSet 0;
BA_REL_ "GenSigTimeoutTime" BU_SG_REL_ BLTN_CAM_FD SG_ 126 BLTN_CAM_Time_Stm_NvalueSet 0;
BA_REL_ "GenSigTimeoutTime" BU_SG_REL_ BLTN_CAM_FD SG_ 126 BLTN_CAM_Spd_Stm_NvalueSet 0;
BA_REL_ "GenSigTimeoutTime" BU_SG_REL_ BLTN_CAM_FD SG_ 126 BLTN_CAM_Locatn_Stm_NvalueSet 0;
BA_REL_ "GenSigTimeoutTime" BU_SG_REL_ BLTN_CAM_FD SG_ 126 BLTN_CAM_TrnSig_Stm_NvalueSet 0;
BA_REL_ "GenSigTimeoutTime" BU_SG_REL_ BLTN_CAM_FD SG_ 126 BLTN_CAM_AclBrk_Stm_NvalueSet 0;
BA_REL_ "GenSigTimeoutTime" BU_SG_REL_ BLTN_CAM_FD SG_ 126 BLTN_CAM_GearPos_Stm_NvalueSet 0;
BA_REL_ "GenSigTimeoutTime" BU_SG_REL_ BLTN_CAM_FD SG_ 126 BLTN_CAM_EVSen_Stm_NvalueSet 0;
BA_REL_ "GenSigTimeoutTime" BU_SG_REL_ BLTN_CAM_FD SG_ 126 BLTN_CAM_Strangl_Stm_NvalueSet 0;
BA_REL_ "GenSigTimeoutTime" BU_SG_REL_ BLTN_CAM_FD SG_ 126 BLTN_CAM_EV_RecMaxTime_NvalueSet 0;
BA_REL_ "GenSigTimeoutTime" BU_SG_REL_ BLTN_CAM_FD SG_ 126 BLTN_CAM_Rec_STRM_NvalueSet 0;
BA_REL_ "GenSigTimeoutTime" BU_SG_REL_ BLTN_CAM_FD SG_ 126 BLTN_CAM_PrkTime_NvalueSet 0;
VAL_ 250 HCU_Crc3Val 0 "0x0~0xFFFF:CRCValue" 65535 "0x0~0xFFFF:CRCValue" ;
VAL_ 250 HCU_SpdLimDeviceActSta 0 "Speed Limiter Lamp Off (Deactivation)" 1 "Speed Limiter Lamp On (Activation)" 2 "Not used" 3 "Error Indicator" ;
VAL_ 250 HCU_SpdLimDeviceOperSta 0 "Speed Limiter Not Operation" 1 "Speed Limiter Operation" 2 "Speed Limiter Standby" 3 "Error Inicator" ;
VAL_ 250 HCU_SpdLimDeviceVehSpdVal 0 "0x00~0xFF:real values" 255 "0x00~0xFF:real values" ;
VAL_ 250 HCU_SrvModSta 0 "Normal made" 1 "2WD Test mode" 2 "Not used" 3 "Error Indicator" ;
VAL_ 250 HCU_StrtInhbt2Sta 0 "None" 1 "Start Inhibit" 2 "Not used" 3 "Error Indicator" ;
VAL_ 250 HCU_StrtInhbtSta 0 "None" 1 "Start Inhibit state" 2 "Not used" 3 "Error Indicator" ;
VAL_ 250 HCU_PdlRgnCmpnRear 0 "Not Request" 1 "Compensation Request" 2 "RESERVED" 3 "RESERVED" ;
VAL_ 250 HCU_VehStrtEnblSta 0 "Start disable" 1 "Start Enable" 2 "Not used" 3 "Error Indicator" ;
VAL_ 250 HCU_BrkLmpOnReq 0 "None" 1 "Lamp On Request" 2 "Not Used" 3 "Error Indicator" ;
VAL_ 250 HCU_CcDrvAlrtDis 0 "default" 1 "CC Disengaged" 2 "No CC Engage Condition" 3 "reserved" ;
VAL_ 250 HCU_SldDrvAlrtDis 0 "default" 1 "SLDdisengeged" 2 "NoSLDEngageCondition" 3 "Reserve" ;
VAL_ 250 HCU_RspaAlvCntVal 0 "counter" 1 "counter" 2 "counter" 3 "counter" ;
VAL_ 250 HCU_RspaSta 0 "Invalid" 1 "Init" 2 "New Start" 3 "Ready OK" 4 "" 5 "Assist OK" 6 "Assist Fail" 7 "Abort" 8 "Ready Fail" ;
VAL_ 250 HCU_AlvCnt3Val 0 "0x0~0xFF:AlvCntValue" 255 "0x0~0xFF:AlvCntValue" ;
VAL_ 250 HCU_RspaCanFailSta 0 "HCU received RSPA CAN message successfully" 1 "HCU failed to receive RSPA CAN message succesfully" 2 "Reserved" 3 "Reserved" ;
VAL_ 250 HCU_PdlStopCtrlSta 0 "Not Request" 1 "Request" 2 "Not Used" 3 "Not Used" ;
VAL_ 250 HCU_PdlRgnCmpn 0 "Not Request" 1 "Compensation Request" 2 "RESERVED" 3 "RESERVED" ;
VAL_ 250 HCU_RForwardRq 0 "Not Request" 1 "R forward drive" 2 "RESERVED" 3 "RESERVED" ;
VAL_ 250 HCU_GearRInhbtSta 0 "Not Request" 1 "Request for Drive Inhibit Gear R" 2 "Reserve" 3 "Reserve" ;
VAL_ 250 HCU_GreenzoneDistinctGen 0 "Inactivate of an greenzone function" 1 "GEN1" 2 "GEN2" 3 "GEN3" 4 "GEN4" 5 "GEN5" 6 "RESERVED" 7 "RESERVED" 8 "RESERVED" 9 "RESERVED" 10 "RESERVED" 11 "RESERVED" 12 "RESERVED" 13 "RESERVED" 14 "RESERVED" 15 "INVALID" ;
VAL_ 250 HCU_2ndStpSig 0 "None" 1 "2nd Stop Request" 2 "RESERVED" 3 "Invalid" ;
VAL_ 250 HCU_11sMaxSpdLimOperSta 0 "Max Speed Limit Inactive" 1 "Max Speed Limit Active" 2 "RESERVED" 3 "RESERVED" ;
VAL_ 250 HCU_PMPDUsmSta 0 "Default" 1 "Off" 2 "On" 3 "Invalid" ;
VAL_ 250 HCU_PMPDActSta 0 "Off" 1 "PMPD On - Torque Limitation" 2 "PMPD On - Brake Act" 3 "PMPD Inactive" ;
VAL_ 250 HCU_PMPDWarnSta 0 "Default" 1 "Reactivation" 2 "Temporary Off" 3 "Off by System Fault" ;
VAL_ 250 HCU_STAYModSta 0 "Default (OFF)" 1 "STAY MODE ON" 2 "STAY MODE Abnormal HOLD" 3 "STAY MODE Normal HOLD" 4 "STAY MODE FINISHED" 5 "RESERVED" 6 "RESERVED" 7 "Invalid" ;
VAL_ 250 HCU_STAYModWarnSta 0 "System Normal" 1 "LOW SOC / Low Fuel" 2 "ENG On Request" 3 "Gear Condition dissatisfaction" 4 "System Abnormal" 5 "RESERVED" 6 "RESERVED" 7 "RESERVED" ;
VAL_ 250 HCU_STAYModReservationSta 0 "Default(Off)" 1 "Off" 2 "On" 3 "RESERVED" ;
VAL_ 250 HCU_STAYModBattMngmntSta 0 "Default(Off)" 1 "Off" 2 "On" 3 "RESERVED" ;
VAL_ 250 HCU_SmartRegen_HeadwayDstSet 0 "Default" 1 "Level1" 2 "Level2" 3 "Level3" 4 "RESERVED" 5 "RESERVED" 6 "RESERVED" 7 "Invalid" ;
VAL_ 250 HCU_EstApsSelSta 0 "EMS real APS use" 1 "HCU Estimated APS use" 2 "Not used" 3 "Error Indicator" ;
VAL_ 250 HCU_GreenZoneDrvModSta 0 "Default" 1 "Off" 2 "On" 3 "reserved" ;
VAL_ 250 HCU_GreenZoneLmpDis 0 "GDM Lamp Off" 1 "GDM Lamp On" ;
VAL_ 250 HCU_HcuRdySta 0 "HCU not Ready" 1 "HCU Control Board Ready" 2 "Not used" 3 "Error Indicator" ;
VAL_ 250 HCU_HEVRdyDis 0 "READY LAMP OFF" 1 "READY LAMP ON" 2 "Not used" 3 "READY LAMP BLINKING" ;
VAL_ 250 HCU_HevRdySta 0 "HEV not ready" 1 "HEV Drivable" 2 "Not used" 3 "Error Indicator" ;
VAL_ 250 HCU_LimpOffSta 0 "None" 1 "Limp off the road" 2 "Not used" 3 "Error Indicator" ;
VAL_ 250 HCU_MILOnReq 0 "Not request" 1 "MIL On Request" 2 "Not used" 3 "Error Indicator" ;
VAL_ 250 HCU_PhevAutoModOnSta 0 "AUTO Mode Off" 1 "AUTO Mode On" ;
VAL_ 250 HCU_SccDrvOvrdReq 0 "Override clear" 1 "Override set" 2 "Not used" 3 "Error Indicator" ;
VAL_ 250 HCU_SccEnblSta 0 "SCC Impossible" 1 "SCC Possible" 2 "Not used" 3 "Error Indicator" ;
VAL_ 250 HCU_SlwDnSta 0 "None" 1 "Slowdown state" 2 "Not used" 3 "Error Indicator" ;
VAL_ 250 HCU_SmrtEcoGdDis 0 "Off" 1 "On" 2 "Not used" 3 "Error Indicator" ;
VAL_ 250 HCU_SmrtEcoLvlDis 0 "Not Display" 1 "1~100%" 2 "1~100%" 3 "1~100%" 4 "1~100%" 5 "1~100%" 6 "1~100%" 7 "1~100%" 8 "1~100%" 9 "1~100%" 10 "1~100%" 11 "1~100%" 12 "1~100%" 13 "1~100%" 14 "1~100%" 15 "1~100%" 16 "1~100%" 17 "1~100%" 18 "1~100%" 19 "1~100%" 20 "1~100%" 21 "1~100%" 22 "1~100%" 23 "1~100%" 24 "1~100%" 25 "1~100%" 26 "1~100%" 27 "1~100%" 28 "1~100%" 29 "1~100%" 30 "1~100%" 31 "1~100%" 32 "1~100%" 33 "1~100%" 34 "1~100%" 35 "1~100%" 36 "1~100%" 37 "1~100%" 38 "1~100%" 39 "1~100%" 40 "1~100%" 41 "1~100%" 42 "1~100%" 43 "1~100%" 44 "1~100%" 45 "1~100%" 46 "1~100%" 47 "1~100%" 48 "1~100%" 49 "1~100%" 50 "1~100%" 51 "1~100%" 52 "1~100%" 53 "1~100%" 54 "1~100%" 55 "1~100%" 56 "1~100%" 57 "1~100%" 58 "1~100%" 59 "1~100%" 60 "1~100%" 61 "1~100%" 62 "1~100%" 63 "1~100%" 64 "1~100%" 65 "1~100%" 66 "1~100%" 67 "1~100%" 68 "1~100%" 69 "1~100%" 70 "1~100%" 71 "1~100%" 72 "1~100%" 73 "1~100%" 74 "1~100%" 75 "1~100%" 76 "1~100%" 77 "1~100%" 78 "1~100%" 79 "1~100%" 80 "1~100%" 81 "1~100%" 82 "1~100%" 83 "1~100%" 84 "1~100%" 85 "1~100%" 86 "1~100%" 87 "1~100%" 88 "1~100%" 89 "1~100%" 90 "1~100%" 91 "1~100%" 92 "1~100%" 93 "1~100%" 94 "1~100%" 95 "1~100%" 96 "1~100%" 97 "1~100%" 98 "1~100%" 99 "1~100%" 100 "1~100%" 101 "Reserved" 102 "Reserved" 103 "Reserved" 104 "Reserved" 105 "Reserved" 106 "Reserved" 107 "Reserved" 108 "Reserved" 109 "Reserved" 110 "Reserved" 111 "Reserved" 112 "Reserved" 113 "Reserved" 114 "Reserved" 115 "Reserved" 116 "Reserved" 117 "Reserved" 118 "Reserved" 119 "Reserved" 120 "Reserved" 121 "Reserved" 122 "Reserved" 123 "Reserved" 124 "Reserved" 125 "Reserved" 126 "Reserved" 127 "Reserved" ;
VAL_ 250 HCU_SmrtEcoRngDis 0 "Not Display" 1 "1~100%" 2 "1~100%" 3 "1~100%" 4 "1~100%" 5 "1~100%" 6 "1~100%" 7 "1~100%" 8 "1~100%" 9 "1~100%" 10 "1~100%" 11 "1~100%" 12 "1~100%" 13 "1~100%" 14 "1~100%" 15 "1~100%" 16 "1~100%" 17 "1~100%" 18 "1~100%" 19 "1~100%" 20 "1~100%" 21 "1~100%" 22 "1~100%" 23 "1~100%" 24 "1~100%" 25 "1~100%" 26 "1~100%" 27 "1~100%" 28 "1~100%" 29 "1~100%" 30 "1~100%" 31 "1~100%" 32 "1~100%" 33 "1~100%" 34 "1~100%" 35 "1~100%" 36 "1~100%" 37 "1~100%" 38 "1~100%" 39 "1~100%" 40 "1~100%" 41 "1~100%" 42 "1~100%" 43 "1~100%" 44 "1~100%" 45 "1~100%" 46 "1~100%" 47 "1~100%" 48 "1~100%" 49 "1~100%" 50 "1~100%" 51 "1~100%" 52 "1~100%" 53 "1~100%" 54 "1~100%" 55 "1~100%" 56 "1~100%" 57 "1~100%" 58 "1~100%" 59 "1~100%" 60 "1~100%" 61 "1~100%" 62 "1~100%" 63 "1~100%" 64 "1~100%" 65 "1~100%" 66 "1~100%" 67 "1~100%" 68 "1~100%" 69 "1~100%" 70 "1~100%" 71 "1~100%" 72 "1~100%" 73 "1~100%" 74 "1~100%" 75 "1~100%" 76 "1~100%" 77 "1~100%" 78 "1~100%" 79 "1~100%" 80 "1~100%" 81 "1~100%" 82 "1~100%" 83 "1~100%" 84 "1~100%" 85 "1~100%" 86 "1~100%" 87 "1~100%" 88 "1~100%" 89 "1~100%" 90 "1~100%" 91 "1~100%" 92 "1~100%" 93 "1~100%" 94 "1~100%" 95 "1~100%" 96 "1~100%" 97 "1~100%" 98 "1~100%" 99 "1~100%" 100 "1~100%" 101 "Reserved" 102 "Reserved" 103 "Reserved" 104 "Reserved" 105 "Reserved" 106 "Reserved" 107 "Reserved" 108 "Reserved" 109 "Reserved" 110 "Reserved" 111 "Reserved" 112 "Reserved" 113 "Reserved" 114 "Reserved" 115 "Reserved" 116 "Reserved" 117 "Reserved" 118 "Reserved" 119 "Reserved" 120 "Reserved" 121 "Reserved" 122 "Reserved" 123 "Reserved" 124 "Reserved" 125 "Reserved" 126 "Reserved" 127 "Reserved" ;
VAL_ 1325 BLTN_CAM_ADAS_PRK_Crc0Val 0 "0x0~0xFFFF:CRCValue" 65535 "0x0~0xFFFF:CRCValue" ;
VAL_ 1325 BLTN_CAM_ADAS_PRK_AlvCnt0Val 0 "0x0~0xFF:AlvCntValue" 255 "0x0~0xFF:AlvCntValue" ;
VAL_ 1325 BLTN_CAM_I2CMasterSta_Left 0 "Default" 1 "BLTN_CAM has control over I2C channel" 2 "ADAS_PRK has control over I2C channel" 3 "Invalid" ;
VAL_ 1325 BLTN_CAM_I2CMasterSta_Right 0 "Default" 1 "BLTN_CAM has control over I2C channel" 2 "ADAS_PRK has control over I2C channel" 3 "Invalid" ;
VAL_ 1325 BLTN_CAM_CamSta_Left 0 "Default" 1 "Normal (Recording)" 2 "Normal (Non-recording)" 3 "Not configured" 4 "SerDes config failed" 5 "Power issue" 6 "V-sync issue" 7 "SerDes lock issue" 8 "RESERVED" 9 "RESERVED" 10 "RESERVED" 11 "RESERVED" 12 "RESERVED" 13 "RESERVED" 14 "RESERVED" 15 "Invalid" ;
VAL_ 1325 BLTN_CAM_CamSta_Right 0 "Default" 1 "Normal (Recording)" 2 "Normal (Non-recording)" 3 "Not configured" 4 "SerDes config failed" 5 "Power issue" 6 "V-sync issue" 7 "SerDes lock issue" 8 "RESERVED" 9 "RESERVED" 10 "RESERVED" 11 "RESERVED" 12 "RESERVED" 13 "RESERVED" 14 "RESERVED" 15 "Invalid" ;
VAL_ 112 HDCT_TqIncReq 0 "Passive" 1 "Torque increase controls" 2 "Not used" 3 "Error Indicator" ;
VAL_ 112 HDCT_EOLReq 0 "No request" 1 "EOL request" 2 "Not used" 3 "Error Indicator" ;
VAL_ 112 HDCT_CltchSta 0 "Open" 1 "Slip" 2 "Locked" 3 "Locked&Micro Slip" ;
VAL_ 112 HDCT_DblCltchSta 0 "CS_Open" 1 "CS_TakeUp" 2 "CS_Engage" 3 "CS_Shift" 4 "CS_Drive" 5 "CS_Disengage" 6 "CS_SpinRequest" 7 "CS_TestMode" 8 "CS_Initialize" 9 "CS_Fail" ;
VAL_ 112 HDCT_AcnChrgInhbtReq 0 "-" 1 "Freeze AC clutch" 2 "Not used" 3 "Error Indicator" ;
VAL_ 112 HDCT_KckDnSkpShftCnt 0 "Normal K/D(No Skip변속) or No shift" 1 "1st Skip K/D" 2 "2nd Skip K/D" 3 "Error Indicator" ;
VAL_ 112 HDCT_FuelCutReq 0 "No Fuel Cut request" 1 "Activation of Fuel Cut request" 2 "Not used" 3 "Error Indicator" ;
VAL_ 112 HDCT_NCoastTrgtGear 0 "gN" 1 "g1" 2 "g2" 3 "g3" 4 "g4" 5 "g5" 6 "g6" 7 "None" 8 "None" 9 "None" 10 "None" 11 "None" 12 "None" 13 "None" 14 "None" 15 "gR" ;
VAL_ 112 HDCT_NCoastDnReq 0 "Off" 1 "On" 2 "Not used" 3 "Error Indicator" ;
VAL_ 112 HDCT_CLUEngSpd 8191 "Error Indicator" ;
VAL_ 112 HDCT_CLUEngSpdFlag 0 "Off" 1 "On" 2 "Not used" 3 "Error Indicator" ;
VAL_ 112 HDCT_CLUTrgtGear 0 "If N or P are detected(No frictional conncetion)" 1 "1st speed" 2 "2nd speed" 3 "3rd speed" 4 "4th speed" 5 "5th speed" 6 "6th speed" 7 "7th speed" 15 "Reverse" ;
VAL_ 112 HDCT_GSITrgtGear 0 "Neutral (Initial Value)" 1 "1st speed" 2 "2nd speed" 3 "3rd speed" 4 "4th speed" 5 "5th speed" 6 "6th speed" 7 "Reserved" 8 "Reserved" 9 "Reserved" 10 "Reserved" 11 "Reserved" 12 "Reserved" 13 "Reserved" 14 "Reserved" 15 "Reserved" ;
VAL_ 112 HDCT_PtrnGear 0 "if N or P are detected (no frictional connection)" 1 "1st speed" 2 "2nd speed" 3 "3rd speed" 4 "4th speed" 5 "5th speed" 6 "6th speed" 15 "Reverse speed" ;
VAL_ 112 HDCT_OBDErrSta 0 "No error" 1 "OBD error" 2 "Not used" 3 "Error Indicator" ;
VAL_ 112 HDCT_StcShftLrchCtrl 0 "No DR or RD lurch control" 1 "DR lurch control active" 2 "RD lurch control active" 3 "Error Indicator" ;
VAL_ 112 HDCT_EngCltchLmphmMod 0 "Inactive" 1 "Active" 2 "Not used" 3 "Error Indicator" ;
VAL_ 112 HDCT_CurrPrgrm 0 "SOS" 1 "ECO" 16 "ACC_NLD" 17 "ACC_LD1" 18 "ACC_LD2" 19 "ACC_LD3" 20 "Manual" 21 "Manual_LD" 22 "CLT_PRT" 23 "TCS_NLD" 24 "TCS_LD" 25 "NORMAL" 26 "ECO_DLD" 27 "DS_DLD" 28 "EVEN" 29 "ODD" 30 "CD (EV Mode)" 31 "Reserve" 2 "DS" 3 "ECO_LD1" 4 "ECO_LD2" 5 "ECO_LD3" 6 "ECO_LD1_HAT" 7 "ECO_LD2_HAT" 8 "ECO_LD3_HAT" 9 "DS_LD1" 10 "DS_LD2" 11 "DS_LD3" 12 "SOC_L" 13 "SOC_N" 14 "SOC_H" 15 "Highway" ;
VAL_ 112 HDCT_FltSta 0 "No fault" 1 "TCU Diagnostic failure" 2 "" 3 "TCU Diagnostic faulure & Limphome activated" 4 "OPU/EOP Diagnostic failure" 5 "" 6 "" 7 "" ;
VAL_ 112 HDCT_MCUAntJrkInhbt 0 "Anti-jerk not inhibit" 1 "Anti-jerk inhibit" 2 "Not used" 3 "Error Indicator" ;
VAL_ 112 HDCT_TrgtGear 0 "If N or P are detected(No frictional conncetion)" 1 "1st speed" 2 "2nd speed" 3 "3rd speed" 4 "4th speed" 5 "5th speed" 6 "6th speed" 15 "Reverse" ;
VAL_ 112 HDCT_CurrGear 0 "if N or P are detected (no frictional connection)" 1 "1st speed" 2 "2nd speed" 3 "3rd speed" 4 "4th speed" 5 "5th speed" 6 "6th speed" 15 "Reverse speed" ;
VAL_ 112 HDCT_GearSelDis 0 "P" 1 "L" 2 "2" 3 "3" 4 "DS Mode (by TGS lever)" 5 "D" 6 "N" 7 "R" 8 "Sports/Manual Mode" 9 "Not display at Cluster" 10 "DS Mode (by Drive Mode button)" 11 "RESERVED" 12 "Paddle shift" 13 "Full-time manual shift" 14 "Intermediate Position" 15 "Fault" ;
VAL_ 112 HDCT_TCURdySta 0 "Not ready" 1 "Ready" 2 "Not used" 3 "Error Indicator" ;
VAL_ 112 HDCT_CtrlablSta 0 "Not Ready" 1 "Controllable" 2 "Not used" 3 "Error Indicator" ;
VAL_ 112 HDCT_TrgtShftCls 0 "static" 1 "Pon UP" 2 "Poff UP" 3 "reserve" 4 "Pon DN" 5 "PoffDn(manual)" 6 "NSTP to 5;4;3;2" 7 "NSTP to 1" 8 "reserve" 9 "reserve" 10 "reserve" 11 "reserve" 12 "reserve" 13 "reserve" 14 "reserve" ;
VAL_ 112 HDCT_ShftPhase 0 "No shift" 1 "A0 (Prepataion for shift)" 2 "A1 (Prepataion for shift)" 3 "A2 (Prepataion for shift)" 4 "A3 (Prepataion for shift)" 5 "B1 (Beginning of shift)" 6 "B2 (Beginning of shift)" 7 "B3 (Beginning of shift)" 8 "B4 (Beginning of shift)" 9 "C1 (Duration of actual shift)" 10 "C2 (Duration of actual shift)" 11 "C3 (Duration of actual shift)" 12 "D1 (Duration of actual shift)" 13 "E1 (Finishing shift)" 14 "E2 (Finishing shift)" 15 "E3 (Finishing shift)" 16 "END (Shift End)" ;
VAL_ 112 HDCT_NetrlCtrlSta 0 "Not complete" 1 "Complete" 2 "Not used" 3 "Error Indicator" ;
VAL_ 112 HDCT_GearShftSta 0 "Inactive" 1 "Active" 2 "Not used" 3 "Error Indicator" ;
VAL_ 126 HU_BLTN_CAM_Crc1Val 0 "0x0~0xFFFF:CRCValue" 65535 "0x0~0xFFFF:CRCValue" ;
VAL_ 126 BLTN_CAM_EV_BfrTime_NvalueSet 0 "10~20 sec" 1 "10~20 sec" 2 "10~20 sec" 3 "10~20 sec" 4 "10~20 sec" 5 "10~20 sec" 6 "10~20 sec" 7 "10~20 sec" 8 "10~20 sec" 9 "10~20 sec" 10 "10~20 sec" 11 "RESERVED" 12 "RESERVED" 13 "RESERVED" 14 "RESERVED" 15 "RESERVED" 16 "RESERVED" 17 "RESERVED" 18 "RESERVED" 19 "RESERVED" 20 "RESERVED" 21 "RESERVED" 22 "RESERVED" 23 "RESERVED" 24 "RESERVED" 25 "RESERVED" 26 "RESERVED" 27 "RESERVED" 28 "RESERVED" 29 "RESERVED" 30 "RESERVED" 31 "Invalid" ;
VAL_ 126 BLTN_CAM_EV_AftTime_NvalueSet 0 "10~20 sec" 1 "10~20 sec" 2 "10~20 sec" 3 "10~20 sec" 4 "10~20 sec" 5 "10~20 sec" 6 "10~20 sec" 7 "10~20 sec" 8 "10~20 sec" 9 "10~20 sec" 10 "10~20 sec" 11 "RESERVED" 12 "RESERVED" 13 "RESERVED" 14 "RESERVED" 15 "RESERVED" 16 "RESERVED" 17 "RESERVED" 18 "RESERVED" 19 "RESERVED" 20 "RESERVED" 21 "RESERVED" 22 "RESERVED" 23 "RESERVED" 24 "RESERVED" 25 "RESERVED" 26 "RESERVED" 27 "RESERVED" 28 "RESERVED" 29 "RESERVED" 30 "RESERVED" 31 "Invalid" ;
VAL_ 126 BLTN_CAM_TML_Int_NvalueSet 0 "Default" 1 "1~ 10 sec" 2 "1~ 10 sec" 3 "1~ 10 sec" 4 "1~ 10 sec" 5 "1~ 10 sec" 6 "1~ 10 sec" 7 "1~ 10 sec" 8 "1~ 10 sec" 9 "1~ 10 sec" 10 "1~ 10 sec" 11 "Reserved" 12 "Reserved" 13 "Reserved" 14 "Reserved" 15 "Invalid" ;
VAL_ 126 BLTN_CAM_Sen_DEV_NvalueSet 0 "Default" 1 "Level 1" 2 "Level 2" 3 "Level 3" 4 "Level 4" 5 "Level 5" 6 "Reserved" 7 "Reserved" 8 "Reserved" 9 "Reserved" 10 "Reserved" 11 "Reserved" 12 "Reserved" 13 "Reserved" 14 "Reserved" 15 "Invalid" ;
VAL_ 126 BLTN_CAM_Sen_PEV_NvalueSet 0 "Default" 1 "Level 1" 2 "Level 2" 3 "Level 3" 4 "Level 4" 5 "Level 5" 6 "Reserved" 7 "Reserved" 8 "Reserved" 9 "Reserved" 10 "Reserved" 11 "Reserved" 12 "Reserved" 13 "Reserved" 14 "Reserved" 15 "Invalid" ;
VAL_ 126 BLTN_CAM_FR_VerPos_NvalueSet 0 "Mid" 1 "Upper Level (1 ~ 10)" 2 "Upper Level (1 ~ 10)" 3 "Upper Level (1 ~ 10)" 4 "Upper Level (1 ~ 10)" 5 "Upper Level (1 ~ 10)" 6 "Upper Level (1 ~ 10)" 7 "Upper Level (1 ~ 10)" 8 "Upper Level (1 ~ 10)" 9 "Upper Level (1 ~ 10)" 10 "Upper Level (1 ~ 10)" 11 "RESERVED" 12 "RESERVED" 13 "RESERVED" 14 "RESERVED" 15 "RESERVED" 16 "RESERVED" 17 "Lower Level (-1 ~ -10)" 18 "Lower Level (-1 ~ -10)" 19 "Lower Level (-1 ~ -10)" 20 "Lower Level (-1 ~ -10)" 21 "Lower Level (-1 ~ -10)" 22 "Lower Level (-1 ~ -10)" 23 "Lower Level (-1 ~ -10)" 24 "Lower Level (-1 ~ -10)" 25 "Lower Level (-1 ~ -10)" 26 "Lower Level (-1 ~ -10)" 27 "RESERVED" 28 "RESERVED" 29 "RESERVED" 30 "RESERVED" 31 "Invalid" ;
VAL_ 126 BLTN_CAM_RR_VerPos_NvalueSet 0 "Mid" 1 "Upper Level (1 ~ 10)" 2 "Upper Level (1 ~ 10)" 3 "Upper Level (1 ~ 10)" 4 "Upper Level (1 ~ 10)" 5 "Upper Level (1 ~ 10)" 6 "Upper Level (1 ~ 10)" 7 "Upper Level (1 ~ 10)" 8 "Upper Level (1 ~ 10)" 9 "Upper Level (1 ~ 10)" 10 "Upper Level (1 ~ 10)" 11 "RESERVED" 12 "RESERVED" 13 "RESERVED" 14 "RESERVED" 15 "RESERVED" 16 "RESERVED" 17 "Lower Level (-1 ~ -10)" 18 "Lower Level (-1 ~ -10)" 19 "Lower Level (-1 ~ -10)" 20 "Lower Level (-1 ~ -10)" 21 "Lower Level (-1 ~ -10)" 22 "Lower Level (-1 ~ -10)" 23 "Lower Level (-1 ~ -10)" 24 "Lower Level (-1 ~ -10)" 25 "Lower Level (-1 ~ -10)" 26 "Lower Level (-1 ~ -10)" 27 "RESERVED" 28 "RESERVED" 29 "RESERVED" 30 "RESERVED" 31 "Invalid" ;
VAL_ 126 BLTN_CAM_AppNoti_PEV_NvalueSet 0 "Default" 1 "Off" 2 "On" 3 "Invalid" ;
VAL_ 126 BLTN_CAM_WiFi_AutoOn_NvalueSet 0 "Default" 1 "Off" 2 "On" 3 "Invalid" ;
VAL_ 126 BLTN_CAM_StoProp_NvalueSet 0 "Normal" 1 "On While Recordings" 2 "On While Parked" 3 "Driving Events" 4 "Parked Events" 5 "Reserved" 6 "Reserved" 7 "Reserved" 8 "Reserved" 9 "Reserved" 10 "Reserved" 11 "Reserved" 12 "Reserved" 13 "Reserved" 14 "Reserved" 15 "Invalid" ;
VAL_ 126 CF_AVN_BLTN_CAM_USMReset 0 "Default" 1 "Built-in CAM USM Reset" 2 "Reserved" 3 "Invalid" ;
VAL_ 126 CF_AVN_BLTN_CAM_RecReset 0 "Default" 1 "Record Data Reset(format)" 2 "Reserved" 3 "Invalid" ;
VAL_ 126 BLTN_CAM_File_DEL_CPY_Cmd 0 "Default" 1 "Pause the operation" 2 "Cancel the operation" 3 "Continue operation" 4 "Reserved" 5 "Reserved" 6 "Reserved" 7 "Reserved" 8 "Reserved" 9 "Reserved" 10 "Reserved" 11 "Reserved" 12 "Reserved" 13 "Reserved" 14 "Reserved" 15 "Invalid" ;
VAL_ 126 BLTN_CAM_LVDS_Mode_Cmd 0 "Front and Rear Camera" 1 "Front Camera for AR Navi." 2 "Built-In Cam Engineer Mode" 3 "Reserved" ;
VAL_ 126 HU_BLTN_CAM_Disp_Touch_Pos_X 0 "0x0~0x77F:X position of the touch(Pixel)" 1919 "0x0~0x77F:X position of the touch(Pixel)" 2046 "Default" 2047 "Invalid" ;
VAL_ 126 HU_BLTN_CAM_AlvCnt1Val 0 "0x0~0xFF:AlvCntValue" 255 "0x0~0xFF:AlvCntValue" ;
VAL_ 126 HU_BLTN_CAM_Disp_Touch_Pos_Y 0 "0x0~0x3FD:Y position of the touch(Pixel)" 1021 "0x0~0x3FD:Y position of the touch(Pixel)" 1022 "Default" 1023 "Invalid" ;
VAL_ 126 MEV_Rec_Req 0 "Default" 1 "On" 2 "RESERVED" 3 "Invalid" ;
VAL_ 126 TML_Rec_Req 0 "Default" 1 "Start Request" 2 "End Request" 3 "Invalid" ;
VAL_ 126 BLTN_CAM_SD_Card_UnMt_Mt_Req 0 "Default" 1 "UnMount Request" 2 "Mount Request" 3 "Invalid" ;
VAL_ 126 BLTN_CAM_PMD_NvalueSet 0 "Default" 1 "Off" 2 "On" 3 "Invalid" ;
VAL_ 126 BLTN_CAM_PMDEV_NvalueSet 0 "Default" 1 "Off" 2 "On" 3 "Invalid" ;
VAL_ 126 BLTN_CAM_Ran_PMDR_NvalueSet 0 "Default" 1 "Level 1" 2 "Level 2" 3 "Level 3" 4 "Level 4" 5 "Level 5" 6 "RESERVED" 7 "RESERVED" 8 "RESERVED" 9 "RESERVED" 10 "RESERVED" 11 "RESERVED" 12 "RESERVED" 13 "RESERVED" 14 "RESERVED" 15 "Invalid" ;
VAL_ 126 BLTN_CAM_PMDTime_NvalueSet 0 "Default" 1 "1~0xFB:1~ 251 hr" 251 "1~0xFB:1~ 251 hr" 252 "RESERVED" 253 "RESERVED" 254 "Not Support" 255 "Invalid" ;
VAL_ 126 BLTN_CAM_BPR_TM_NvalueSet 0 "Default" 1 "Track Mode 1" 2 "Track Mode 2" 3 "Track Mode 3" 4 "Track Mode 4" 5 "RESERVED" 6 "RESERVED" 7 "Invalid" ;
VAL_ 126 BLTN_CAM_BPR_RE_NvalueSet 0 "Default" 1 "Resolution Mode 1" 2 "Resolution Mode 2" 3 "Resolution Mode 3" 4 "Resolution Mode 4" 5 "RESERVED" 6 "RESERVED" 7 "Invalid" ;
VAL_ 126 BLTN_CAM_BPR_SndRec_NvalueSet 0 "Default" 1 "Off" 2 "On" 3 "Invalid" ;
VAL_ 126 BLTN_CAM_BPR_AutRec_NvalueSet 0 "Default" 1 "Off" 2 "On" 3 "Invalid" ;
VAL_ 126 BLTN_CAM_BPR_Rec_Req 0 "Off" 1 "Start Request" 2 "End Request" 3 "Invalid" ;
VAL_ 126 BLTN_CAM_Rec_LPE_NvalueSet 0 "Default" 1 "Off" 2 "On" 3 "Invalid" ;
VAL_ 126 BLTN_CAM_Distort_NvalueSet 0 "Default" 1 "Off" 2 "On" 3 "Invalid" ;
VAL_ 126 BLTN_CAM_Pollution_NvalueSet 0 "Default" 1 "Off" 2 "On" 3 "Invalid" ;
VAL_ 126 BLTN_CAM_Crash_Pos_NvalueSet 0 "Default" 1 "Off" 2 "On" 3 "Invalid" ;
VAL_ 126 BLTN_CAM_Rear_Flip_NvalueSet 0 "Default" 1 "Off" 2 "On" 3 "Invalid" ;
VAL_ 126 BLTN_CAM_Stm_all_NvalueSet 0 "Default" 1 "Off" 2 "On" 3 "Invalid" ;
VAL_ 126 BLTN_CAM_Rec_OWD_NvalueSet 0 "Default" 1 "Off" 2 "On" 3 "Invalid" ;
VAL_ 126 BLTN_CAM_Rec_DEV_NvalueSet 0 "Default" 1 "Off" 2 "On" 3 "Invalid" ;
VAL_ 126 BLTN_CAM_Rec_OWP_NvalueSet 0 "Default" 1 "Off" 2 "On" 3 "Invalid" ;
VAL_ 126 BLTN_CAM_Rec_PEV_NvalueSet 0 "Default" 1 "Off" 2 "On" 3 "Invalid" ;
VAL_ 126 BLTN_CAM_AudRec_NvalueSet 0 "Default" 1 "Off" 2 "On" 3 "Invalid" ;
VAL_ 126 BLTN_CAM_Time_Stm_NvalueSet 0 "Default" 1 "Off" 2 "On" 3 "Invalid" ;
VAL_ 126 BLTN_CAM_Spd_Stm_NvalueSet 0 "Default" 1 "Off" 2 "On" 3 "Invalid" ;
VAL_ 126 BLTN_CAM_Locatn_Stm_NvalueSet 0 "Default" 1 "Off" 2 "On" 3 "Invalid" ;
VAL_ 126 BLTN_CAM_TrnSig_Stm_NvalueSet 0 "Default" 1 "Off" 2 "On" 3 "Invalid" ;
VAL_ 126 BLTN_CAM_AclBrk_Stm_NvalueSet 0 "Default" 1 "Off" 2 "On" 3 "Invalid" ;
VAL_ 126 BLTN_CAM_GearPos_Stm_NvalueSet 0 "Default" 1 "Off" 2 "On" 3 "Invalid" ;
VAL_ 126 BLTN_CAM_EVSen_Stm_NvalueSet 0 "Default" 1 "Off" 2 "On" 3 "Invalid" ;
VAL_ 126 BLTN_CAM_Strangl_Stm_NvalueSet 0 "Default" 1 "Off" 2 "On" 3 "Invalid" ;
VAL_ 126 BLTN_CAM_EV_RecMaxTime_NvalueSet 0 "Default" 1 "Off" 2 "On" 3 "Invalid" ;
VAL_ 126 BLTN_CAM_Rec_STRM_NvalueSet 0 "Default" 1 "Off" 2 "On" 3 "Invalid" ;
VAL_ 126 BLTN_CAM_PrkTime_NvalueSet 0 "Default" 1 "01~0xFB:1~ 251  hr" 251 "01~0xFB:1~ 251  hr" 252 "RESERVED" 253 "RESERVED" 254 "Not Supported" 255 "Invalid" ;
VAL_ 2549874789 SNI_SHVU_CCS_FD 0 "0x0~0xFF:NM Source Node ID" 255 "0x0~0xFF:NM Source Node ID" ;
VAL_ 2549874789 CBV_RMR_SHVU_CCS_FD 0 "Repeat Message State not requested" 1 "Repeat Message State requested" ;
VAL_ 2549874789 CBV_NMCoID_SHVU_CCS_FD 0 "NM Coordinator ID" 1 "NM Coordinator ID" 2 "NM Coordinator ID" 3 "NM Coordinator ID" ;
VAL_ 2549874789 CBV_NMCoSRB_SHVU_CCS_FD 0 "Start of synchronized shutdown is not requested by main coordinator" 1 "Start of synchronized shutdown is requested by main coordinator" ;
VAL_ 2549874789 CBV_AWB_SHVU_CCS_FD 0 "Node has not woken up the network (passive wakeup)" 1 "Node has woken up the network (active wakeup)" ;
VAL_ 2549874789 CBV_PNIB_SHVU_CCS_FD 0 "NM PDU contains no partial network cluster information in the user data area" 1 "NM PDU contains partial network cluster information in the user data area" ;
VAL_ 2549874789 NRR_SHVU_CCS_FD 0 "Default" 1 "1~0xFF:RESERVED" 255 "1~0xFF:RESERVED" ;
VAL_ 2549874789 NM_State_SHVU_CCS_FD 0 "Default" 1 "NM_RMS_BSM" 2 "NM_RMS_PBSM" 3 "RESERVED" 4 "NM_NS_RMS" 5 "RESERVED" 6 "RESERVED" 7 "RESERVED" 8 "NM_NS_RSS" 9 "RESERVED" 10 "RESERVED" 11 "RESERVED" 12 "RESERVED" 13 "RESERVED" 14 "RESERVED" 15 "RESERVED" 16 "NM_RMS_RSS" 17 "RESERVED" 18 "RESERVED" 19 "RESERVED" 20 "RESERVED" 21 "RESERVED" 22 "RESERVED" 23 "RESERVED" 24 "RESERVED" 25 "RESERVED" 26 "RESERVED" 27 "RESERVED" 28 "RESERVED" 29 "RESERVED" 30 "RESERVED" 31 "RESERVED" 32 "NM_RMS_NS" 33 "21~0xFF:RESERVED" 255 "21~0xFF:RESERVED" ;
VAL_ 2549874789 PNI_SHVU_CCS_FD 0 "0x0~0xFFFFFFFF:NM PNC Bit" 2147483647 "0x0~0xFFFFFFFF:NM PNC Bit" ;
VAL_ 2549874789 PNI_SHVU_CCS_FD_1 0 "0x0~0xFFFFFFFFFFFFFFFF:NM PNC Bit" ;
VAL_ 2549874789 PNI_SHVU_CCS_FD_2 0 "0x0~0xFFFFFFFFFFFFFFFF:NM PNC Bit" ;
VAL_ 2549874789 PNI_SHVU_CCS_FD_3 0 "0x0~0xFFFFFFFFFFFFFFFF:NM PNC Bit" ;
VAL_ 2549874826 SNI_ARS_FD 0 "0x0~0xFF:NM Source Node ID" 255 "0x0~0xFF:NM Source Node ID" ;
VAL_ 2549874826 CBV_RMR_ARS_FD 0 "Repeat Message State not requested" 1 "Repeat Message State requested" ;
VAL_ 2549874826 CBV_NMCoID_ARS_FD 0 "NM Coordinator ID" 1 "NM Coordinator ID" 2 "NM Coordinator ID" 3 "NM Coordinator ID" ;
VAL_ 2549874826 CBV_NMCoSRB_ARS_FD 0 "Start of synchronized shutdown is not requested by main coordinator" 1 "Start of synchronized shutdown is requested by main coordinator" ;
VAL_ 2549874826 CBV_AWB_ARS_FD 0 "Node has not woken up the network (passive wakeup)" 1 "Node has woken up the network (active wakeup)" ;
VAL_ 2549874826 CBV_PNIB_ARS_FD 0 "NM PDU contains no partial network cluster information in the user data area" 1 "NM PDU contains partial network cluster information in the user data area" ;
VAL_ 2549874826 NRR_ARS_FD 0 "Default" 1 "1~0xFF:RESERVED" 255 "1~0xFF:RESERVED" ;
VAL_ 2549874826 NM_State_ARS_FD 0 "Default" 1 "NM_RMS_BSM" 2 "NM_RMS_PBSM" 3 "RESERVED" 4 "NM_NS_RMS" 5 "RESERVED" 6 "RESERVED" 7 "RESERVED" 8 "NM_NS_RSS" 9 "RESERVED" 10 "RESERVED" 11 "RESERVED" 12 "RESERVED" 13 "RESERVED" 14 "RESERVED" 15 "RESERVED" 16 "NM_RMS_RSS" 17 "RESERVED" 18 "RESERVED" 19 "RESERVED" 20 "RESERVED" 21 "RESERVED" 22 "RESERVED" 23 "RESERVED" 24 "RESERVED" 25 "RESERVED" 26 "RESERVED" 27 "RESERVED" 28 "RESERVED" 29 "RESERVED" 30 "RESERVED" 31 "RESERVED" 32 "NM_RMS_NS" 33 "21~0xFF:RESERVED" 255 "21~0xFF:RESERVED" ;
VAL_ 2549874826 PNI_ARS_FD 0 "0x0~0xFFFFFFFF:NM PNC Bit" 2147483647 "0x0~0xFFFFFFFF:NM PNC Bit" ;
VAL_ 2549874826 PNI_ARS_FD_1 0 "0x0~0xFFFFFFFFFFFFFFFF:NM PNC Bit" ;
VAL_ 2549874826 PNI_ARS_FD_2 0 "0x0~0xFFFFFFFFFFFFFFFF:NM PNC Bit" ;
VAL_ 2549874826 PNI_ARS_FD_3 0 "0x0~0xFFFFFFFFFFFFFFFF:NM PNC Bit" ;
VAL_ 2549874846 SNI_WPC_FD 0 "0x0~0xFF:NM Source Node ID" 255 "0x0~0xFF:NM Source Node ID" ;
VAL_ 2549874846 CBV_RMR_WPC_FD 0 "Repeat Message State not requested" 1 "Repeat Message State requested" ;
VAL_ 2549874846 CBV_NMCoID_WPC_FD 0 "NM Coordinator ID" 1 "NM Coordinator ID" 2 "NM Coordinator ID" 3 "NM Coordinator ID" ;
VAL_ 2549874846 CBV_NMCoSRB_WPC_FD 0 "Start of synchronized shutdown is not requested by main coordinator" 1 "Start of synchronized shutdown is requested by main coordinator" ;
VAL_ 2549874846 CBV_AWB_WPC_FD 0 "Node has not woken up the network (passive wakeup)" 1 "Node has woken up the network (active wakeup)" ;
VAL_ 2549874846 CBV_PNIB_WPC_FD 0 "NM PDU contains no partial network cluster information in the user data area" 1 "NM PDU contains partial network cluster information in the user data area" ;
VAL_ 2549874846 NRR_WPC_FD 0 "Default" 1 "1~0xFF:RESERVED" 255 "1~0xFF:RESERVED" ;
VAL_ 2549874846 NM_State_WPC_FD 0 "Default" 1 "NM_RMS_BSM" 2 "NM_RMS_PBSM" 3 "RESERVED" 4 "NM_NS_RMS" 5 "RESERVED" 6 "RESERVED" 7 "RESERVED" 8 "NM_NS_RSS" 9 "RESERVED" 10 "RESERVED" 11 "RESERVED" 12 "RESERVED" 13 "RESERVED" 14 "RESERVED" 15 "RESERVED" 16 "NM_RMS_RSS" 17 "RESERVED" 18 "RESERVED" 19 "RESERVED" 20 "RESERVED" 21 "RESERVED" 22 "RESERVED" 23 "RESERVED" 24 "RESERVED" 25 "RESERVED" 26 "RESERVED" 27 "RESERVED" 28 "RESERVED" 29 "RESERVED" 30 "RESERVED" 31 "RESERVED" 32 "NM_RMS_NS" 33 "21~0xFF:RESERVED" 255 "21~0xFF:RESERVED" ;
VAL_ 2549874846 PNI_WPC_FD 0 "0x0~0xFFFFFFFF:NM PNC Bit" 2147483647 "0x0~0xFFFFFFFF:NM PNC Bit" ;
VAL_ 2549874846 PNI_WPC_FD_1 0 "0x0~0xFFFFFFFFFFFFFFFF:NM PNC Bit" ;
VAL_ 2549874846 PNI_WPC_FD_2 0 "0x0~0xFFFFFFFFFFFFFFFF:NM PNC Bit" ;
VAL_ 2549874846 PNI_WPC_FD_3 0 "0x0~0xFFFFFFFFFFFFFFFF:NM PNC Bit" ;
VAL_ 2549874837 SNI_WPC2_FD 0 "0x0~0xFF:NM Source Node ID" 255 "0x0~0xFF:NM Source Node ID" ;
VAL_ 2549874837 CBV_RMR_WPC2_FD 0 "Repeat Message State not requested" 1 "Repeat Message State requested" ;
VAL_ 2549874837 CBV_NMCoID_WPC2_FD 0 "NM Coordinator ID" 1 "NM Coordinator ID" 2 "NM Coordinator ID" 3 "NM Coordinator ID" ;
VAL_ 2549874837 CBV_NMCoSRB_WPC2_FD 0 "Start of synchronized shutdown is not requested by main coordinator" 1 "Start of synchronized shutdown is requested by main coordinator" ;
VAL_ 2549874837 CBV_AWB_WPC2_FD 0 "Node has not woken up the network (passive wakeup)" 1 "Node has woken up the network (active wakeup)" ;
VAL_ 2549874837 CBV_PNIB_WPC2_FD 0 "NM PDU contains no partial network cluster information in the user data area" 1 "NM PDU contains partial network cluster information in the user data area" ;
VAL_ 2549874837 NRR_WPC2_FD 0 "Default" 1 "1~0xFF:RESERVED" 255 "1~0xFF:RESERVED" ;
VAL_ 2549874837 NM_State_WPC2_FD 0 "Default" 1 "NM_RMS_BSM" 2 "NM_RMS_PBSM" 3 "RESERVED" 4 "NM_NS_RMS" 5 "RESERVED" 6 "RESERVED" 7 "RESERVED" 8 "NM_NS_RSS" 9 "RESERVED" 10 "RESERVED" 11 "RESERVED" 12 "RESERVED" 13 "RESERVED" 14 "RESERVED" 15 "RESERVED" 16 "NM_RMS_RSS" 17 "RESERVED" 18 "RESERVED" 19 "RESERVED" 20 "RESERVED" 21 "RESERVED" 22 "RESERVED" 23 "RESERVED" 24 "RESERVED" 25 "RESERVED" 26 "RESERVED" 27 "RESERVED" 28 "RESERVED" 29 "RESERVED" 30 "RESERVED" 31 "RESERVED" 32 "NM_RMS_NS" 33 "21~0xFF:RESERVED" 255 "21~0xFF:RESERVED" ;
VAL_ 2549874837 PNI_WPC2_FD 0 "0x0~0xFFFFFFFF:NM PNC Bit" 2147483647 "0x0~0xFFFFFFFF:NM PNC Bit" ;
VAL_ 2549874837 PNI_WPC2_FD_1 0 "0x0~0xFFFFFFFFFFFFFFFF:NM PNC Bit" ;
VAL_ 2549874837 PNI_WPC2_FD_2 0 "0x0~0xFFFFFFFFFFFFFFFF:NM PNC Bit" ;
VAL_ 2549874837 PNI_WPC2_FD_3 0 "0x0~0xFFFFFFFFFFFFFFFF:NM PNC Bit" ;
VAL_ 2549874823 SNI_SCM_FD 0 "0x0~0xFF:NM Source Node ID" 255 "0x0~0xFF:NM Source Node ID" ;
VAL_ 2549874823 CBV_RMR_SCM_FD 0 "Repeat Message State not requested" 1 "Repeat Message State requested" ;
VAL_ 2549874823 CBV_NMCoID_SCM_FD 0 "NM Coordinator ID" 1 "NM Coordinator ID" 2 "NM Coordinator ID" 3 "NM Coordinator ID" ;
VAL_ 2549874823 CBV_NMCoSRB_SCM_FD 0 "Start of synchronized shutdown is not requested by main coordinator" 1 "Start of synchronized shutdown is requested by main coordinator" ;
VAL_ 2549874823 CBV_AWB_SCM_FD 0 "Node has not woken up the network (passive wakeup)" 1 "Node has woken up the network (active wakeup)" ;
VAL_ 2549874823 CBV_PNIB_SCM_FD 0 "NM PDU contains no partial network cluster information in the user data area" 1 "NM PDU contains partial network cluster information in the user data area" ;
VAL_ 2549874823 NRR_SCM_FD 0 "Default" 1 "1~0xFF:RESERVED" 255 "1~0xFF:RESERVED" ;
VAL_ 2549874823 NM_State_SCM_FD 0 "Default" 1 "NM_RMS_BSM" 2 "NM_RMS_PBSM" 3 "RESERVED" 4 "NM_NS_RMS" 5 "RESERVED" 6 "RESERVED" 7 "RESERVED" 8 "NM_NS_RSS" 9 "RESERVED" 10 "RESERVED" 11 "RESERVED" 12 "RESERVED" 13 "RESERVED" 14 "RESERVED" 15 "RESERVED" 16 "NM_RMS_RSS" 17 "RESERVED" 18 "RESERVED" 19 "RESERVED" 20 "RESERVED" 21 "RESERVED" 22 "RESERVED" 23 "RESERVED" 24 "RESERVED" 25 "RESERVED" 26 "RESERVED" 27 "RESERVED" 28 "RESERVED" 29 "RESERVED" 30 "RESERVED" 31 "RESERVED" 32 "NM_RMS_NS" 33 "21~0xFF:RESERVED" 255 "21~0xFF:RESERVED" ;
VAL_ 2549874823 PNI_SCM_FD 0 "0x0~0xFFFFFFFF:NM PNC Bit" 2147483647 "0x0~0xFFFFFFFF:NM PNC Bit" ;
VAL_ 2549874823 PNI_SCM_FD_1 0 "0x0~0xFFFFFFFFFFFFFFFF:NM PNC Bit" ;
VAL_ 2549874823 PNI_SCM_FD_2 0 "0x0~0xFFFFFFFFFFFFFFFF:NM PNC Bit" ;
VAL_ 2549874823 PNI_SCM_FD_3 0 "0x0~0xFFFFFFFFFFFFFFFF:NM PNC Bit" ;
VAL_ 2549874858 SNI_SHVU_FRNT_FD 0 "0x0~0xFF:NM Source Node ID" 255 "0x0~0xFF:NM Source Node ID" ;
VAL_ 2549874858 CBV_RMR_SHVU_FRNT_FD 0 "Repeat Message State not requested" 1 "Repeat Message State requested" ;
VAL_ 2549874858 CBV_NMCoID_SHVU_FRNT_FD 0 "NM Coordinator ID" 1 "NM Coordinator ID" 2 "NM Coordinator ID" 3 "NM Coordinator ID" ;
VAL_ 2549874858 CBV_NMCoSRB_SHVU_FRNT_FD 0 "Start of synchronized shutdown is not requested by main coordinator" 1 "Start of synchronized shutdown is requested by main coordinator" ;
VAL_ 2549874858 CBV_AWB_SHVU_FRNT_FD 0 "Node has not woken up the network (passive wakeup)" 1 "Node has woken up the network (active wakeup)" ;
VAL_ 2549874858 CBV_PNIB_SHVU_FRNT_FD 0 "NM PDU contains no partial network cluster information in the user data area" 1 "NM PDU contains partial network cluster information in the user data area" ;
VAL_ 2549874858 NRR_SHVU_FRNT_FD 0 "Default" 1 "1~0xFF:RESERVED" 255 "1~0xFF:RESERVED" ;
VAL_ 2549874858 NM_State_SHVU_FRNT_FD 0 "Default" 1 "NM_RMS_BSM" 2 "NM_RMS_PBSM" 3 "RESERVED" 4 "NM_NS_RMS" 5 "RESERVED" 6 "RESERVED" 7 "RESERVED" 8 "NM_NS_RSS" 9 "RESERVED" 10 "RESERVED" 11 "RESERVED" 12 "RESERVED" 13 "RESERVED" 14 "RESERVED" 15 "RESERVED" 16 "NM_RMS_RSS" 17 "RESERVED" 18 "RESERVED" 19 "RESERVED" 20 "RESERVED" 21 "RESERVED" 22 "RESERVED" 23 "RESERVED" 24 "RESERVED" 25 "RESERVED" 26 "RESERVED" 27 "RESERVED" 28 "RESERVED" 29 "RESERVED" 30 "RESERVED" 31 "RESERVED" 32 "NM_RMS_NS" 33 "21~0xFF:RESERVED" 255 "21~0xFF:RESERVED" ;
VAL_ 2549874858 PNI_SHVU_FRNT_FD 0 "0x0~0xFFFFFFFF:NM PNC Bit" 2147483647 "0x0~0xFFFFFFFF:NM PNC Bit" ;
VAL_ 2549874858 PNI_SHVU_FRNT_FD_1 0 "0x0~0xFFFFFFFFFFFFFFFF:NM PNC Bit" ;
VAL_ 2549874858 PNI_SHVU_FRNT_FD_2 0 "0x0~0xFFFFFFFFFFFFFFFF:NM PNC Bit" ;
VAL_ 2549874858 PNI_SHVU_FRNT_FD_3 0 "0x0~0xFFFFFFFFFFFFFFFF:NM PNC Bit" ;
VAL_ 2549874750 SNI_FLLR_FD 0 "0x0~0xFF:NM Source Node ID" 255 "0x0~0xFF:NM Source Node ID" ;
VAL_ 2549874750 CBV_RMR_FLLR_FD 0 "Repeat Message State not requested" 1 "Repeat Message State requested" ;
VAL_ 2549874750 CBV_NMCoID_FLLR_FD 0 "NM Coordinator ID" 1 "NM Coordinator ID" 2 "NM Coordinator ID" 3 "NM Coordinator ID" ;
VAL_ 2549874750 CBV_NMCoSRB_FLLR_FD 0 "Start of synchronized shutdown is not requested by main coordinator" 1 "Start of synchronized shutdown is requested by main coordinator" ;
VAL_ 2549874750 CBV_AWB_FLLR_FD 0 "Node has not woken up the network (passive wakeup)" 1 "Node has woken up the network (active wakeup)" ;
VAL_ 2549874750 CBV_PNIB_FLLR_FD 0 "NM PDU contains no partial network cluster information in the user data area" 1 "NM PDU contains partial network cluster information in the user data area" ;
VAL_ 2549874750 NRR_FLLR_FD 0 "Default" 1 "1~0xFF:RESERVED" 255 "1~0xFF:RESERVED" ;
VAL_ 2549874750 NM_State_FLLR_FD 0 "Default" 1 "NM_RMS_BSM" 2 "NM_RMS_PBSM" 3 "RESERVED" 4 "NM_NS_RMS" 5 "RESERVED" 6 "RESERVED" 7 "RESERVED" 8 "NM_NS_RSS" 9 "RESERVED" 10 "RESERVED" 11 "RESERVED" 12 "RESERVED" 13 "RESERVED" 14 "RESERVED" 15 "RESERVED" 16 "NM_RMS_RSS" 17 "RESERVED" 18 "RESERVED" 19 "RESERVED" 20 "RESERVED" 21 "RESERVED" 22 "RESERVED" 23 "RESERVED" 24 "RESERVED" 25 "RESERVED" 26 "RESERVED" 27 "RESERVED" 28 "RESERVED" 29 "RESERVED" 30 "RESERVED" 31 "RESERVED" 32 "NM_RMS_NS" 33 "21~0xFF:RESERVED" 255 "21~0xFF:RESERVED" ;
VAL_ 2549874750 PNI_FLLR_FD 0 "0x0~0xFFFFFFFF:NM PNC Bit" 2147483647 "0x0~0xFFFFFFFF:NM PNC Bit" ;
VAL_ 2549874750 PNI_FLLR_FD_1 0 "0x0~0xFFFFFFFFFFFFFFFF:NM PNC Bit" ;
VAL_ 2549874750 PNI_FLLR_FD_2 0 "0x0~0xFFFFFFFFFFFFFFFF:NM PNC Bit" ;
VAL_ 2549874750 PNI_FLLR_FD_3 0 "0x0~0xFFFFFFFFFFFFFFFF:NM PNC Bit" ;
VAL_ 2549874905 SNI_GW_SAU_DRV_FD 0 "0x0~0xFF:NM Source Node ID" 255 "0x0~0xFF:NM Source Node ID" ;
VAL_ 2549874905 CBV_RMR_GW_SAU_DRV_FD 0 "Repeat Message State not requested" 1 "Repeat Message State requested" ;
VAL_ 2549874905 CBV_NMCoID_GW_SAU_DRV_FD 0 "NM Coordinator ID" 1 "NM Coordinator ID" 2 "NM Coordinator ID" 3 "NM Coordinator ID" ;
VAL_ 2549874905 CBV_NMCoSRB_GW_SAU_DRV_FD 0 "Start of synchronized shutdown is not requested by main coordinator" 1 "Start of synchronized shutdown is requested by main coordinator" ;
VAL_ 2549874905 CBV_AWB_GW_SAU_DRV_FD 0 "Node has not woken up the network (passive wakeup)" 1 "Node has woken up the network (active wakeup)" ;
VAL_ 2549874905 CBV_PNIB_GW_SAU_DRV_FD 0 "NM PDU contains no partial network cluster information in the user data area" 1 "NM PDU contains partial network cluster information in the user data area" ;
VAL_ 2549874905 NRR_GW_SAU_DRV_FD 0 "Default" 1 "1~0xFF:RESERVED" 255 "1~0xFF:RESERVED" ;
VAL_ 2549874905 NM_State_GW_SAU_DRV_FD 0 "Default" 1 "NM_RMS_BSM" 2 "NM_RMS_PBSM" 3 "RESERVED" 4 "NM_NS_RMS" 5 "RESERVED" 6 "RESERVED" 7 "RESERVED" 8 "NM_NS_RSS" 9 "RESERVED" 10 "RESERVED" 11 "RESERVED" 12 "RESERVED" 13 "RESERVED" 14 "RESERVED" 15 "RESERVED" 16 "NM_RMS_RSS" 17 "RESERVED" 18 "RESERVED" 19 "RESERVED" 20 "RESERVED" 21 "RESERVED" 22 "RESERVED" 23 "RESERVED" 24 "RESERVED" 25 "RESERVED" 26 "RESERVED" 27 "RESERVED" 28 "RESERVED" 29 "RESERVED" 30 "RESERVED" 31 "RESERVED" 32 "NM_RMS_NS" 33 "21~0xFF:RESERVED" 255 "21~0xFF:RESERVED" ;
VAL_ 2549874905 PNI_GW_SAU_DRV_FD 0 "0x0~0xFFFFFFFF:NM PNC Bit" 2147483647 "0x0~0xFFFFFFFF:NM PNC Bit" ;
VAL_ 2549874905 PNI_GW_SAU_DRV_FD_1 0 "0x0~0xFFFFFFFFFFFFFFFF:NM PNC Bit" ;
VAL_ 2549874905 PNI_GW_SAU_DRV_FD_2 0 "0x0~0xFFFFFFFFFFFFFFFF:NM PNC Bit" ;
VAL_ 2549874905 PNI_GW_SAU_DRV_FD_3 0 "0x0~0xFFFFFFFFFFFFFFFF:NM PNC Bit" ;
VAL_ 2549874896 SNI_ATS_FD 0 "0x0~0xFF:NM Source Node ID" 255 "0x0~0xFF:NM Source Node ID" ;
VAL_ 2549874896 CBV_RMR_ATS_FD 0 "Repeat Message State not requested" 1 "Repeat Message State requested" ;
VAL_ 2549874896 CBV_NMCoID_ATS_FD 0 "NM Coordinator ID" 1 "NM Coordinator ID" 2 "NM Coordinator ID" 3 "NM Coordinator ID" ;
VAL_ 2549874896 CBV_NMCoSRB_ATS_FD 0 "Start of synchronized shutdown is not requested by main coordinator" 1 "Start of synchronized shutdown is requested by main coordinator" ;
VAL_ 2549874896 CBV_AWB_ATS_FD 0 "Node has not woken up the network (passive wakeup)" 1 "Node has woken up the network (active wakeup)" ;
VAL_ 2549874896 CBV_PNIB_ATS_FD 0 "NM PDU contains no partial network cluster information in the user data area" 1 "NM PDU contains partial network cluster information in the user data area" ;
VAL_ 2549874896 NRR_ATS_FD 0 "Default" 1 "1~0xFF:RESERVED" 255 "1~0xFF:RESERVED" ;
VAL_ 2549874896 NM_State_ATS_FD 0 "Default" 1 "NM_RMS_BSM" 2 "NM_RMS_PBSM" 3 "RESERVED" 4 "NM_NS_RMS" 5 "RESERVED" 6 "RESERVED" 7 "RESERVED" 8 "NM_NS_RSS" 9 "RESERVED" 10 "RESERVED" 11 "RESERVED" 12 "RESERVED" 13 "RESERVED" 14 "RESERVED" 15 "RESERVED" 16 "NM_RMS_RSS" 17 "RESERVED" 18 "RESERVED" 19 "RESERVED" 20 "RESERVED" 21 "RESERVED" 22 "RESERVED" 23 "RESERVED" 24 "RESERVED" 25 "RESERVED" 26 "RESERVED" 27 "RESERVED" 28 "RESERVED" 29 "RESERVED" 30 "RESERVED" 31 "RESERVED" 32 "NM_RMS_NS" 33 "21~0xFF:RESERVED" 255 "21~0xFF:RESERVED" ;
VAL_ 2549874896 PNI_ATS_FD 0 "0x0~0xFFFFFFFF:NM PNC Bit" 2147483647 "0x0~0xFFFFFFFF:NM PNC Bit" ;
VAL_ 2549874896 PNI_ATS_FD_1 0 "0x0~0xFFFFFFFFFFFFFFFF:NM PNC Bit" ;
VAL_ 2549874896 PNI_ATS_FD_2 0 "0x0~0xFFFFFFFFFFFFFFFF:NM PNC Bit" ;
VAL_ 2549874896 PNI_ATS_FD_3 0 "0x0~0xFFFFFFFFFFFFFFFF:NM PNC Bit" ;
VAL_ 2549874881 SNI_PSB_FD 0 "0x0~0xFF:NM Source Node ID" 255 "0x0~0xFF:NM Source Node ID" ;
VAL_ 2549874881 CBV_RMR_PSB_FD 0 "Repeat Message State not requested" 1 "Repeat Message State requested" ;
VAL_ 2549874881 CBV_NMCoID_PSB_FD 0 "NM Coordinator ID" 1 "NM Coordinator ID" 2 "NM Coordinator ID" 3 "NM Coordinator ID" ;
VAL_ 2549874881 CBV_NMCoSRB_PSB_FD 0 "Start of synchronized shutdown is not requested by main coordinator" 1 "Start of synchronized shutdown is requested by main coordinator" ;
VAL_ 2549874881 CBV_AWB_PSB_FD 0 "Node has not woken up the network (passive wakeup)" 1 "Node has woken up the network (active wakeup)" ;
VAL_ 2549874881 CBV_PNIB_PSB_FD 0 "NM PDU contains no partial network cluster information in the user data area" 1 "NM PDU contains partial network cluster information in the user data area" ;
VAL_ 2549874881 NRR_PSB_FD 0 "Default" 1 "1~0xFF:RESERVED" 255 "1~0xFF:RESERVED" ;
VAL_ 2549874881 NM_State_PSB_FD 0 "Default" 1 "NM_RMS_BSM" 2 "NM_RMS_PBSM" 3 "RESERVED" 4 "NM_NS_RMS" 5 "RESERVED" 6 "RESERVED" 7 "RESERVED" 8 "NM_NS_RSS" 9 "RESERVED" 10 "RESERVED" 11 "RESERVED" 12 "RESERVED" 13 "RESERVED" 14 "RESERVED" 15 "RESERVED" 16 "NM_RMS_RSS" 17 "RESERVED" 18 "RESERVED" 19 "RESERVED" 20 "RESERVED" 21 "RESERVED" 22 "RESERVED" 23 "RESERVED" 24 "RESERVED" 25 "RESERVED" 26 "RESERVED" 27 "RESERVED" 28 "RESERVED" 29 "RESERVED" 30 "RESERVED" 31 "RESERVED" 32 "NM_RMS_NS" 33 "21~0xFF:RESERVED" 255 "21~0xFF:RESERVED" ;
VAL_ 2549874881 PNI_PSB_FD 0 "0x0~0xFFFFFFFF:NM PNC Bit" 2147483647 "0x0~0xFFFFFFFF:NM PNC Bit" ;
VAL_ 2549874881 PNI_PSB_FD_1 0 "0x0~0xFFFFFFFFFFFFFFFF:NM PNC Bit" ;
VAL_ 2549874881 PNI_PSB_FD_2 0 "0x0~0xFFFFFFFFFFFFFFFF:NM PNC Bit" ;
VAL_ 2549874881 PNI_PSB_FD_3 0 "0x0~0xFFFFFFFFFFFFFFFF:NM PNC Bit" ;
